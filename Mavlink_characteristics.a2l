/begin COMPU_METHOD CM_AHRS_GPS_USE "AHRS use GPS for navigation" TAB_VERB "%17.6" "" COMPU_TAB_REF TAB_AHRS_GPS_USE /end COMPU_METHOD
/begin COMPU_VTAB TAB_AHRS_GPS_USE "AHRS use GPS for navigation, This controls whether to use dead-reckoning or GPS based navigation. If set to 0 then the GPS won't be used for navigation, and only dead reckoning will be used. A value of zero should never be used for normal flight." TAB_VERB 2 0 "Disabled" 1 "Enabled" /end COMPU_VTAB
/begin CHARACTERISTIC AHRS_GPS_USE "AHRS use GPS for navigation, This controls whether to use dead-reckoning or GPS based navigation. If set to 0 then the GPS won't be used for navigation, and only dead reckoning will be used. A value of zero should never be used for normal flight." VALUE 0x36100000 Scalar_FLOAT32_IEEE 0 CM_AHRS_GPS_USE 0.0 1.0 /end CHARACTERISTIC
/begin CHARACTERISTIC AHRS_YAW_P "Yaw P, This controls the weight the compass or GPS has on the heading. A higher value means the heading will track the yaw source (GPS or compass) more rapidly." VALUE 0x36100000 Scalar_FLOAT32_IEEE 0 IDENTICAL 0.1 0.4 /end CHARACTERISTIC
/begin CHARACTERISTIC AHRS_RP_P "AHRS RP_P, This controls how fast the accelerometers correct the attitude" VALUE 0x36100000 Scalar_FLOAT32_IEEE 0 IDENTICAL 0.1 0.4 /end CHARACTERISTIC
/begin CHARACTERISTIC AHRS_WIND_MAX "Maximum wind, This sets the maximum allowable difference between ground speed and airspeed. This allows the plane to cope with a failing airspeed sensor. A value of zero means to use the airspeed as is." VALUE 0x36100000 Scalar_FLOAT32_IEEE 0 METERS_PER_SECOND 0.0 127.0 /end CHARACTERISTIC
/begin CHARACTERISTIC AHRS_TRIM_X "AHRS Trim Roll, Compensates for the roll angle difference between the control board and the frame. Positive values make the vehicle roll right." VALUE 0x36100000 Scalar_FLOAT32_IEEE 0 RADIANS -0.1745 0.1745 /end CHARACTERISTIC
/begin CHARACTERISTIC AHRS_TRIM_Y "AHRS Trim Pitch, Compensates for the pitch angle difference between the control board and the frame. Positive values make the vehicle pitch up/back." VALUE 0x36100000 Scalar_FLOAT32_IEEE 0 RADIANS -0.1745 0.1745 /end CHARACTERISTIC
/begin CHARACTERISTIC AHRS_TRIM_Z "AHRS Trim Yaw, Not Used" VALUE 0x36100000 Scalar_FLOAT32_IEEE 0 RADIANS -0.1745 0.1745 /end CHARACTERISTIC
/begin COMPU_METHOD CM_AHRS_ORIENTATION "Board Orientation" TAB_VERB "%17.6" "" COMPU_TAB_REF TAB_AHRS_ORIENTATION /end COMPU_METHOD
/begin COMPU_VTAB TAB_AHRS_ORIENTATION "Board Orientation, Overall board orientation relative to the standard orientation for the board type. This rotates the IMU and compass readings to allow the board to be oriented in your vehicle at any 90 or 45 degree angle. This option takes affect on next boot. After changing you will need to re-level your vehicle." TAB_VERB 38 0 "None" 1 "Yaw45" 2 "Yaw90" 3 "Yaw135" 4 "Yaw180" 5 "Yaw225" 6 "Yaw270" 7 "Yaw315" 8 "Roll180" 9 "Roll180Yaw45" 10 "Roll180Yaw90" 11 "Roll180Yaw135" 12 "Pitch180" 13 "Roll180Yaw225" 14 "Roll180Yaw270" 15 "Roll180Yaw315" 16 "Roll90" 17 "Roll90Yaw45" 18 "Roll90Yaw90" 19 "Roll90Yaw135" 20 "Roll270" 21 "Roll270Yaw45" 22 "Roll270Yaw90" 23 "Roll270Yaw136" 24 "Pitch90" 25 "Pitch270" 26 "Pitch180Yaw90" 27 "Pitch180Yaw270" 28 "Roll90Pitch90" 29 "Roll180Pitch90" 30 "Roll270Pitch90" 31 "Roll90Pitch180" 32 "Roll270Pitch180" 33 "Roll90Pitch270" 34 "Roll180Pitch270" 35 "Roll270Pitch270" 36 "Roll90Pitch180Yaw90" 37 "Roll90Yaw270" /end COMPU_VTAB
/begin CHARACTERISTIC AHRS_ORIENTATION "Board Orientation, Overall board orientation relative to the standard orientation for the board type. This rotates the IMU and compass readings to allow the board to be oriented in your vehicle at any 90 or 45 degree angle. This option takes affect on next boot. After changing you will need to re-level your vehicle." VALUE 0x36100000 Scalar_FLOAT32_IEEE 0 CM_AHRS_ORIENTATION 0.0 37.0 /end CHARACTERISTIC
/begin CHARACTERISTIC AHRS_COMP_BETA "AHRS Velocity Complementary Filter Beta Coefficient, This controls the time constant for the cross-over frequency used to fuse AHRS (airspeed and heading) and GPS data to estimate ground velocity. Time constant is 0.1/beta. A larger time constant will use GPS data less and a small time constant will use air data less." VALUE 0x36100000 Scalar_FLOAT32_IEEE 0 IDENTICAL 0.001 0.5 /end CHARACTERISTIC
/begin CHARACTERISTIC AHRS_GPS_MINSATS "AHRS GPS Minimum satellites, Minimum number of satellites visible to use GPS for velocity based corrections attitude correction. This defaults to 6, which is about the point at which the velocity numbers from a GPS become too unreliable for accurate correction of the accelerometers." VALUE 0x36100000 Scalar_FLOAT32_IEEE 0 IDENTICAL 0.0 10.0 /end CHARACTERISTIC
/begin COMPU_METHOD CM_AHRS_EKF_TYPE "Use NavEKF Kalman filter for attitude and position estimation" TAB_VERB "%17.6" "" COMPU_TAB_REF TAB_AHRS_EKF_TYPE /end COMPU_METHOD
/begin COMPU_VTAB TAB_AHRS_EKF_TYPE "Use NavEKF Kalman filter for attitude and position estimation, This controls whether the NavEKF Kalman filter is used for attitude and position estimation and whether fallback to the DCM algorithm is allowed. Note that on copters " disabled " is not available, and will be the same as " enabled - no fallback "" TAB_VERB 3 0 "Disabled" 1 "Enabled" 2 "Enable EKF2" /end COMPU_VTAB
/begin CHARACTERISTIC AHRS_EKF_TYPE "Use NavEKF Kalman filter for attitude and position estimation, This controls whether the NavEKF Kalman filter is used for attitude and position estimation and whether fallback to the DCM algorithm is allowed. Note that on copters " disabled " is not available, and will be the same as " enabled - no fallback "" VALUE 0x36100000 Scalar_FLOAT32_IEEE 0 CM_AHRS_EKF_TYPE 0.0 2.0 /end CHARACTERISTIC
/begin COMPU_METHOD CM_MNT_DEFLT_MODE "Mount default operating mode" TAB_VERB "%17.6" "" COMPU_TAB_REF TAB_MNT_DEFLT_MODE /end COMPU_METHOD
/begin COMPU_VTAB TAB_MNT_DEFLT_MODE "Mount default operating mode, Mount default operating mode on startup and after control is returned from autopilot" TAB_VERB 5 0 "Retracted" 1 "Neutral" 2 "MavLink Targeting" 3 "RC Targeting" 4 "GPS Point" /end COMPU_VTAB
/begin CHARACTERISTIC MNT_DEFLT_MODE "Mount default operating mode, Mount default operating mode on startup and after control is returned from autopilot" VALUE 0x36100000 Scalar_FLOAT32_IEEE 0 CM_MNT_DEFLT_MODE 0.0 4.0 /end CHARACTERISTIC
/begin CHARACTERISTIC MNT_RETRACT_X "Mount roll angle when in retracted position, Mount roll angle when in retracted position" VALUE 0x36100000 Scalar_FLOAT32_IEEE 0 DEGREES -180.0 179.99 /end CHARACTERISTIC
/begin CHARACTERISTIC MNT_RETRACT_Y "Mount tilt/pitch angle when in retracted position, Mount tilt/pitch angle when in retracted position" VALUE 0x36100000 Scalar_FLOAT32_IEEE 0 DEGREES -180.0 179.99 /end CHARACTERISTIC
/begin CHARACTERISTIC MNT_RETRACT_Z "Mount yaw/pan angle when in retracted position, Mount yaw/pan angle when in retracted position" VALUE 0x36100000 Scalar_FLOAT32_IEEE 0 DEGREES -180.0 179.99 /end CHARACTERISTIC
/begin CHARACTERISTIC MNT_NEUTRAL_X "Mount roll angle when in neutral position, Mount roll angle when in neutral position" VALUE 0x36100000 Scalar_FLOAT32_IEEE 0 DEGREES -180.0 179.99 /end CHARACTERISTIC
/begin CHARACTERISTIC MNT_NEUTRAL_Y "Mount tilt/pitch angle when in neutral position, Mount tilt/pitch angle when in neutral position" VALUE 0x36100000 Scalar_FLOAT32_IEEE 0 DEGREES -180.0 179.99 /end CHARACTERISTIC
/begin CHARACTERISTIC MNT_NEUTRAL_Z "Mount pan/yaw angle when in neutral position, Mount pan/yaw angle when in neutral position" VALUE 0x36100000 Scalar_FLOAT32_IEEE 0 DEGREES -180.0 179.99 /end CHARACTERISTIC
/begin COMPU_METHOD CM_MNT_STAB_ROLL "Stabilize mount's roll angle" TAB_VERB "%17.6" "" COMPU_TAB_REF TAB_MNT_STAB_ROLL /end COMPU_METHOD
/begin COMPU_VTAB TAB_MNT_STAB_ROLL "Stabilize mount's roll angle, enable roll stabilisation relative to Earth" TAB_VERB 2 0 "Disabled" 1 "Enabled" /end COMPU_VTAB
/begin CHARACTERISTIC MNT_STAB_ROLL "Stabilize mount's roll angle, enable roll stabilisation relative to Earth" VALUE 0x36100000 Scalar_FLOAT32_IEEE 0 CM_MNT_STAB_ROLL 0.0 1.0 /end CHARACTERISTIC
/begin COMPU_METHOD CM_MNT_STAB_TILT "Stabilize mount's pitch/tilt angle" TAB_VERB "%17.6" "" COMPU_TAB_REF TAB_MNT_STAB_TILT /end COMPU_METHOD
/begin COMPU_VTAB TAB_MNT_STAB_TILT "Stabilize mount's pitch/tilt angle, enable tilt/pitch stabilisation relative to Earth" TAB_VERB 2 0 "Disabled" 1 "Enabled" /end COMPU_VTAB
/begin CHARACTERISTIC MNT_STAB_TILT "Stabilize mount's pitch/tilt angle, enable tilt/pitch stabilisation relative to Earth" VALUE 0x36100000 Scalar_FLOAT32_IEEE 0 CM_MNT_STAB_TILT 0.0 1.0 /end CHARACTERISTIC
/begin COMPU_METHOD CM_MNT_STAB_PAN "Stabilize mount pan/yaw angle" TAB_VERB "%17.6" "" COMPU_TAB_REF TAB_MNT_STAB_PAN /end COMPU_METHOD
/begin COMPU_VTAB TAB_MNT_STAB_PAN "Stabilize mount pan/yaw angle, enable pan/yaw stabilisation relative to Earth" TAB_VERB 2 0 "Disabled" 1 "Enabled" /end COMPU_VTAB
/begin CHARACTERISTIC MNT_STAB_PAN "Stabilize mount pan/yaw angle, enable pan/yaw stabilisation relative to Earth" VALUE 0x36100000 Scalar_FLOAT32_IEEE 0 CM_MNT_STAB_PAN 0.0 1.0 /end CHARACTERISTIC
/begin COMPU_METHOD CM_MNT_RC_IN_ROLL "roll RC input channel" TAB_VERB "%17.6" "" COMPU_TAB_REF TAB_MNT_RC_IN_ROLL /end COMPU_METHOD
/begin COMPU_VTAB TAB_MNT_RC_IN_ROLL "roll RC input channel, 0 for none, any other for the RC channel to be used to control roll movements" TAB_VERB 9 0 "Disabled" 5 "RC5" 6 "RC6" 7 "RC7" 8 "RC8" 9 "RC9" 10 "RC10" 11 "RC11" 12 "RC12" /end COMPU_VTAB
/begin CHARACTERISTIC MNT_RC_IN_ROLL "roll RC input channel, 0 for none, any other for the RC channel to be used to control roll movements" VALUE 0x36100000 Scalar_FLOAT32_IEEE 0 CM_MNT_RC_IN_ROLL 0.0 12.0 /end CHARACTERISTIC
/begin CHARACTERISTIC MNT_ANGMIN_ROL "Minimum roll angle, Minimum physical roll angular position of mount." VALUE 0x36100000 Scalar_FLOAT32_IEEE 0 CENTIDEGREES -18000.0 17999.0 /end CHARACTERISTIC
/begin CHARACTERISTIC MNT_ANGMAX_ROL "Maximum roll angle, Maximum physical roll angular position of the mount" VALUE 0x36100000 Scalar_FLOAT32_IEEE 0 CENTIDEGREES -18000.0 17999.0 /end CHARACTERISTIC
/begin COMPU_METHOD CM_MNT_RC_IN_TILT "tilt (pitch) RC input channel" TAB_VERB "%17.6" "" COMPU_TAB_REF TAB_MNT_RC_IN_TILT /end COMPU_METHOD
/begin COMPU_VTAB TAB_MNT_RC_IN_TILT "tilt (pitch) RC input channel, 0 for none, any other for the RC channel to be used to control tilt (pitch) movements" TAB_VERB 9 0 "Disabled" 5 "RC5" 6 "RC6" 7 "RC7" 8 "RC8" 9 "RC9" 10 "RC10" 11 "RC11" 12 "RC12" /end COMPU_VTAB
/begin CHARACTERISTIC MNT_RC_IN_TILT "tilt (pitch) RC input channel, 0 for none, any other for the RC channel to be used to control tilt (pitch) movements" VALUE 0x36100000 Scalar_FLOAT32_IEEE 0 CM_MNT_RC_IN_TILT 0.0 12.0 /end CHARACTERISTIC
/begin CHARACTERISTIC MNT_ANGMIN_TIL "Minimum tilt angle, Minimum physical tilt (pitch) angular position of mount." VALUE 0x36100000 Scalar_FLOAT32_IEEE 0 CENTIDEGREES -18000.0 17999.0 /end CHARACTERISTIC
/begin CHARACTERISTIC MNT_ANGMAX_TIL "Maximum tilt angle, Maximum physical tilt (pitch) angular position of the mount" VALUE 0x36100000 Scalar_FLOAT32_IEEE 0 CENTIDEGREES -18000.0 17999.0 /end CHARACTERISTIC
/begin COMPU_METHOD CM_MNT_RC_IN_PAN "pan (yaw) RC input channel" TAB_VERB "%17.6" "" COMPU_TAB_REF TAB_MNT_RC_IN_PAN /end COMPU_METHOD
/begin COMPU_VTAB TAB_MNT_RC_IN_PAN "pan (yaw) RC input channel, 0 for none, any other for the RC channel to be used to control pan (yaw) movements" TAB_VERB 9 0 "Disabled" 5 "RC5" 6 "RC6" 7 "RC7" 8 "RC8" 9 "RC9" 10 "RC10" 11 "RC11" 12 "RC12" /end COMPU_VTAB
/begin CHARACTERISTIC MNT_RC_IN_PAN "pan (yaw) RC input channel, 0 for none, any other for the RC channel to be used to control pan (yaw) movements" VALUE 0x36100000 Scalar_FLOAT32_IEEE 0 CM_MNT_RC_IN_PAN 0.0 12.0 /end CHARACTERISTIC
/begin CHARACTERISTIC MNT_ANGMIN_PAN "Minimum pan angle, Minimum physical pan (yaw) angular position of mount." VALUE 0x36100000 Scalar_FLOAT32_IEEE 0 CENTIDEGREES -18000.0 17999.0 /end CHARACTERISTIC
/begin CHARACTERISTIC MNT_ANGMAX_PAN "Maximum pan angle, Maximum physical pan (yaw) angular position of the mount" VALUE 0x36100000 Scalar_FLOAT32_IEEE 0 CENTIDEGREES -18000.0 17999.0 /end CHARACTERISTIC
/begin CHARACTERISTIC MNT_JSTICK_SPD "mount joystick speed, 0 for position control, small for low speeds, 100 for max speed. A good general value is 10 which gives a movement speed of 3 degrees per second." VALUE 0x36100000 Scalar_FLOAT32_IEEE 0 IDENTICAL 0.0 100.0 /end CHARACTERISTIC
/begin CHARACTERISTIC MNT_LEAD_RLL "Roll stabilization lead time, Causes the servo angle output to lead the current angle of the vehicle by some amount of time based on current angular rate, compensating for servo delay. Increase until the servo is responsive but doesn't overshoot. Does nothing with pan stabilization enabled." VALUE 0x36100000 Scalar_FLOAT32_IEEE 0 SECONDS 0.0 0.2 /end CHARACTERISTIC
/begin CHARACTERISTIC MNT_LEAD_PTCH "Pitch stabilization lead time, Causes the servo angle output to lead the current angle of the vehicle by some amount of time based on current angular rate. Increase until the servo is responsive but doesn't overshoot. Does nothing with pan stabilization enabled." VALUE 0x36100000 Scalar_FLOAT32_IEEE 0 SECONDS 0.0 0.2 /end CHARACTERISTIC
/begin COMPU_METHOD CM_MNT_TYPE "Mount Type" TAB_VERB "%17.6" "" COMPU_TAB_REF TAB_MNT_TYPE /end COMPU_METHOD
/begin COMPU_VTAB TAB_MNT_TYPE "Mount Type, Mount Type (None, Servo or MAVLink)" TAB_VERB 6 0 "None" 1 "Servo" 2 "3DR Solo" 3 "Alexmos Serial" 4 "SToRM32 MAVLink" 5 "SToRM32 Serial" /end COMPU_VTAB
/begin CHARACTERISTIC MNT_TYPE "Mount Type, Mount Type (None, Servo or MAVLink)" VALUE 0x36100000 Scalar_FLOAT32_IEEE 0 CM_MNT_TYPE 0.0 5.0 /end CHARACTERISTIC
/begin COMPU_METHOD CM_MNT2_DEFLT_MODE "Mount default operating mode" TAB_VERB "%17.6" "" COMPU_TAB_REF TAB_MNT2_DEFLT_MODE /end COMPU_METHOD
/begin COMPU_VTAB TAB_MNT2_DEFLT_MODE "Mount default operating mode, Mount default operating mode on startup and after control is returned from autopilot" TAB_VERB 5 0 "Retracted" 1 "Neutral" 2 "MavLink Targeting" 3 "RC Targeting" 4 "GPS Point" /end COMPU_VTAB
/begin CHARACTERISTIC MNT2_DEFLT_MODE "Mount default operating mode, Mount default operating mode on startup and after control is returned from autopilot" VALUE 0x36100000 Scalar_FLOAT32_IEEE 0 CM_MNT2_DEFLT_MODE 0.0 4.0 /end CHARACTERISTIC
/begin CHARACTERISTIC MNT2_RETRACT_X "Mount2 roll angle when in retracted position, Mount2 roll angle when in retracted position" VALUE 0x36100000 Scalar_FLOAT32_IEEE 0 DEGREES -180.0 179.99 /end CHARACTERISTIC
/begin CHARACTERISTIC MNT2_RETRACT_Y "Mount2 tilt/pitch angle when in retracted position, Mount2 tilt/pitch angle when in retracted position" VALUE 0x36100000 Scalar_FLOAT32_IEEE 0 DEGREES -180.0 179.99 /end CHARACTERISTIC
/begin CHARACTERISTIC MNT2_RETRACT_Z "Mount2 yaw/pan angle when in retracted position, Mount2 yaw/pan angle when in retracted position" VALUE 0x36100000 Scalar_FLOAT32_IEEE 0 DEGREES -180.0 179.99 /end CHARACTERISTIC
/begin CHARACTERISTIC MNT2_NEUTRAL_X "Mount2 roll angle when in neutral position, Mount2 roll angle when in neutral position" VALUE 0x36100000 Scalar_FLOAT32_IEEE 0 DEGREES -180.0 179.99 /end CHARACTERISTIC
/begin CHARACTERISTIC MNT2_NEUTRAL_Y "Mount2 tilt/pitch angle when in neutral position, Mount2 tilt/pitch angle when in neutral position" VALUE 0x36100000 Scalar_FLOAT32_IEEE 0 DEGREES -180.0 179.99 /end CHARACTERISTIC
/begin CHARACTERISTIC MNT2_NEUTRAL_Z "Mount2 pan/yaw angle when in neutral position, Mount2 pan/yaw angle when in neutral position" VALUE 0x36100000 Scalar_FLOAT32_IEEE 0 DEGREES -180.0 179.99 /end CHARACTERISTIC
/begin COMPU_METHOD CM_MNT2_STAB_ROLL "Stabilize Mount2's roll angle" TAB_VERB "%17.6" "" COMPU_TAB_REF TAB_MNT2_STAB_ROLL /end COMPU_METHOD
/begin COMPU_VTAB TAB_MNT2_STAB_ROLL "Stabilize Mount2's roll angle, enable roll stabilisation relative to Earth" TAB_VERB 2 0 "Disabled" 1 "Enabled" /end COMPU_VTAB
/begin CHARACTERISTIC MNT2_STAB_ROLL "Stabilize Mount2's roll angle, enable roll stabilisation relative to Earth" VALUE 0x36100000 Scalar_FLOAT32_IEEE 0 CM_MNT2_STAB_ROLL 0.0 1.0 /end CHARACTERISTIC
/begin COMPU_METHOD CM_MNT2_STAB_TILT "Stabilize Mount2's pitch/tilt angle" TAB_VERB "%17.6" "" COMPU_TAB_REF TAB_MNT2_STAB_TILT /end COMPU_METHOD
/begin COMPU_VTAB TAB_MNT2_STAB_TILT "Stabilize Mount2's pitch/tilt angle, enable tilt/pitch stabilisation relative to Earth" TAB_VERB 2 0 "Disabled" 1 "Enabled" /end COMPU_VTAB
/begin CHARACTERISTIC MNT2_STAB_TILT "Stabilize Mount2's pitch/tilt angle, enable tilt/pitch stabilisation relative to Earth" VALUE 0x36100000 Scalar_FLOAT32_IEEE 0 CM_MNT2_STAB_TILT 0.0 1.0 /end CHARACTERISTIC
/begin COMPU_METHOD CM_MNT2_STAB_PAN "Stabilize mount2 pan/yaw angle" TAB_VERB "%17.6" "" COMPU_TAB_REF TAB_MNT2_STAB_PAN /end COMPU_METHOD
/begin COMPU_VTAB TAB_MNT2_STAB_PAN "Stabilize mount2 pan/yaw angle, enable pan/yaw stabilisation relative to Earth" TAB_VERB 2 0 "Disabled" 1 "Enabled" /end COMPU_VTAB
/begin CHARACTERISTIC MNT2_STAB_PAN "Stabilize mount2 pan/yaw angle, enable pan/yaw stabilisation relative to Earth" VALUE 0x36100000 Scalar_FLOAT32_IEEE 0 CM_MNT2_STAB_PAN 0.0 1.0 /end CHARACTERISTIC
/begin COMPU_METHOD CM_MNT2_RC_IN_ROLL "Mount2's roll RC input channel" TAB_VERB "%17.6" "" COMPU_TAB_REF TAB_MNT2_RC_IN_ROLL /end COMPU_METHOD
/begin COMPU_VTAB TAB_MNT2_RC_IN_ROLL "Mount2's roll RC input channel, 0 for none, any other for the RC channel to be used to control roll movements" TAB_VERB 9 0 "Disabled" 5 "RC5" 6 "RC6" 7 "RC7" 8 "RC8" 9 "RC9" 10 "RC10" 11 "RC11" 12 "RC12" /end COMPU_VTAB
/begin CHARACTERISTIC MNT2_RC_IN_ROLL "Mount2's roll RC input channel, 0 for none, any other for the RC channel to be used to control roll movements" VALUE 0x36100000 Scalar_FLOAT32_IEEE 0 CM_MNT2_RC_IN_ROLL 0.0 12.0 /end CHARACTERISTIC
/begin CHARACTERISTIC MNT2_ANGMIN_ROL "Mount2's minimum roll angle, Mount2's minimum physical roll angular position" VALUE 0x36100000 Scalar_FLOAT32_IEEE 0 CENTIDEGREES -18000.0 17999.0 /end CHARACTERISTIC
/begin CHARACTERISTIC MNT2_ANGMAX_ROL "Mount2's maximum roll angle, Mount2's maximum physical roll angular position" VALUE 0x36100000 Scalar_FLOAT32_IEEE 0 CENTIDEGREES -18000.0 17999.0 /end CHARACTERISTIC
/begin COMPU_METHOD CM_MNT2_RC_IN_TILT "Mount2's tilt (pitch) RC input channel" TAB_VERB "%17.6" "" COMPU_TAB_REF TAB_MNT2_RC_IN_TILT /end COMPU_METHOD
/begin COMPU_VTAB TAB_MNT2_RC_IN_TILT "Mount2's tilt (pitch) RC input channel, 0 for none, any other for the RC channel to be used to control tilt (pitch) movements" TAB_VERB 9 0 "Disabled" 5 "RC5" 6 "RC6" 7 "RC7" 8 "RC8" 9 "RC9" 10 "RC10" 11 "RC11" 12 "RC12" /end COMPU_VTAB
/begin CHARACTERISTIC MNT2_RC_IN_TILT "Mount2's tilt (pitch) RC input channel, 0 for none, any other for the RC channel to be used to control tilt (pitch) movements" VALUE 0x36100000 Scalar_FLOAT32_IEEE 0 CM_MNT2_RC_IN_TILT 0.0 12.0 /end CHARACTERISTIC
/begin CHARACTERISTIC MNT2_ANGMIN_TIL "Mount2's minimum tilt angle, Mount2's minimum physical tilt (pitch) angular position" VALUE 0x36100000 Scalar_FLOAT32_IEEE 0 CENTIDEGREES -18000.0 17999.0 /end CHARACTERISTIC
/begin CHARACTERISTIC MNT2_ANGMAX_TIL "Mount2's maximum tilt angle, Mount2's maximum physical tilt (pitch) angular position" VALUE 0x36100000 Scalar_FLOAT32_IEEE 0 CENTIDEGREES -18000.0 17999.0 /end CHARACTERISTIC
/begin COMPU_METHOD CM_MNT2_RC_IN_PAN "Mount2's pan (yaw) RC input channel" TAB_VERB "%17.6" "" COMPU_TAB_REF TAB_MNT2_RC_IN_PAN /end COMPU_METHOD
/begin COMPU_VTAB TAB_MNT2_RC_IN_PAN "Mount2's pan (yaw) RC input channel, 0 for none, any other for the RC channel to be used to control pan (yaw) movements" TAB_VERB 9 0 "Disabled" 5 "RC5" 6 "RC6" 7 "RC7" 8 "RC8" 9 "RC9" 10 "RC10" 11 "RC11" 12 "RC12" /end COMPU_VTAB
/begin CHARACTERISTIC MNT2_RC_IN_PAN "Mount2's pan (yaw) RC input channel, 0 for none, any other for the RC channel to be used to control pan (yaw) movements" VALUE 0x36100000 Scalar_FLOAT32_IEEE 0 CM_MNT2_RC_IN_PAN 0.0 12.0 /end CHARACTERISTIC
/begin CHARACTERISTIC MNT2_ANGMIN_PAN "Mount2's minimum pan angle, Mount2's minimum physical pan (yaw) angular position" VALUE 0x36100000 Scalar_FLOAT32_IEEE 0 CENTIDEGREES -18000.0 17999.0 /end CHARACTERISTIC
/begin CHARACTERISTIC MNT2_ANGMAX_PAN "Mount2's maximum pan angle, MOunt2's maximum physical pan (yaw) angular position" VALUE 0x36100000 Scalar_FLOAT32_IEEE 0 CENTIDEGREES -18000.0 17999.0 /end CHARACTERISTIC
/begin CHARACTERISTIC MNT2_LEAD_RLL "Mount2's Roll stabilization lead time, Causes the servo angle output to lead the current angle of the vehicle by some amount of time based on current angular rate, compensating for servo delay. Increase until the servo is responsive but doesn't overshoot. Does nothing with pan stabilization enabled." VALUE 0x36100000 Scalar_FLOAT32_IEEE 0 SECONDS 0.0 0.2 /end CHARACTERISTIC
/begin CHARACTERISTIC MNT2_LEAD_PTCH "Mount2's Pitch stabilization lead time, Causes the servo angle output to lead the current angle of the vehicle by some amount of time based on current angular rate. Increase until the servo is responsive but doesn't overshoot. Does nothing with pan stabilization enabled." VALUE 0x36100000 Scalar_FLOAT32_IEEE 0 SECONDS 0.0 0.2 /end CHARACTERISTIC
/begin COMPU_METHOD CM_MNT2_TYPE "Mount2 Type" TAB_VERB "%17.6" "" COMPU_TAB_REF TAB_MNT2_TYPE /end COMPU_METHOD
/begin COMPU_VTAB TAB_MNT2_TYPE "Mount2 Type, Mount Type (None, Servo or MAVLink)" TAB_VERB 6 0 "None" 1 "Servo" 2 "3DR Solo" 3 "Alexmos Serial" 4 "SToRM32 MAVLink" 5 "SToRM32 Serial" /end COMPU_VTAB
/begin CHARACTERISTIC MNT2_TYPE "Mount2 Type, Mount Type (None, Servo or MAVLink)" VALUE 0x36100000 Scalar_FLOAT32_IEEE 0 CM_MNT2_TYPE 0.0 5.0 /end CHARACTERISTIC
/begin COMPU_METHOD CM_LOG_BACKEND_TYPE "DataFlash Backend Storage type" TAB_VERB "%17.6" "" COMPU_TAB_REF TAB_LOG_BACKEND_TYPE /end COMPU_METHOD
/begin COMPU_VTAB TAB_LOG_BACKEND_TYPE "DataFlash Backend Storage type, 0 for None, 1 for File, 2 for dataflash mavlink, 3 for both file and dataflash" TAB_VERB 4 0 "None" 1 "File" 2 "MAVLink" 3 "BothFileAndMAVLink" /end COMPU_VTAB
/begin CHARACTERISTIC LOG_BACKEND_TYPE "DataFlash Backend Storage type, 0 for None, 1 for File, 2 for dataflash mavlink, 3 for both file and dataflash" VALUE 0x36100000 Scalar_FLOAT32_IEEE 0 CM_LOG_BACKEND_TYPE 0.0 3.0 /end CHARACTERISTIC
/begin CHARACTERISTIC LOG_FILE_BUFSIZE "Maximum DataFlash File Backend buffer size (in kilobytes), The DataFlash_File backend uses a buffer to store data before writing to the block device.  Raising this value may reduce " gaps " in your SD card logging.  This buffer size may be reduced depending on available memory.  PixHawk requires at least 4 kilobytes.  Maximum value available here is 64 kilobytes." VALUE 0x36100000 Scalar_FLOAT32_IEEE 0 IDENTICAL -3.40282e+38 3.40282e+38 /end CHARACTERISTIC
/begin COMPU_METHOD CM_LOG_DISARMED "Enable logging while disarmed" TAB_VERB "%17.6" "" COMPU_TAB_REF TAB_LOG_DISARMED /end COMPU_METHOD
/begin COMPU_VTAB TAB_LOG_DISARMED "Enable logging while disarmed, If LOG_DISARMED is set to 1 then logging will be enabled while disarmed. This can make for very large logfiles but can help a lot when tracking down startup issues" TAB_VERB 2 0 "Disabled" 1 "Enabled" /end COMPU_VTAB
/begin CHARACTERISTIC LOG_DISARMED "Enable logging while disarmed, If LOG_DISARMED is set to 1 then logging will be enabled while disarmed. This can make for very large logfiles but can help a lot when tracking down startup issues" VALUE 0x36100000 Scalar_FLOAT32_IEEE 0 CM_LOG_DISARMED 0.0 1.0 /end CHARACTERISTIC
/begin COMPU_METHOD CM_LOG_REPLAY "Enable logging of information needed for Replay" TAB_VERB "%17.6" "" COMPU_TAB_REF TAB_LOG_REPLAY /end COMPU_METHOD
/begin COMPU_VTAB TAB_LOG_REPLAY "Enable logging of information needed for Replay, If LOG_REPLAY is set to 1 then the EKF2 state estimator will log detailed information needed for diagnosing problems with the Kalman filter. It is suggested that you also raise LOG_FILE_BUFSIZE to give more buffer space for logging and use a high quality microSD card to ensure no sensor data is lost" TAB_VERB 2 0 "Disabled" 1 "Enabled" /end COMPU_VTAB
/begin CHARACTERISTIC LOG_REPLAY "Enable logging of information needed for Replay, If LOG_REPLAY is set to 1 then the EKF2 state estimator will log detailed information needed for diagnosing problems with the Kalman filter. It is suggested that you also raise LOG_FILE_BUFSIZE to give more buffer space for logging and use a high quality microSD card to ensure no sensor data is lost" VALUE 0x36100000 Scalar_FLOAT32_IEEE 0 CM_LOG_REPLAY 0.0 1.0 /end CHARACTERISTIC
/begin COMPU_METHOD CM_BATT_MONITOR "Battery monitoring" TAB_VERB "%17.6" "" COMPU_TAB_REF TAB_BATT_MONITOR /end COMPU_METHOD
/begin COMPU_VTAB TAB_BATT_MONITOR "Battery monitoring, Controls enabling monitoring of the battery's voltage and current" TAB_VERB 5 0 "Disabled" 3 "Analog Voltage Only" 4 "Analog Voltage and Current" 5 "SMBus" 6 "Bebop" /end COMPU_VTAB
/begin CHARACTERISTIC BATT_MONITOR "Battery monitoring, Controls enabling monitoring of the battery's voltage and current" VALUE 0x36100000 Scalar_FLOAT32_IEEE 0 CM_BATT_MONITOR 0.0 6.0 /end CHARACTERISTIC
/begin COMPU_METHOD CM_BATT_VOLT_PIN "Battery Voltage sensing pin" TAB_VERB "%17.6" "" COMPU_TAB_REF TAB_BATT_VOLT_PIN /end COMPU_METHOD
/begin COMPU_VTAB TAB_BATT_VOLT_PIN "Battery Voltage sensing pin, Setting this to 0 ~ 13 will enable battery voltage sensing on pins A0 ~ A13. For the 3DR power brick on APM2.5 it should be set to 13. On the PX4 it should be set to 100. On the Pixhawk powered from the PM connector it should be set to 2." TAB_VERB 6 -1 "Disabled" 0 "A0" 1 "A1" 2 "Pixhawk" 13 "A13" 100 "PX4" /end COMPU_VTAB
/begin CHARACTERISTIC BATT_VOLT_PIN "Battery Voltage sensing pin, Setting this to 0 ~ 13 will enable battery voltage sensing on pins A0 ~ A13. For the 3DR power brick on APM2.5 it should be set to 13. On the PX4 it should be set to 100. On the Pixhawk powered from the PM connector it should be set to 2." VALUE 0x36100000 Scalar_FLOAT32_IEEE 0 CM_BATT_VOLT_PIN -1.0 100.0 /end CHARACTERISTIC
/begin COMPU_METHOD CM_BATT_CURR_PIN "Battery Current sensing pin" TAB_VERB "%17.6" "" COMPU_TAB_REF TAB_BATT_CURR_PIN /end COMPU_METHOD
/begin COMPU_VTAB TAB_BATT_CURR_PIN "Battery Current sensing pin, Setting this to 0 ~ 13 will enable battery current sensing on pins A0 ~ A13. For the 3DR power brick on APM2.5 it should be set to 12. On the PX4 it should be set to 101. On the Pixhawk powered from the PM connector it should be set to 3." TAB_VERB 6 -1 "Disabled" 1 "A1" 2 "A2" 3 "Pixhawk" 12 "A12" 101 "PX4" /end COMPU_VTAB
/begin CHARACTERISTIC BATT_CURR_PIN "Battery Current sensing pin, Setting this to 0 ~ 13 will enable battery current sensing on pins A0 ~ A13. For the 3DR power brick on APM2.5 it should be set to 12. On the PX4 it should be set to 101. On the Pixhawk powered from the PM connector it should be set to 3." VALUE 0x36100000 Scalar_FLOAT32_IEEE 0 CM_BATT_CURR_PIN -1.0 101.0 /end CHARACTERISTIC
/begin CHARACTERISTIC BATT_VOLT_MULT "Voltage Multiplier, Used to convert the voltage of the voltage sensing pin (BATT_VOLT_PIN) to the actual battery's voltage (pin_voltage * VOLT_MULT). For the 3DR Power brick on APM2 or Pixhawk, this should be set to 10.1. For the Pixhawk with the 3DR 4in1 ESC this should be 12.02. For the PX4 using the PX4IO power supply this should be set to 1." VALUE 0x36100000 Scalar_FLOAT32_IEEE 0 IDENTICAL -3.40282e+38 3.40282e+38 /end CHARACTERISTIC
/begin CHARACTERISTIC BATT_AMP_PERVOLT "Amps per volt, Number of amps that a 1V reading on the current sensor corresponds to. On the APM2 or Pixhawk using the 3DR Power brick this should be set to 17. For the Pixhawk with the 3DR 4in1 ESC this should be 17." VALUE 0x36100000 Scalar_FLOAT32_IEEE 0 AMPERE_PER_VOLT -3.40282e+38 3.40282e+38 /end CHARACTERISTIC
/begin CHARACTERISTIC BATT_AMP_OFFSET "AMP offset, Voltage offset at zero current on current sensor" VALUE 0x36100000 Scalar_FLOAT32_IEEE 0 VOLT -3.40282e+38 3.40282e+38 /end CHARACTERISTIC
/begin CHARACTERISTIC BATT_CAPACITY "Battery capacity, Capacity of the battery in mAh when full" VALUE 0x36100000 Scalar_FLOAT32_IEEE 0 MILLIAMPERE_HOUR -3.40282e+38 3.40282e+38 /end CHARACTERISTIC
/begin CHARACTERISTIC BATT_WATT_MAX "Maximum allowed power (Watts), If battery wattage (voltage * current) exceeds this value then the system will reduce max throttle (THR_MAX, TKOFF_THR_MAX and THR_MIN for reverse thrust) to satisfy this limit. This helps limit high current to low C rated batteries regardless of battery voltage. The max throttle will slowly grow back to THR_MAX (or TKOFF_THR_MAX ) and THR_MIN if demanding the current max and under the watt max. Use 0 to disable." VALUE 0x36100000 Scalar_FLOAT32_IEEE 0 WATT -3.40282e+38 3.40282e+38 /end CHARACTERISTIC
/begin COMPU_METHOD CM_BATT2_MONITOR "Battery monitoring" TAB_VERB "%17.6" "" COMPU_TAB_REF TAB_BATT2_MONITOR /end COMPU_METHOD
/begin COMPU_VTAB TAB_BATT2_MONITOR "Battery monitoring, Controls enabling monitoring of the battery's voltage and current" TAB_VERB 5 0 "Disabled" 3 "Analog Voltage Only" 4 "Analog Voltage and Current" 5 "SMBus" 6 "Bebop" /end COMPU_VTAB
/begin CHARACTERISTIC BATT2_MONITOR "Battery monitoring, Controls enabling monitoring of the battery's voltage and current" VALUE 0x36100000 Scalar_FLOAT32_IEEE 0 CM_BATT2_MONITOR 0.0 6.0 /end CHARACTERISTIC
/begin COMPU_METHOD CM_BATT2_VOLT_PIN "Battery Voltage sensing pin" TAB_VERB "%17.6" "" COMPU_TAB_REF TAB_BATT2_VOLT_PIN /end COMPU_METHOD
/begin COMPU_VTAB TAB_BATT2_VOLT_PIN "Battery Voltage sensing pin, Setting this to 0 ~ 13 will enable battery voltage sensing on pins A0 ~ A13. For the 3DR power brick on APM2.5 it should be set to 13. On the PX4 it should be set to 100. On the Pixhawk powered from the PM connector it should be set to 2." TAB_VERB 6 -1 "Disabled" 0 "A0" 1 "A1" 2 "Pixhawk" 13 "A13" 100 "PX4" /end COMPU_VTAB
/begin CHARACTERISTIC BATT2_VOLT_PIN "Battery Voltage sensing pin, Setting this to 0 ~ 13 will enable battery voltage sensing on pins A0 ~ A13. For the 3DR power brick on APM2.5 it should be set to 13. On the PX4 it should be set to 100. On the Pixhawk powered from the PM connector it should be set to 2." VALUE 0x36100000 Scalar_FLOAT32_IEEE 0 CM_BATT2_VOLT_PIN -1.0 100.0 /end CHARACTERISTIC
/begin COMPU_METHOD CM_BATT2_CURR_PIN "Battery Current sensing pin" TAB_VERB "%17.6" "" COMPU_TAB_REF TAB_BATT2_CURR_PIN /end COMPU_METHOD
/begin COMPU_VTAB TAB_BATT2_CURR_PIN "Battery Current sensing pin, Setting this to 0 ~ 13 will enable battery current sensing on pins A0 ~ A13. For the 3DR power brick on APM2.5 it should be set to 12. On the PX4 it should be set to 101. On the Pixhawk powered from the PM connector it should be set to 3." TAB_VERB 6 -1 "Disabled" 1 "A1" 2 "A2" 3 "Pixhawk" 12 "A12" 101 "PX4" /end COMPU_VTAB
/begin CHARACTERISTIC BATT2_CURR_PIN "Battery Current sensing pin, Setting this to 0 ~ 13 will enable battery current sensing on pins A0 ~ A13. For the 3DR power brick on APM2.5 it should be set to 12. On the PX4 it should be set to 101. On the Pixhawk powered from the PM connector it should be set to 3." VALUE 0x36100000 Scalar_FLOAT32_IEEE 0 CM_BATT2_CURR_PIN -1.0 101.0 /end CHARACTERISTIC
/begin CHARACTERISTIC BATT2_VOLT_MULT "Voltage Multiplier, Used to convert the voltage of the voltage sensing pin (BATT_VOLT_PIN) to the actual battery's voltage (pin_voltage * VOLT_MULT). For the 3DR Power brick on APM2 or Pixhawk, this should be set to 10.1. For the Pixhawk with the 3DR 4in1 ESC this should be 12.02. For the PX4 using the PX4IO power supply this should be set to 1." VALUE 0x36100000 Scalar_FLOAT32_IEEE 0 IDENTICAL -3.40282e+38 3.40282e+38 /end CHARACTERISTIC
/begin CHARACTERISTIC BATT2_AMP_PERVOL "Amps per volt, Number of amps that a 1V reading on the current sensor corresponds to. On the APM2 or Pixhawk using the 3DR Power brick this should be set to 17. For the Pixhawk with the 3DR 4in1 ESC this should be 17." VALUE 0x36100000 Scalar_FLOAT32_IEEE 0 AMPERE_PER_VOLT -3.40282e+38 3.40282e+38 /end CHARACTERISTIC
/begin CHARACTERISTIC BATT2_AMP_OFFSET "AMP offset, Voltage offset at zero current on current sensor" VALUE 0x36100000 Scalar_FLOAT32_IEEE 0 VOLT -3.40282e+38 3.40282e+38 /end CHARACTERISTIC
/begin CHARACTERISTIC BATT2_CAPACITY "Battery capacity, Capacity of the battery in mAh when full" VALUE 0x36100000 Scalar_FLOAT32_IEEE 0 MILLIAMPERE_HOUR -3.40282e+38 3.40282e+38 /end CHARACTERISTIC
/begin CHARACTERISTIC BATT2_WATT_MAX "Maximum allowed current, If battery wattage (voltage * current) exceeds this value then the system will reduce max throttle (THR_MAX, TKOFF_THR_MAX and THR_MIN for reverse thrust) to satisfy this limit. This helps limit high current to low C rated batteries regardless of battery voltage. The max throttle will slowly grow back to THR_MAX (or TKOFF_THR_MAX ) and THR_MIN if demanding the current max and under the watt max. Use 0 to disable." VALUE 0x36100000 Scalar_FLOAT32_IEEE 0 AMPERE -3.40282e+38 3.40282e+38 /end CHARACTERISTIC
/begin COMPU_METHOD CM_BRD_PWM_COUNT "Auxiliary pin config" TAB_VERB "%17.6" "" COMPU_TAB_REF TAB_BRD_PWM_COUNT /end COMPU_METHOD
/begin COMPU_VTAB TAB_BRD_PWM_COUNT "Auxiliary pin config, Control assigning of FMU pins to PWM output, timer capture and GPIO. All unassigned pins can be used for GPIO" TAB_VERB 5 0 "No PWMs" 2 "Two PWMs" 4 "Four PWMs" 6 "Six PWMs" 7 "Three PWMs and One Capture" /end COMPU_VTAB
/begin CHARACTERISTIC BRD_PWM_COUNT "Auxiliary pin config, Control assigning of FMU pins to PWM output, timer capture and GPIO. All unassigned pins can be used for GPIO" VALUE 0x36100000 Scalar_FLOAT32_IEEE 0 CM_BRD_PWM_COUNT 0.0 7.0 /end CHARACTERISTIC
/begin COMPU_METHOD CM_BRD_SER1_RTSCTS "Serial 1 flow control" TAB_VERB "%17.6" "" COMPU_TAB_REF TAB_BRD_SER1_RTSCTS /end COMPU_METHOD
/begin COMPU_VTAB TAB_BRD_SER1_RTSCTS "Serial 1 flow control, Enable flow control on serial 1 (telemetry 1) on Pixhawk. You must have the RTS and CTS pins connected to your radio. The standard DF13 6 pin connector for a 3DR radio does have those pins connected. If this is set to 2 then flow control will be auto-detected by checking for the output buffer filling on startup. Note that the PX4v1 does not have hardware flow control pins on this port, so you should leave this disabled." TAB_VERB 3 0 "Disabled" 1 "Enabled" 2 "Auto" /end COMPU_VTAB
/begin CHARACTERISTIC BRD_SER1_RTSCTS "Serial 1 flow control, Enable flow control on serial 1 (telemetry 1) on Pixhawk. You must have the RTS and CTS pins connected to your radio. The standard DF13 6 pin connector for a 3DR radio does have those pins connected. If this is set to 2 then flow control will be auto-detected by checking for the output buffer filling on startup. Note that the PX4v1 does not have hardware flow control pins on this port, so you should leave this disabled." VALUE 0x36100000 Scalar_FLOAT32_IEEE 0 CM_BRD_SER1_RTSCTS 0.0 2.0 /end CHARACTERISTIC
/begin COMPU_METHOD CM_BRD_SER2_RTSCTS "Serial 2 flow control" TAB_VERB "%17.6" "" COMPU_TAB_REF TAB_BRD_SER2_RTSCTS /end COMPU_METHOD
/begin COMPU_VTAB TAB_BRD_SER2_RTSCTS "Serial 2 flow control, Enable flow control on serial 2 (telemetry 2) on Pixhawk and PX4. You must have the RTS and CTS pins connected to your radio. The standard DF13 6 pin connector for a 3DR radio does have those pins connected. If this is set to 2 then flow control will be auto-detected by checking for the output buffer filling on startup." TAB_VERB 3 0 "Disabled" 1 "Enabled" 2 "Auto" /end COMPU_VTAB
/begin CHARACTERISTIC BRD_SER2_RTSCTS "Serial 2 flow control, Enable flow control on serial 2 (telemetry 2) on Pixhawk and PX4. You must have the RTS and CTS pins connected to your radio. The standard DF13 6 pin connector for a 3DR radio does have those pins connected. If this is set to 2 then flow control will be auto-detected by checking for the output buffer filling on startup." VALUE 0x36100000 Scalar_FLOAT32_IEEE 0 CM_BRD_SER2_RTSCTS 0.0 2.0 /end CHARACTERISTIC
/begin COMPU_METHOD CM_BRD_SAFETYENABLE "Enable use of safety arming switch" TAB_VERB "%17.6" "" COMPU_TAB_REF TAB_BRD_SAFETYENABLE /end COMPU_METHOD
/begin COMPU_VTAB TAB_BRD_SAFETYENABLE "Enable use of safety arming switch, This controls the default state of the safety switch at startup. When set to 1 the safety switch will start in the safe state (flashing) at boot. When set to zero the safety switch will start in the unsafe state (solid) at startup. Note that if a safety switch is fitted the user can still control the safety state after startup using the switch. The safety state can also be controlled in software using a MAVLink message." TAB_VERB 2 0 "Disabled" 1 "Enabled" /end COMPU_VTAB
/begin CHARACTERISTIC BRD_SAFETYENABLE "Enable use of safety arming switch, This controls the default state of the safety switch at startup. When set to 1 the safety switch will start in the safe state (flashing) at boot. When set to zero the safety switch will start in the unsafe state (solid) at startup. Note that if a safety switch is fitted the user can still control the safety state after startup using the switch. The safety state can also be controlled in software using a MAVLink message." VALUE 0x36100000 Scalar_FLOAT32_IEEE 0 CM_BRD_SAFETYENABLE 0.0 1.0 /end CHARACTERISTIC
/begin COMPU_METHOD CM_BRD_SBUS_OUT " SBUS output rate" TAB_VERB "%17.6" "" COMPU_TAB_REF TAB_BRD_SBUS_OUT /end COMPU_METHOD
/begin COMPU_VTAB TAB_BRD_SBUS_OUT " SBUS output rate, This sets the SBUS output frame rate in Hz" TAB_VERB 8 0 "Disabled" 1 "50Hz" 2 "75Hz" 3 "100Hz" 4 "150Hz" 5 "200Hz" 6 "250Hz" 7 "300Hz" /end COMPU_VTAB
/begin CHARACTERISTIC BRD_SBUS_OUT " SBUS output rate, This sets the SBUS output frame rate in Hz" VALUE 0x36100000 Scalar_FLOAT32_IEEE 0 CM_BRD_SBUS_OUT 0.0 7.0 /end CHARACTERISTIC
/begin CHARACTERISTIC BRD_SERIAL_NUM "User-defined serial number, User-defined serial number of this vehicle, it can be any arbitrary number you want and has no effect on the autopilot" VALUE 0x36100000 Scalar_FLOAT32_IEEE 0 IDENTICAL -32767.0 32768.0 /end CHARACTERISTIC
/begin COMPU_METHOD CM_BRD_CAN_ENABLE " Enable use of UAVCAN devices" TAB_VERB "%17.6" "" COMPU_TAB_REF TAB_BRD_CAN_ENABLE /end COMPU_METHOD
/begin COMPU_VTAB TAB_BRD_CAN_ENABLE " Enable use of UAVCAN devices, Enabling this option on a Pixhawk enables UAVCAN devices. Note that this uses about 25k of memory" TAB_VERB 2 0 "Disabled" 1 "Enabled" /end COMPU_VTAB
/begin CHARACTERISTIC BRD_CAN_ENABLE " Enable use of UAVCAN devices, Enabling this option on a Pixhawk enables UAVCAN devices. Note that this uses about 25k of memory" VALUE 0x36100000 Scalar_FLOAT32_IEEE 0 CM_BRD_CAN_ENABLE 0.0 1.0 /end CHARACTERISTIC
/begin COMPU_METHOD CM_BRD_SAFETY_MASK "Channels to which ignore the safety switch state" TAB_VERB "%17.6" "" COMPU_TAB_REF TAB_BRD_SAFETY_MASK /end COMPU_METHOD
/begin COMPU_VTAB TAB_BRD_SAFETY_MASK "Channels to which ignore the safety switch state, A bitmask which controls what channels can move while the safety switch has not been pressed" TAB_VERB 2 0 "Disabled" 1 "Enabled" /end COMPU_VTAB
/begin CHARACTERISTIC BRD_SAFETY_MASK "Channels to which ignore the safety switch state, A bitmask which controls what channels can move while the safety switch has not been pressed" VALUE 0x36100000 Scalar_FLOAT32_IEEE 0 CM_BRD_SAFETY_MASK 0.0 1.0 /end CHARACTERISTIC
/begin CHARACTERISTIC BRD_IMU_TARGTEMP "Target IMU temperature, This sets the target IMU temperature for boards with controllable IMU heating units. A value of -1 disables heating." VALUE 0x36100000 Scalar_FLOAT32_IEEE 0 DEGREES -1.0 80.0 /end CHARACTERISTIC
/begin COMPU_METHOD CM_BRD_TYPE "Board type" TAB_VERB "%17.6" "" COMPU_TAB_REF TAB_BRD_TYPE /end COMPU_METHOD
/begin COMPU_VTAB TAB_BRD_TYPE "Board type, This allows selection of a PX4 or VRBRAIN board type. If set to zero then the board type is auto-detected (PX4)" TAB_VERB 13 0 "AUTO" 1 "PX4V1" 2 "Pixhawk" 3 "Pixhawk2" 4 "Pixracer" 5 "PixhawkMini" 6 "Pixhawk2Slim" 7 "VRBrain 5.1" 8 "VRBrain 5.2" 9 "VR Micro Brain 5.1" 10 "VR Micro Brain 5.2" 11 "VRBrain Core 1.0" 12 "VRBrain 5.4" /end COMPU_VTAB
/begin CHARACTERISTIC BRD_TYPE "Board type, This allows selection of a PX4 or VRBRAIN board type. If set to zero then the board type is auto-detected (PX4)" VALUE 0x36100000 Scalar_FLOAT32_IEEE 0 CM_BRD_TYPE 0.0 12.0 /end CHARACTERISTIC
/begin COMPU_METHOD CM_SPRAY_ENABLE "Sprayer enable/disable" TAB_VERB "%17.6" "" COMPU_TAB_REF TAB_SPRAY_ENABLE /end COMPU_METHOD
/begin COMPU_VTAB TAB_SPRAY_ENABLE "Sprayer enable/disable, Allows you to enable (1) or disable (0) the sprayer" TAB_VERB 2 0 "Disabled" 1 "Enabled" /end COMPU_VTAB
/begin CHARACTERISTIC SPRAY_ENABLE "Sprayer enable/disable, Allows you to enable (1) or disable (0) the sprayer" VALUE 0x36100000 Scalar_FLOAT32_IEEE 0 CM_SPRAY_ENABLE 0.0 1.0 /end CHARACTERISTIC
/begin CHARACTERISTIC SPRAY_PUMP_RATE "Pump speed, Desired pump speed when travelling 1m/s expressed as a percentage" VALUE 0x36100000 Scalar_FLOAT32_IEEE 0 PERCENT 0.0 100.0 /end CHARACTERISTIC
/begin CHARACTERISTIC SPRAY_SPINNER "Spinner rotation speed, Spinner's rotation speed in PWM (a higher rate will disperse the spray over a wider area horizontally)" VALUE 0x36100000 Scalar_FLOAT32_IEEE 0 MILLISECONDS 1000.0 2000.0 /end CHARACTERISTIC
/begin CHARACTERISTIC SPRAY_SPEED_MIN "Speed minimum, Speed minimum at which we will begin spraying" VALUE 0x36100000 Scalar_FLOAT32_IEEE 0 CENTIMETERS_PER_SECOND 0.0 1000.0 /end CHARACTERISTIC
/begin CHARACTERISTIC SPRAY_PUMP_MIN "Pump speed minimum, Minimum pump speed expressed as a percentage" VALUE 0x36100000 Scalar_FLOAT32_IEEE 0 PERCENT 0.0 100.0 /end CHARACTERISTIC
/begin MEASUREMENT GND_ABS_PRESS "Absolute Pressure, calibrated ground pressure in Pascals" FLOAT32_IEEE PASCAL 0 0 -3.40282e+38 3.40282e+38 ECU_ADDRESS 0x36100000 /end MEASUREMENT
/begin MEASUREMENT GND_TEMP "ground temperature, calibrated ground temperature in degrees Celsius" FLOAT32_IEEE DEGREESCELSIUS 0 0 -3.40282e+38 3.40282e+38 ECU_ADDRESS 0x36100000 /end MEASUREMENT
/begin CHARACTERISTIC GND_ALT_OFFSET "altitude offset, altitude offset in meters added to barometric altitude. This is used to allow for automatic adjustment of the base barometric altitude by a ground station equipped with a barometer. The value is added to the barometric altitude read by the aircraft. It is automatically reset to 0 when the barometer is calibrated on each reboot or when a preflight calibration is performed." VALUE 0x36100000 Scalar_FLOAT32_IEEE 0 METERS -3.40282e+38 3.40282e+38 /end CHARACTERISTIC
/begin COMPU_METHOD CM_GND_PRIMARY "Primary barometer" TAB_VERB "%17.6" "" COMPU_TAB_REF TAB_GND_PRIMARY /end COMPU_METHOD
/begin COMPU_VTAB TAB_GND_PRIMARY "Primary barometer, This selects which barometer will be the primary if multiple barometers are found" TAB_VERB 3 0 "FirstBaro" 1 "2ndBaro" 2 "3rdBaro" /end COMPU_VTAB
/begin CHARACTERISTIC GND_PRIMARY "Primary barometer, This selects which barometer will be the primary if multiple barometers are found" VALUE 0x36100000 Scalar_FLOAT32_IEEE 0 CM_GND_PRIMARY 0.0 2.0 /end CHARACTERISTIC
/begin COMPU_METHOD CM_GPS_TYPE "GPS type" TAB_VERB "%17.6" "" COMPU_TAB_REF TAB_GPS_TYPE /end COMPU_METHOD
/begin COMPU_VTAB TAB_GPS_TYPE "GPS type, GPS type" TAB_VERB 12 0 "None" 1 "AUTO" 2 "uBlox" 3 "MTK" 4 "MTK19" 5 "NMEA" 6 "SiRF" 7 "HIL" 8 "SwiftNav" 9 "PX4-UAVCAN" 10 "SBF" 11 "GSOF" /end COMPU_VTAB
/begin CHARACTERISTIC GPS_TYPE "GPS type, GPS type" VALUE 0x36100000 Scalar_FLOAT32_IEEE 0 CM_GPS_TYPE 0.0 11.0 /end CHARACTERISTIC
/begin COMPU_METHOD CM_GPS_TYPE2 "2nd GPS type" TAB_VERB "%17.6" "" COMPU_TAB_REF TAB_GPS_TYPE2 /end COMPU_METHOD
/begin COMPU_VTAB TAB_GPS_TYPE2 "2nd GPS type, GPS type of 2nd GPS" TAB_VERB 12 0 "None" 1 "AUTO" 2 "uBlox" 3 "MTK" 4 "MTK19" 5 "NMEA" 6 "SiRF" 7 "HIL" 8 "SwiftNav" 9 "PX4-UAVCAN" 10 "SBF" 11 "GSOF" /end COMPU_VTAB
/begin CHARACTERISTIC GPS_TYPE2 "2nd GPS type, GPS type of 2nd GPS" VALUE 0x36100000 Scalar_FLOAT32_IEEE 0 CM_GPS_TYPE2 0.0 11.0 /end CHARACTERISTIC
/begin COMPU_METHOD CM_GPS_NAVFILTER "Navigation filter setting" TAB_VERB "%17.6" "" COMPU_TAB_REF TAB_GPS_NAVFILTER /end COMPU_METHOD
/begin COMPU_VTAB TAB_GPS_NAVFILTER "Navigation filter setting, Navigation filter engine setting" TAB_VERB 8 0 "Portable" 2 "Stationary" 3 "Pedestrian" 4 "Automotive" 5 "Sea" 6 "Airborne1G" 7 "Airborne2G" 8 "Airborne4G" /end COMPU_VTAB
/begin CHARACTERISTIC GPS_NAVFILTER "Navigation filter setting, Navigation filter engine setting" VALUE 0x36100000 Scalar_FLOAT32_IEEE 0 CM_GPS_NAVFILTER 0.0 8.0 /end CHARACTERISTIC
/begin COMPU_METHOD CM_GPS_AUTO_SWITCH "Automatic Switchover Setting" TAB_VERB "%17.6" "" COMPU_TAB_REF TAB_GPS_AUTO_SWITCH /end COMPU_METHOD
/begin COMPU_VTAB TAB_GPS_AUTO_SWITCH "Automatic Switchover Setting, Automatic switchover to GPS reporting best lock" TAB_VERB 2 0 "Disabled" 1 "Enabled" /end COMPU_VTAB
/begin CHARACTERISTIC GPS_AUTO_SWITCH "Automatic Switchover Setting, Automatic switchover to GPS reporting best lock" VALUE 0x36100000 Scalar_FLOAT32_IEEE 0 CM_GPS_AUTO_SWITCH 0.0 1.0 /end CHARACTERISTIC
/begin COMPU_METHOD CM_GPS_MIN_DGPS "Minimum Lock Type Accepted for DGPS" TAB_VERB "%17.6" "" COMPU_TAB_REF TAB_GPS_MIN_DGPS /end COMPU_METHOD
/begin COMPU_VTAB TAB_GPS_MIN_DGPS "Minimum Lock Type Accepted for DGPS, Sets the minimum type of differential GPS corrections required before allowing to switch into DGPS mode." TAB_VERB 3 0 "Any" 50 "FloatRTK" 100 "IntegerRTK" /end COMPU_VTAB
/begin CHARACTERISTIC GPS_MIN_DGPS "Minimum Lock Type Accepted for DGPS, Sets the minimum type of differential GPS corrections required before allowing to switch into DGPS mode." VALUE 0x36100000 Scalar_FLOAT32_IEEE 0 CM_GPS_MIN_DGPS 0.0 100.0 /end CHARACTERISTIC
/begin COMPU_METHOD CM_GPS_SBAS_MODE "SBAS Mode" TAB_VERB "%17.6" "" COMPU_TAB_REF TAB_GPS_SBAS_MODE /end COMPU_METHOD
/begin COMPU_VTAB TAB_GPS_SBAS_MODE "SBAS Mode, This sets the SBAS (satellite based augmentation system) mode if available on this GPS. If set to 2 then the SBAS mode is not changed in the GPS. Otherwise the GPS will be reconfigured to enable/disable SBAS. Disabling SBAS may be worthwhile in some parts of the world where an SBAS signal is available but the baseline is too long to be useful." TAB_VERB 3 0 "Disabled" 1 "Enabled" 2 "NoChange" /end COMPU_VTAB
/begin CHARACTERISTIC GPS_SBAS_MODE "SBAS Mode, This sets the SBAS (satellite based augmentation system) mode if available on this GPS. If set to 2 then the SBAS mode is not changed in the GPS. Otherwise the GPS will be reconfigured to enable/disable SBAS. Disabling SBAS may be worthwhile in some parts of the world where an SBAS signal is available but the baseline is too long to be useful." VALUE 0x36100000 Scalar_FLOAT32_IEEE 0 CM_GPS_SBAS_MODE 0.0 2.0 /end CHARACTERISTIC
/begin CHARACTERISTIC GPS_MIN_ELEV "Minimum elevation, This sets the minimum elevation of satellites above the horizon for them to be used for navigation. Setting this to -100 leaves the minimum elevation set to the GPS modules default." VALUE 0x36100000 Scalar_FLOAT32_IEEE 0 DEGREES -100.0 90.0 /end CHARACTERISTIC
/begin COMPU_METHOD CM_GPS_INJECT_TO "Destination for GPS_INJECT_DATA MAVLink packets" TAB_VERB "%17.6" "" COMPU_TAB_REF TAB_GPS_INJECT_TO /end COMPU_METHOD
/begin COMPU_VTAB TAB_GPS_INJECT_TO "Destination for GPS_INJECT_DATA MAVLink packets, The GGS can send raw serial packets to inject data to multiple GPSes." TAB_VERB 3 0 "send to first GPS" 1 "send to 2nd GPS" 127 "send to all" /end COMPU_VTAB
/begin CHARACTERISTIC GPS_INJECT_TO "Destination for GPS_INJECT_DATA MAVLink packets, The GGS can send raw serial packets to inject data to multiple GPSes." VALUE 0x36100000 Scalar_FLOAT32_IEEE 0 CM_GPS_INJECT_TO 0.0 127.0 /end CHARACTERISTIC
/begin COMPU_METHOD CM_GPS_SBP_LOGMASK "Swift Binary Protocol Logging Mask" TAB_VERB "%17.6" "" COMPU_TAB_REF TAB_GPS_SBP_LOGMASK /end COMPU_METHOD
/begin COMPU_VTAB TAB_GPS_SBP_LOGMASK "Swift Binary Protocol Logging Mask, Masked with the SBP msg_type field to determine whether SBR1/SBR2 data is logged" TAB_VERB 3 0x0000 "None" 0xFFFF "All" 0xFF00 "External only" /end COMPU_VTAB
/begin CHARACTERISTIC GPS_SBP_LOGMASK "Swift Binary Protocol Logging Mask, Masked with the SBP msg_type field to determine whether SBR1/SBR2 data is logged" VALUE 0x36100000 Scalar_FLOAT32_IEEE 0 CM_GPS_SBP_LOGMASK 0 65535 /end CHARACTERISTIC
/begin COMPU_METHOD CM_GPS_RAW_DATA "Raw data logging" TAB_VERB "%17.6" "" COMPU_TAB_REF TAB_GPS_RAW_DATA /end COMPU_METHOD
/begin COMPU_VTAB TAB_GPS_RAW_DATA "Raw data logging, Enable logging of RXM raw data from uBlox which includes carrier phase and pseudo range information. This allows for post processing of dataflash logs for more precise positioning. Note that this requires a raw capable uBlox such as the 6P or 6T." TAB_VERB 3 0 "Disabled" 1 "log every sample" 5 "log every 5 samples" /end COMPU_VTAB
/begin CHARACTERISTIC GPS_RAW_DATA "Raw data logging, Enable logging of RXM raw data from uBlox which includes carrier phase and pseudo range information. This allows for post processing of dataflash logs for more precise positioning. Note that this requires a raw capable uBlox such as the 6P or 6T." VALUE 0x36100000 Scalar_FLOAT32_IEEE 0 CM_GPS_RAW_DATA 0.0 5.0 /end CHARACTERISTIC
/begin COMPU_METHOD CM_GPS_GNSS_MODE "GNSS system configuration" TAB_VERB "%17.6" "" COMPU_TAB_REF TAB_GPS_GNSS_MODE /end COMPU_METHOD
/begin COMPU_VTAB TAB_GPS_GNSS_MODE "GNSS system configuration, Bitmask for what GNSS system to use on the first GPS (all unchecked or zero to leave GPS as configured)" TAB_VERB 10 0 "Leave as currently configured" 1 "GPS-NoSBAS" 3 "GPS+SBAS" 4 "Galileo-NoSBAS" 6 "Galileo+SBAS" 8 "Beidou" 51 "GPS+IMES+QZSS+SBAS (Japan Only)" 64 "GLONASS" 66 "GLONASS+SBAS" 67 "GPS+GLONASS+SBAS" /end COMPU_VTAB
/begin CHARACTERISTIC GPS_GNSS_MODE "GNSS system configuration, Bitmask for what GNSS system to use on the first GPS (all unchecked or zero to leave GPS as configured)" VALUE 0x36100000 Scalar_FLOAT32_IEEE 0 CM_GPS_GNSS_MODE 0.0 67.0 /end CHARACTERISTIC
/begin COMPU_METHOD CM_GPS_SAVE_CFG "Save GPS configuration" TAB_VERB "%17.6" "" COMPU_TAB_REF TAB_GPS_SAVE_CFG /end COMPU_METHOD
/begin COMPU_VTAB TAB_GPS_SAVE_CFG "Save GPS configuration, Determines whether the configuration for this GPS should be written to non-volatile memory on the GPS. Currently working for UBlox 6 series and above." TAB_VERB 3 0 "Do not save config" 1 "Save config" 2 "Save only when needed" /end COMPU_VTAB
/begin CHARACTERISTIC GPS_SAVE_CFG "Save GPS configuration, Determines whether the configuration for this GPS should be written to non-volatile memory on the GPS. Currently working for UBlox 6 series and above." VALUE 0x36100000 Scalar_FLOAT32_IEEE 0 CM_GPS_SAVE_CFG 0.0 2.0 /end CHARACTERISTIC
/begin COMPU_METHOD CM_GPS_GNSS_MODE2 "GNSS system configuration" TAB_VERB "%17.6" "" COMPU_TAB_REF TAB_GPS_GNSS_MODE2 /end COMPU_METHOD
/begin COMPU_VTAB TAB_GPS_GNSS_MODE2 "GNSS system configuration, Bitmask for what GNSS system to use on the second GPS (all unchecked or zero to leave GPS as configured)" TAB_VERB 10 0 "Leave as currently configured" 1 "GPS-NoSBAS" 3 "GPS+SBAS" 4 "Galileo-NoSBAS" 6 "Galileo+SBAS" 8 "Beidou" 51 "GPS+IMES+QZSS+SBAS (Japan Only)" 64 "GLONASS" 66 "GLONASS+SBAS" 67 "GPS+GLONASS+SBAS" /end COMPU_VTAB
/begin CHARACTERISTIC GPS_GNSS_MODE2 "GNSS system configuration, Bitmask for what GNSS system to use on the second GPS (all unchecked or zero to leave GPS as configured)" VALUE 0x36100000 Scalar_FLOAT32_IEEE 0 CM_GPS_GNSS_MODE2 0.0 67.0 /end CHARACTERISTIC
/begin COMPU_METHOD CM_GPS_AUTO_CONFIG "Automatic GPS configuration" TAB_VERB "%17.6" "" COMPU_TAB_REF TAB_GPS_AUTO_CONFIG /end COMPU_METHOD
/begin COMPU_VTAB TAB_GPS_AUTO_CONFIG "Automatic GPS configuration, Controls if the autopilot should automatically configure the GPS based on the parameters and default settings" TAB_VERB 2 0 "Disables automatic configuration" 1 "Enable automatic configuration" /end COMPU_VTAB
/begin CHARACTERISTIC GPS_AUTO_CONFIG "Automatic GPS configuration, Controls if the autopilot should automatically configure the GPS based on the parameters and default settings" VALUE 0x36100000 Scalar_FLOAT32_IEEE 0 CM_GPS_AUTO_CONFIG 0.0 1.0 /end CHARACTERISTIC
/begin COMPU_METHOD CM_SCHED_DEBUG "Scheduler debug level" TAB_VERB "%17.6" "" COMPU_TAB_REF TAB_SCHED_DEBUG /end COMPU_METHOD
/begin COMPU_VTAB TAB_SCHED_DEBUG "Scheduler debug level, Set to non-zero to enable scheduler debug messages. When set to show " Slips " the scheduler will display a message whenever a scheduled task is delayed due to too much CPU load. When set to ShowOverruns the scheduled will display a message whenever a task takes longer than the limit promised in the task table." TAB_VERB 3 0 "Disabled" 2 "ShowSlips" 3 "ShowOverruns" /end COMPU_VTAB
/begin CHARACTERISTIC SCHED_DEBUG "Scheduler debug level, Set to non-zero to enable scheduler debug messages. When set to show " Slips " the scheduler will display a message whenever a scheduled task is delayed due to too much CPU load. When set to ShowOverruns the scheduled will display a message whenever a task takes longer than the limit promised in the task table." VALUE 0x36100000 Scalar_FLOAT32_IEEE 0 CM_SCHED_DEBUG 0.0 3.0 /end CHARACTERISTIC
/begin COMPU_METHOD CM_SCHED_LOOP_RATE "Scheduling main loop rate" TAB_VERB "%17.6" "" COMPU_TAB_REF TAB_SCHED_LOOP_RATE /end COMPU_METHOD
/begin COMPU_VTAB TAB_SCHED_LOOP_RATE "Scheduling main loop rate, This controls the rate of the main control loop in Hz. This should only be changed by developers. This only takes effect on restart" TAB_VERB 6 50 "50Hz" 100 "100Hz" 200 "200Hz" 250 "250Hz" 300 "300Hz" 400 "400Hz" /end COMPU_VTAB
/begin CHARACTERISTIC SCHED_LOOP_RATE "Scheduling main loop rate, This controls the rate of the main control loop in Hz. This should only be changed by developers. This only takes effect on restart" VALUE 0x36100000 Scalar_FLOAT32_IEEE 0 CM_SCHED_LOOP_RATE 50.0 400.0 /end CHARACTERISTIC
/begin COMPU_METHOD CM_FENCE_ENABLE "Fence enable/disable" TAB_VERB "%17.6" "" COMPU_TAB_REF TAB_FENCE_ENABLE /end COMPU_METHOD
/begin COMPU_VTAB TAB_FENCE_ENABLE "Fence enable/disable, Allows you to enable (1) or disable (0) the fence functionality" TAB_VERB 2 0 "Disabled" 1 "Enabled" /end COMPU_VTAB
/begin CHARACTERISTIC FENCE_ENABLE "Fence enable/disable, Allows you to enable (1) or disable (0) the fence functionality" VALUE 0x36100000 Scalar_FLOAT32_IEEE 0 CM_FENCE_ENABLE 0.0 1.0 /end CHARACTERISTIC
/begin COMPU_METHOD CM_FENCE_TYPE "Fence Type" TAB_VERB "%17.6" "" COMPU_TAB_REF TAB_FENCE_TYPE /end COMPU_METHOD
/begin COMPU_VTAB TAB_FENCE_TYPE "Fence Type, Enabled fence types held as bitmask" TAB_VERB 8 0 "None" 1 "Altitude" 2 "Circle" 3 "Altitude and Circle" 4 "Polygon" 5 "Altitude and Polygon" 6 "Circle and Polygon" 7 "All" /end COMPU_VTAB
/begin CHARACTERISTIC FENCE_TYPE "Fence Type, Enabled fence types held as bitmask" VALUE 0x36100000 Scalar_FLOAT32_IEEE 0 CM_FENCE_TYPE 0.0 7.0 /end CHARACTERISTIC
/begin COMPU_METHOD CM_FENCE_ACTION "Fence Action" TAB_VERB "%17.6" "" COMPU_TAB_REF TAB_FENCE_ACTION /end COMPU_METHOD
/begin COMPU_VTAB TAB_FENCE_ACTION "Fence Action, What action should be taken when fence is breached" TAB_VERB 2 0 "Report Only" 1 "RTL or Land" /end COMPU_VTAB
/begin CHARACTERISTIC FENCE_ACTION "Fence Action, What action should be taken when fence is breached" VALUE 0x36100000 Scalar_FLOAT32_IEEE 0 CM_FENCE_ACTION 0.0 1.0 /end CHARACTERISTIC
/begin CHARACTERISTIC FENCE_ALT_MAX "Fence Maximum Altitude, Maximum altitude allowed before geofence triggers" VALUE 0x36100000 Scalar_FLOAT32_IEEE 0 METERS 10.0 1000.0 /end CHARACTERISTIC
/begin CHARACTERISTIC FENCE_RADIUS "Circular Fence Radius, Circle fence radius which when breached will cause an RTL" VALUE 0x36100000 Scalar_FLOAT32_IEEE 0 METERS 30.0 10000.0 /end CHARACTERISTIC
/begin CHARACTERISTIC FENCE_MARGIN "Fence Margin, Distance that autopilot's should maintain from the fence to avoid a breach" VALUE 0x36100000 Scalar_FLOAT32_IEEE 0 METERS 1.0 10.0 /end CHARACTERISTIC
/begin CHARACTERISTIC FENCE_TOTAL "Fence polygon point total, Number of polygon points saved in eeprom (do not update manually)" VALUE 0x36100000 Scalar_FLOAT32_IEEE 0 IDENTICAL 1.0 20.0 /end CHARACTERISTIC
/begin COMPU_METHOD CM_AVOID_ENABLE "Avoidance control enable/disable" TAB_VERB "%17.6" "" COMPU_TAB_REF TAB_AVOID_ENABLE /end COMPU_METHOD
/begin COMPU_VTAB TAB_AVOID_ENABLE "Avoidance control enable/disable, Enabled/disable stopping at fence" TAB_VERB 2 0 "None" 1 "StopAtFence" /end COMPU_VTAB
/begin CHARACTERISTIC AVOID_ENABLE "Avoidance control enable/disable, Enabled/disable stopping at fence" VALUE 0x36100000 Scalar_FLOAT32_IEEE 0 CM_AVOID_ENABLE 0.0 1.0 /end CHARACTERISTIC
/begin CHARACTERISTIC RALLY_TOTAL "Rally Total, Number of rally points currently loaded" VALUE 0x36100000 Scalar_FLOAT32_IEEE 0 IDENTICAL -3.40282e+38 3.40282e+38 /end CHARACTERISTIC
/begin CHARACTERISTIC RALLY_LIMIT_KM "Rally Limit, Maximum distance to rally point. If the closest rally point is more than this number of kilometers from the current position and the home location is closer than any of the rally points from the current position then do RTL to home rather than to the closest rally point. This prevents a leftover rally point from a different airfield being used accidentally. If this is set to 0 then the closest rally point is always used." VALUE 0x36100000 Scalar_FLOAT32_IEEE 0 KILOMETERS -3.40282e+38 3.40282e+38 /end CHARACTERISTIC
/begin COMPU_METHOD CM_RALLY_INCL_HOME "Rally Include Home" TAB_VERB "%17.6" "" COMPU_TAB_REF TAB_RALLY_INCL_HOME /end COMPU_METHOD
/begin COMPU_VTAB TAB_RALLY_INCL_HOME "Rally Include Home, Controls if Home is included as a Rally point (i.e. as a safe landing place) for RTL" TAB_VERB 2 0 "DoNotIncludeHome" 1 "IncludeHome" /end COMPU_VTAB
/begin CHARACTERISTIC RALLY_INCL_HOME "Rally Include Home, Controls if Home is included as a Rally point (i.e. as a safe landing place) for RTL" VALUE 0x36100000 Scalar_FLOAT32_IEEE 0 CM_RALLY_INCL_HOME 0.0 1.0 /end CHARACTERISTIC
/begin CHARACTERISTIC H_SV1_POS "Servo 1 Position, Angular location of swash servo #1" VALUE 0x36100000 Scalar_FLOAT32_IEEE 0 DEGREES -180.0 180.0 /end CHARACTERISTIC
/begin CHARACTERISTIC H_SV2_POS "Servo 2 Position, Angular location of swash servo #2" VALUE 0x36100000 Scalar_FLOAT32_IEEE 0 DEGREES -180.0 180.0 /end CHARACTERISTIC
/begin CHARACTERISTIC H_SV3_POS "Servo 3 Position, Angular location of swash servo #3" VALUE 0x36100000 Scalar_FLOAT32_IEEE 0 DEGREES -180.0 180.0 /end CHARACTERISTIC
/begin COMPU_METHOD CM_H_TAIL_TYPE "Tail Type" TAB_VERB "%17.6" "" COMPU_TAB_REF TAB_H_TAIL_TYPE /end COMPU_METHOD
/begin COMPU_VTAB TAB_H_TAIL_TYPE "Tail Type, Tail type selection.  Simpler yaw controller used if external gyro is selected" TAB_VERB 4 0 "Servo only" 1 "Servo with ExtGyro" 2 "DirectDrive VarPitch" 3 "DirectDrive FixedPitch" /end COMPU_VTAB
/begin CHARACTERISTIC H_TAIL_TYPE "Tail Type, Tail type selection.  Simpler yaw controller used if external gyro is selected" VALUE 0x36100000 Scalar_FLOAT32_IEEE 0 CM_H_TAIL_TYPE 0.0 3.0 /end CHARACTERISTIC
/begin COMPU_METHOD CM_H_SWASH_TYPE "Swash Type" TAB_VERB "%17.6" "" COMPU_TAB_REF TAB_H_SWASH_TYPE /end COMPU_METHOD
/begin COMPU_VTAB TAB_H_SWASH_TYPE "Swash Type, Swash Type Setting - either 3-servo CCPM or H1 Mechanical Mixing" TAB_VERB 2 0 "3-Servo CCPM" 1 "H1 Mechanical Mixing" /end COMPU_VTAB
/begin CHARACTERISTIC H_SWASH_TYPE "Swash Type, Swash Type Setting - either 3-servo CCPM or H1 Mechanical Mixing" VALUE 0x36100000 Scalar_FLOAT32_IEEE 0 CM_H_SWASH_TYPE 0.0 1.0 /end CHARACTERISTIC
/begin CHARACTERISTIC H_GYR_GAIN "External Gyro Gain, PWM sent to external gyro on ch7 when tail type is Servo w/ ExtGyro" VALUE 0x36100000 Scalar_FLOAT32_IEEE 0 MICROSECONDS 0.0 1000.0 /end CHARACTERISTIC
/begin CHARACTERISTIC H_PHANG "Swashplate Phase Angle Compensation, Phase angle correction for rotor head.  If pitching the swash forward induces a roll, this can be correct the problem" VALUE 0x36100000 Scalar_FLOAT32_IEEE 0 DEGREES -90.0 90.0 /end CHARACTERISTIC
/begin CHARACTERISTIC H_COLYAW "Collective-Yaw Mixing, Feed-forward compensation to automatically add rudder input when collective pitch is increased. Can be positive or negative depending on mechanics." VALUE 0x36100000 Scalar_FLOAT32_IEEE 0 IDENTICAL -10.0 10.0 /end CHARACTERISTIC
/begin COMPU_METHOD CM_H_FLYBAR_MODE "Flybar Mode Selector" TAB_VERB "%17.6" "" COMPU_TAB_REF TAB_H_FLYBAR_MODE /end COMPU_METHOD
/begin COMPU_VTAB TAB_H_FLYBAR_MODE "Flybar Mode Selector, Flybar present or not.  Affects attitude controller used during ACRO flight mode" TAB_VERB 2 0 "NoFlybar" 1 "Flybar" /end COMPU_VTAB
/begin CHARACTERISTIC H_FLYBAR_MODE "Flybar Mode Selector, Flybar present or not.  Affects attitude controller used during ACRO flight mode" VALUE 0x36100000 Scalar_FLOAT32_IEEE 0 CM_H_FLYBAR_MODE 0.0 1.0 /end CHARACTERISTIC
/begin CHARACTERISTIC H_TAIL_SPEED "Direct Drive VarPitch Tail ESC speed, Direct Drive VarPitch Tail ESC speed.  Only used when TailType is DirectDrive VarPitch" VALUE 0x36100000 Scalar_FLOAT32_IEEE 0 MICROSECONDS 0.0 1000.0 /end CHARACTERISTIC
/begin CHARACTERISTIC H_GYR_GAIN_ACRO "External Gyro Gain for ACRO, PWM sent to external gyro on ch7 when tail type is Servo w/ ExtGyro. A value of zero means to use H_GYR_GAIN" VALUE 0x36100000 Scalar_FLOAT32_IEEE 0 MICROSECONDS 0.0 1000.0 /end CHARACTERISTIC
/begin CHARACTERISTIC H_RSC_PWM_MIN "RSC PWM output miniumum, This sets the PWM output on RSC channel for maximum rotor speed" VALUE 0x36100000 Scalar_FLOAT32_IEEE 0 IDENTICAL 0.0 2000.0 /end CHARACTERISTIC
/begin CHARACTERISTIC H_RSC_PWM_MAX "RSC PWM output maxiumum, This sets the PWM output on RSC channel for miniumum rotor speed" VALUE 0x36100000 Scalar_FLOAT32_IEEE 0 IDENTICAL 0.0 2000.0 /end CHARACTERISTIC
/begin COMPU_METHOD CM_H_RSC_PWM_REV "RSC PWM reversal" TAB_VERB "%17.6" "" COMPU_TAB_REF TAB_H_RSC_PWM_REV /end COMPU_METHOD
/begin COMPU_VTAB TAB_H_RSC_PWM_REV "RSC PWM reversal, This controls reversal of the RSC channel output" TAB_VERB 2 -1 "Reversed" 1 "Normal" /end COMPU_VTAB
/begin CHARACTERISTIC H_RSC_PWM_REV "RSC PWM reversal, This controls reversal of the RSC channel output" VALUE 0x36100000 Scalar_FLOAT32_IEEE 0 CM_H_RSC_PWM_REV -1.0 1.0 /end CHARACTERISTIC
/begin CHARACTERISTIC MOT_YAW_HEADROOM "Matrix Yaw Min, Yaw control is given at least this pwm range" VALUE 0x36100000 Scalar_FLOAT32_IEEE 0 MICROSECONDS 0.0 500.0 /end CHARACTERISTIC
/begin CHARACTERISTIC MOT_THST_EXPO "Thrust Curve Expo, Motor thrust curve exponent (from 0 for linear to 1.0 for second order curve)" VALUE 0x36100000 Scalar_FLOAT32_IEEE 0 IDENTICAL 0.25 0.8 /end CHARACTERISTIC
/begin COMPU_METHOD CM_MOT_SPIN_MAX "Motor Spin maximum" TAB_VERB "%17.6" "" COMPU_TAB_REF TAB_MOT_SPIN_MAX /end COMPU_METHOD
/begin COMPU_VTAB TAB_MOT_SPIN_MAX "Motor Spin maximum, Point at which the thrust saturates expressed as a number from 0 to 1 in the entire output range" TAB_VERB 3 0.95 "Default" 1.0 "High" 0.9 "Low" /end COMPU_VTAB
/begin CHARACTERISTIC MOT_SPIN_MAX "Motor Spin maximum, Point at which the thrust saturates expressed as a number from 0 to 1 in the entire output range" VALUE 0x36100000 Scalar_FLOAT32_IEEE 0 CM_MOT_SPIN_MAX 0.9 1.0 /end CHARACTERISTIC
/begin CHARACTERISTIC MOT_BAT_VOLT_MAX "Battery voltage compensation maximum voltage, Battery voltage compensation maximum voltage (voltage above this will have no additional scaling effect on thrust).  Recommend 4.4 * cell count, 0 = Disabled" VALUE 0x36100000 Scalar_FLOAT32_IEEE 0 VOLT 6.0 35.0 /end CHARACTERISTIC
/begin CHARACTERISTIC MOT_BAT_VOLT_MIN "Battery voltage compensation minimum voltage, Battery voltage compensation minimum voltage (voltage below this will have no additional scaling effect on thrust).  Recommend 3.5 * cell count, 0 = Disabled" VALUE 0x36100000 Scalar_FLOAT32_IEEE 0 VOLT 6.0 35.0 /end CHARACTERISTIC
/begin CHARACTERISTIC MOT_BAT_CURR_MAX "Motor Current Max, Maximum current over which maximum throttle is limited (0 = Disabled)" VALUE 0x36100000 Scalar_FLOAT32_IEEE 0 AMPERE 0.0 200.0 /end CHARACTERISTIC
/begin COMPU_METHOD CM_MOT_PWM_TYPE "Output PWM type" TAB_VERB "%17.6" "" COMPU_TAB_REF TAB_MOT_PWM_TYPE /end COMPU_METHOD
/begin COMPU_VTAB TAB_MOT_PWM_TYPE "Output PWM type, This selects the output PWM type, allowing for normal PWM continuous output or OneShot125" TAB_VERB 3 0 "Normal" 1 "OneShot" 2 "OneShot125" /end COMPU_VTAB
/begin CHARACTERISTIC MOT_PWM_TYPE "Output PWM type, This selects the output PWM type, allowing for normal PWM continuous output or OneShot125" VALUE 0x36100000 Scalar_FLOAT32_IEEE 0 CM_MOT_PWM_TYPE 0.0 2.0 /end CHARACTERISTIC
/begin CHARACTERISTIC MOT_PWM_MIN "PWM output miniumum, This sets the min PWM output value that will ever be output to the motors, 0 = use input RC3_MIN" VALUE 0x36100000 Scalar_FLOAT32_IEEE 0 IDENTICAL 0.0 2000.0 /end CHARACTERISTIC
/begin CHARACTERISTIC MOT_PWM_MAX "PWM output maximum, This sets the max PWM value that will ever be output to the motors, 0 = use input RC3_MAX" VALUE 0x36100000 Scalar_FLOAT32_IEEE 0 IDENTICAL 0.0 2000.0 /end CHARACTERISTIC
/begin COMPU_METHOD CM_MOT_SPIN_MIN "Motor Spin minimum" TAB_VERB "%17.6" "" COMPU_TAB_REF TAB_MOT_SPIN_MIN /end COMPU_METHOD
/begin COMPU_VTAB TAB_MOT_SPIN_MIN "Motor Spin minimum, Point at which the thrust starts expressed as a number from 0 to 1 in the entire output range" TAB_VERB 3 0.3 "High" 0.0 "Low" 0.15 "Default" /end COMPU_VTAB
/begin CHARACTERISTIC MOT_SPIN_MIN "Motor Spin minimum, Point at which the thrust starts expressed as a number from 0 to 1 in the entire output range" VALUE 0x36100000 Scalar_FLOAT32_IEEE 0 CM_MOT_SPIN_MIN 0.0 0.3 /end CHARACTERISTIC
/begin COMPU_METHOD CM_MOT_SPIN_ARM "Motor Spin armed" TAB_VERB "%17.6" "" COMPU_TAB_REF TAB_MOT_SPIN_ARM /end COMPU_METHOD
/begin COMPU_VTAB TAB_MOT_SPIN_ARM "Motor Spin armed, Point at which the motors start to spin expressed as a number from 0 to 1 in the entire output range" TAB_VERB 3 0.1 "Default" 0.2 "High" 0.0 "Low" /end COMPU_VTAB
/begin CHARACTERISTIC MOT_SPIN_ARM "Motor Spin armed, Point at which the motors start to spin expressed as a number from 0 to 1 in the entire output range" VALUE 0x36100000 Scalar_FLOAT32_IEEE 0 CM_MOT_SPIN_ARM 0.0 0.2 /end CHARACTERISTIC
/begin CHARACTERISTIC MOT_BAT_CURR_TC "Motor Current Max Time Constant, Time constant used to limit the maximum current" VALUE 0x36100000 Scalar_FLOAT32_IEEE 0 SECONDS 0.0 10.0 /end CHARACTERISTIC
/begin CHARACTERISTIC MOT_THST_HOVER "Thrust Hover Value, Motor thrust needed to hover expressed as a number from 0 to 1" VALUE 0x36100000 Scalar_FLOAT32_IEEE 0 IDENTICAL 0.25 0.8 /end CHARACTERISTIC
/begin COMPU_METHOD CM_MOT_HOVER_LEARN "Hover Value Learning" TAB_VERB "%17.6" "" COMPU_TAB_REF TAB_MOT_HOVER_LEARN /end COMPU_METHOD
/begin COMPU_VTAB TAB_MOT_HOVER_LEARN "Hover Value Learning, Enable/Disable automatic learning of hover throttle" TAB_VERB 3 0 "Disabled" 1 "Learn" 2 "LearnAndSave" /end COMPU_VTAB
/begin CHARACTERISTIC MOT_HOVER_LEARN "Hover Value Learning, Enable/Disable automatic learning of hover throttle" VALUE 0x36100000 Scalar_FLOAT32_IEEE 0 CM_MOT_HOVER_LEARN 0.0 2.0 /end CHARACTERISTIC
/begin CHARACTERISTIC RCMAP_ROLL "Roll channel, Roll channel number. This is useful when you have a RC transmitter that can't change the channel order easily. Roll is normally on channel 1, but you can move it to any channel with this parameter.  Reboot is required for changes to take effect." VALUE 0x36100000 Scalar_FLOAT32_IEEE 0 IDENTICAL 1.0 8.0 /end CHARACTERISTIC
/begin CHARACTERISTIC RCMAP_PITCH "Pitch channel, Pitch channel number. This is useful when you have a RC transmitter that can't change the channel order easily. Pitch is normally on channel 2, but you can move it to any channel with this parameter.  Reboot is required for changes to take effect." VALUE 0x36100000 Scalar_FLOAT32_IEEE 0 IDENTICAL 1.0 8.0 /end CHARACTERISTIC
/begin CHARACTERISTIC RCMAP_THROTTLE "Throttle channel, Throttle channel number. This is useful when you have a RC transmitter that can't change the channel order easily. Throttle is normally on channel 3, but you can move it to any channel with this parameter. Warning APM 2.X: Changing the throttle channel could produce unexpected fail-safe results if connection between receiver and on-board PPM Encoder is lost. Disabling on-board PPM Encoder is recommended.  Reboot is required for changes to take effect." VALUE 0x36100000 Scalar_FLOAT32_IEEE 0 IDENTICAL 1.0 8.0 /end CHARACTERISTIC
/begin CHARACTERISTIC RCMAP_YAW "Yaw channel, Yaw channel number. This is useful when you have a RC transmitter that can't change the channel order easily. Yaw (also known as rudder) is normally on channel 4, but you can move it to any channel with this parameter.  Reboot is required for changes to take effect." VALUE 0x36100000 Scalar_FLOAT32_IEEE 0 IDENTICAL 1.0 8.0 /end CHARACTERISTIC
/begin COMPU_METHOD CM_EKF_ENABLE "Enable EKF1" TAB_VERB "%17.6" "" COMPU_TAB_REF TAB_EKF_ENABLE /end COMPU_METHOD
/begin COMPU_VTAB TAB_EKF_ENABLE "Enable EKF1, This enables EKF1 to be disabled when using alternative algorithms. When disabling it, the alternate EKF2 estimator must be enabled by setting EK2_ENABLED = 1 and flight control algorithms must be set to use the alternative estimator by setting AHRS_EKF_TYPE = 2." TAB_VERB 2 0 "Disabled" 1 "Enabled" /end COMPU_VTAB
/begin CHARACTERISTIC EKF_ENABLE "Enable EKF1, This enables EKF1 to be disabled when using alternative algorithms. When disabling it, the alternate EKF2 estimator must be enabled by setting EK2_ENABLED = 1 and flight control algorithms must be set to use the alternative estimator by setting AHRS_EKF_TYPE = 2." VALUE 0x36100000 Scalar_FLOAT32_IEEE 0 CM_EKF_ENABLE 0.0 1.0 /end CHARACTERISTIC
/begin CHARACTERISTIC EKF_VELNE_NOISE "GPS horizontal velocity measurement noise scaler, This is the scaler that is applied to the speed accuracy reported by the receiver to estimate the horizontal velocity observation noise. If the model of receiver used does not provide a speed accurcy estimate, then a speed accuracy of 1 is assumed. Increasing it reduces the weighting on these measurements." VALUE 0x36100000 Scalar_FLOAT32_IEEE 0 IDENTICAL 0.05 5.0 /end CHARACTERISTIC
/begin CHARACTERISTIC EKF_VELD_NOISE "GPS vertical velocity measurement noise scaler, This is the scaler that is applied to the speed accuracy reported by the receiver to estimate the vertical velocity observation noise. If the model of receiver used does not provide a speed accurcy estimate, then a speed accuracy of 1 is assumed. Increasing it reduces the weighting on this measurement." VALUE 0x36100000 Scalar_FLOAT32_IEEE 0 IDENTICAL 0.05 5.0 /end CHARACTERISTIC
/begin CHARACTERISTIC EKF_POSNE_NOISE "GPS horizontal position measurement noise (m), This is the RMS value of noise in the GPS horizontal position measurements. Increasing it reduces the weighting on these measurements." VALUE 0x36100000 Scalar_FLOAT32_IEEE 0 METERS 0.1 10.0 /end CHARACTERISTIC
/begin CHARACTERISTIC EKF_ALT_NOISE "Altitude measurement noise (m), This is the RMS value of noise in the altitude measurement. Increasing it reduces the weighting on this measurement." VALUE 0x36100000 Scalar_FLOAT32_IEEE 0 METERS 0.1 10.0 /end CHARACTERISTIC
/begin CHARACTERISTIC EKF_MAG_NOISE "Magnetometer measurement noise (Gauss), This is the RMS value of noise in magnetometer measurements. Increasing it reduces the weighting on these measurements." VALUE 0x36100000 Scalar_FLOAT32_IEEE 0 IDENTICAL 0.01 0.5 /end CHARACTERISTIC
/begin CHARACTERISTIC EKF_EAS_NOISE "Equivalent airspeed measurement noise (m/s), This is the RMS value of noise in equivalent airspeed measurements. Increasing it reduces the weighting on these measurements." VALUE 0x36100000 Scalar_FLOAT32_IEEE 0 METERS_PER_SECOND 0.5 5.0 /end CHARACTERISTIC
/begin CHARACTERISTIC EKF_WIND_PNOISE "Wind velocity process noise (m/s^2), This noise controls the growth of wind state error estimates. Increasing it makes wind estimation faster and noisier." VALUE 0x36100000 Scalar_FLOAT32_IEEE 0 IDENTICAL 0.01 1.0 /end CHARACTERISTIC
/begin CHARACTERISTIC EKF_WIND_PSCALE "Height rate to wind procss noise scaler, Increasing this parameter increases how rapidly the wind states adapt when changing altitude, but does make wind speed estimation noiser." VALUE 0x36100000 Scalar_FLOAT32_IEEE 0 IDENTICAL 0.0 1.0 /end CHARACTERISTIC
/begin CHARACTERISTIC EKF_GYRO_PNOISE "Rate gyro noise (rad/s), This noise controls the growth of estimated error due to gyro measurement errors excluding bias. Increasing it makes the flter trust the gyro measurements less and other measurements more." VALUE 0x36100000 Scalar_FLOAT32_IEEE 0 RADIANS_PER_SECOND 0.001 0.05 /end CHARACTERISTIC
/begin CHARACTERISTIC EKF_ACC_PNOISE "Accelerometer noise (m/s^2), This noise controls the growth of estimated error due to accelerometer measurement errors excluding bias. Increasing it makes the flter trust the accelerometer measurements less and other measurements more." VALUE 0x36100000 Scalar_FLOAT32_IEEE 0 METERS_PER_SECOND_PER_SECOND 0.05 1.0 /end CHARACTERISTIC
/begin CHARACTERISTIC EKF_GBIAS_PNOISE "Rate gyro bias process noise (rad/s), This noise controls the growth of gyro bias state error estimates. Increasing it makes rate gyro bias estimation faster and noisier." VALUE 0x36100000 Scalar_FLOAT32_IEEE 0 RADIANS_PER_SECOND 1e-07 1e-05 /end CHARACTERISTIC
/begin CHARACTERISTIC EKF_ABIAS_PNOISE "Accelerometer bias process noise (m/s^2), This noise controls the growth of the vertical acelerometer bias state error estimate. Increasing it makes accelerometer bias estimation faster and noisier." VALUE 0x36100000 Scalar_FLOAT32_IEEE 0 METERS_PER_SECOND_PER_SECOND 1e-05 0.001 /end CHARACTERISTIC
/begin CHARACTERISTIC EKF_MAGE_PNOISE "Earth magnetic field process noise (gauss/s), This noise controls the growth of earth magnetic field state error estimates. Increasing it makes earth magnetic field bias estimation faster and noisier." VALUE 0x36100000 Scalar_FLOAT32_IEEE 0 GAUSS_PER_SECOND 0.0001 0.01 /end CHARACTERISTIC
/begin CHARACTERISTIC EKF_MAGB_PNOISE "Body magnetic field process noise (gauss/s), This noise controls the growth of body magnetic field state error estimates. Increasing it makes compass offset estimation faster and noisier." VALUE 0x36100000 Scalar_FLOAT32_IEEE 0 GAUSS_PER_SECOND 0.0001 0.01 /end CHARACTERISTIC
/begin CHARACTERISTIC EKF_VEL_DELAY "GPS velocity measurement delay (msec), This is the number of msec that the GPS velocity measurements lag behind the inertial measurements." VALUE 0x36100000 Scalar_FLOAT32_IEEE 0 MILLISECONDS 0.0 500.0 /end CHARACTERISTIC
/begin CHARACTERISTIC EKF_POS_DELAY "GPS position measurement delay (msec), This is the number of msec that the GPS position measurements lag behind the inertial measurements." VALUE 0x36100000 Scalar_FLOAT32_IEEE 0 MILLISECONDS 0.0 500.0 /end CHARACTERISTIC
/begin COMPU_METHOD CM_EKF_GPS_TYPE "GPS mode control" TAB_VERB "%17.6" "" COMPU_TAB_REF TAB_EKF_GPS_TYPE /end COMPU_METHOD
/begin COMPU_VTAB TAB_EKF_GPS_TYPE "GPS mode control, This parameter controls use of GPS measurements : 0 = use 3D velocity & 2D position, 1 = use 2D velocity and 2D position, 2 = use 2D position, 3 = use no GPS (optical flow will be used if available)" TAB_VERB 4 0 "GPS 3D Vel and 2D Pos" 1 "GPS 2D vel and 2D pos" 2 "GPS 2D pos" 3 "No GPS use optical flow" /end COMPU_VTAB
/begin CHARACTERISTIC EKF_GPS_TYPE "GPS mode control, This parameter controls use of GPS measurements : 0 = use 3D velocity & 2D position, 1 = use 2D velocity and 2D position, 2 = use 2D position, 3 = use no GPS (optical flow will be used if available)" VALUE 0x36100000 Scalar_FLOAT32_IEEE 0 CM_EKF_GPS_TYPE 0.0 3.0 /end CHARACTERISTIC
/begin CHARACTERISTIC EKF_VEL_GATE "GPS velocity measurement gate size, This parameter sets the number of standard deviations applied to the GPS velocity measurement innovation consistency check. Decreasing it makes it more likely that good measurements willbe rejected. Increasing it makes it more likely that bad measurements will be accepted." VALUE 0x36100000 Scalar_FLOAT32_IEEE 0 IDENTICAL 1.0 100.0 /end CHARACTERISTIC
/begin CHARACTERISTIC EKF_POS_GATE "GPS position measurement gate size, This parameter sets the number of standard deviations applied to the GPS position measurement innovation consistency check. Decreasing it makes it more likely that good measurements will be rejected. Increasing it makes it more likely that bad measurements will be accepted." VALUE 0x36100000 Scalar_FLOAT32_IEEE 0 IDENTICAL 1.0 100.0 /end CHARACTERISTIC
/begin CHARACTERISTIC EKF_HGT_GATE "Height measurement gate size, This parameter sets the number of standard deviations applied to the height measurement innovation consistency check. Decreasing it makes it more likely that good measurements will be rejected. Increasing it makes it more likely that bad measurements will be accepted." VALUE 0x36100000 Scalar_FLOAT32_IEEE 0 IDENTICAL 1.0 100.0 /end CHARACTERISTIC
/begin CHARACTERISTIC EKF_MAG_GATE "Magnetometer measurement gate size, This parameter sets the number of standard deviations applied to the magnetometer measurement innovation consistency check. Decreasing it makes it more likely that good measurements will be rejected. Increasing it makes it more likely that bad measurements will be accepted." VALUE 0x36100000 Scalar_FLOAT32_IEEE 0 IDENTICAL 1.0 100.0 /end CHARACTERISTIC
/begin CHARACTERISTIC EKF_EAS_GATE "Airspeed measurement gate size, This parameter sets the number of standard deviations applied to the airspeed measurement innovation consistency check. Decreasing it makes it more likely that good measurements will be rejected. Increasing it makes it more likely that bad measurements will be accepted." VALUE 0x36100000 Scalar_FLOAT32_IEEE 0 IDENTICAL 1.0 100.0 /end CHARACTERISTIC
/begin COMPU_METHOD CM_EKF_MAG_CAL "Magnetometer calibration mode" TAB_VERB "%17.6" "" COMPU_TAB_REF TAB_EKF_MAG_CAL /end COMPU_METHOD
/begin COMPU_VTAB TAB_EKF_MAG_CAL "Magnetometer calibration mode, EKF_MAG_CAL = 0 enables calibration based on flying speed and altitude and is the default setting for Plane users. EKF_MAG_CAL = 1 enables calibration based on manoeuvre level and is the default setting for Copter and Rover users. EKF_MAG_CAL = 2 prevents magnetometer calibration regardless of flight condition and is recommended if in-flight magnetometer calibration is unreliable." TAB_VERB 4 0 "Speed and Height" 1 "Acceleration" 2 "Never" 3 "Always" /end COMPU_VTAB
/begin CHARACTERISTIC EKF_MAG_CAL "Magnetometer calibration mode, EKF_MAG_CAL = 0 enables calibration based on flying speed and altitude and is the default setting for Plane users. EKF_MAG_CAL = 1 enables calibration based on manoeuvre level and is the default setting for Copter and Rover users. EKF_MAG_CAL = 2 prevents magnetometer calibration regardless of flight condition and is recommended if in-flight magnetometer calibration is unreliable." VALUE 0x36100000 Scalar_FLOAT32_IEEE 0 CM_EKF_MAG_CAL 0.0 3.0 /end CHARACTERISTIC
/begin CHARACTERISTIC EKF_GLITCH_ACCEL "GPS glitch accel gate size (cm/s^2), This parameter controls the maximum amount of difference in horizontal acceleration between the value predicted by the filter and the value measured by the GPS before the GPS position data is rejected. If this value is set too low, then valid GPS data will be regularly discarded, and the position accuracy will degrade. If this parameter is set too high, then large GPS glitches will cause large rapid changes in position." VALUE 0x36100000 Scalar_FLOAT32_IEEE 0 IDENTICAL 100.0 500.0 /end CHARACTERISTIC
/begin CHARACTERISTIC EKF_GLITCH_RAD "GPS glitch radius gate size (m), This parameter controls the maximum amount of difference in horizontal position (in m) between the value predicted by the filter and the value measured by the GPS before the long term glitch protection logic is activated and the filter states are reset to the new GPS position. Position steps smaller than this value will be temporarily ignored, but will then be accepted and the filter will move to the new position. Position steps larger than this value will be ignored initially, but the filter will then apply an offset to the GPS position measurement." VALUE 0x36100000 Scalar_FLOAT32_IEEE 0 METERS 10.0 50.0 /end CHARACTERISTIC
/begin CHARACTERISTIC EKF_GND_GRADIENT "Terrain Gradient % RMS, This parameter sets the RMS terrain gradient percentage assumed by the terrain height estimation. Terrain height can be estimated using optical flow and/or range finder sensor data if fitted. Smaller values cause the terrain height estimate to be slower to respond to changes in measurement. Larger values cause the terrain height estimate to be faster to respond, but also more noisy. Generally this value can be reduced if operating over very flat terrain and increased if operating over uneven terrain." VALUE 0x36100000 Scalar_FLOAT32_IEEE 0 IDENTICAL 1.0 50.0 /end CHARACTERISTIC
/begin CHARACTERISTIC EKF_FLOW_NOISE "Optical flow measurement noise (rad/s), This is the RMS value of noise and errors in optical flow measurements. Increasing it reduces the weighting on these measurements." VALUE 0x36100000 Scalar_FLOAT32_IEEE 0 RADIANS_PER_SECOND 0.05 1.0 /end CHARACTERISTIC
/begin CHARACTERISTIC EKF_FLOW_GATE "Optical Flow measurement gate size, This parameter sets the number of standard deviations applied to the optical flow innovation consistency check. Decreasing it makes it more likely that good measurements will be rejected. Increasing it makes it more likely that bad measurements will be accepted." VALUE 0x36100000 Scalar_FLOAT32_IEEE 0 IDENTICAL 1.0 100.0 /end CHARACTERISTIC
/begin CHARACTERISTIC EKF_FLOW_DELAY "Optical Flow measurement delay (msec), This is the number of msec that the optical flow measurements lag behind the inertial measurements. It is the time from the end of the optical flow averaging period and does not include the time delay due to the 100msec of averaging within the flow sensor." VALUE 0x36100000 Scalar_FLOAT32_IEEE 0 MILLISECONDS 0.0 500.0 /end CHARACTERISTIC
/begin CHARACTERISTIC EKF_RNG_GATE "Range finder measurement gate size, This parameter sets the number of standard deviations applied to the range finder innovation consistency check. Decreasing it makes it more likely that good measurements will be rejected. Increasing it makes it more likely that bad measurements will be accepted." VALUE 0x36100000 Scalar_FLOAT32_IEEE 0 IDENTICAL 1.0 100.0 /end CHARACTERISTIC
/begin CHARACTERISTIC EKF_MAX_FLOW "Maximum valid optical flow rate, This parameter sets the magnitude maximum optical flow rate in rad/sec that will be accepted by the filter" VALUE 0x36100000 Scalar_FLOAT32_IEEE 0 IDENTICAL 1.0 4.0 /end CHARACTERISTIC
/begin COMPU_METHOD CM_EKF_FALLBACK "Fallback strictness" TAB_VERB "%17.6" "" COMPU_TAB_REF TAB_EKF_FALLBACK /end COMPU_METHOD
/begin COMPU_VTAB TAB_EKF_FALLBACK "Fallback strictness, This parameter controls the conditions necessary to trigger a fallback to DCM and INAV. A value of 1 will cause fallbacks to occur on loss of GPS and other conditions. A value of 0 will trust the EKF more." TAB_VERB 2 0 "Trust EKF more" 1 "Trust DCM more" /end COMPU_VTAB
/begin CHARACTERISTIC EKF_FALLBACK "Fallback strictness, This parameter controls the conditions necessary to trigger a fallback to DCM and INAV. A value of 1 will cause fallbacks to occur on loss of GPS and other conditions. A value of 0 will trust the EKF more." VALUE 0x36100000 Scalar_FLOAT32_IEEE 0 CM_EKF_FALLBACK 0.0 1.0 /end CHARACTERISTIC
/begin COMPU_METHOD CM_EKF_ALT_SOURCE "Primary height source" TAB_VERB "%17.6" "" COMPU_TAB_REF TAB_EKF_ALT_SOURCE /end COMPU_METHOD
/begin COMPU_VTAB TAB_EKF_ALT_SOURCE "Primary height source, This parameter controls which height sensor is used by the EKF during optical flow navigation (when EKF_GPS_TYPE = 3). A value of will 0 cause it to always use baro altitude. A value of 1 will cause it to use range finder if available." TAB_VERB 2 0 "Use Baro" 1 "Use Range Finder" /end COMPU_VTAB
/begin CHARACTERISTIC EKF_ALT_SOURCE "Primary height source, This parameter controls which height sensor is used by the EKF during optical flow navigation (when EKF_GPS_TYPE = 3). A value of will 0 cause it to always use baro altitude. A value of 1 will cause it to use range finder if available." VALUE 0x36100000 Scalar_FLOAT32_IEEE 0 CM_EKF_ALT_SOURCE 0.0 1.0 /end CHARACTERISTIC
/begin CHARACTERISTIC EKF_GPS_CHECK "GPS preflight check, 1 byte bitmap of GPS preflight checks to perform. Set to 0 to bypass all checks. Set to 255 perform all checks. Set to 3 to check just the number of satellites and HDoP. Set to 31 for the most rigorous checks that will still allow checks to pass when the copter is moving, eg launch from a boat." VALUE 0x36100000 Scalar_FLOAT32_IEEE 0 IDENTICAL -3.40282e+38 3.40282e+38 /end CHARACTERISTIC
/begin COMPU_METHOD CM_EK2_ENABLE "Enable EKF2" TAB_VERB "%17.6" "" COMPU_TAB_REF TAB_EK2_ENABLE /end COMPU_METHOD
/begin COMPU_VTAB TAB_EK2_ENABLE "Enable EKF2, This enables EKF2. Enabling EKF2 only makes the maths run, it does not mean it will be used for flight control. To use it for flight control set AHRS_EKF_TYPE=2. A reboot or restart will need to be performed after changing the value of EK2_ENABLE for it to take effect." TAB_VERB 2 0 "Disabled" 1 "Enabled" /end COMPU_VTAB
/begin CHARACTERISTIC EK2_ENABLE "Enable EKF2, This enables EKF2. Enabling EKF2 only makes the maths run, it does not mean it will be used for flight control. To use it for flight control set AHRS_EKF_TYPE=2. A reboot or restart will need to be performed after changing the value of EK2_ENABLE for it to take effect." VALUE 0x36100000 Scalar_FLOAT32_IEEE 0 CM_EK2_ENABLE 0.0 1.0 /end CHARACTERISTIC
/begin COMPU_METHOD CM_EK2_GPS_TYPE "GPS mode control" TAB_VERB "%17.6" "" COMPU_TAB_REF TAB_EK2_GPS_TYPE /end COMPU_METHOD
/begin COMPU_VTAB TAB_EK2_GPS_TYPE "GPS mode control, This controls use of GPS measurements : 0 = use 3D velocity & 2D position, 1 = use 2D velocity and 2D position, 2 = use 2D position, 3 = use no GPS (optical flow will be used if available)" TAB_VERB 4 0 "GPS 3D Vel and 2D Pos" 1 "GPS 2D vel and 2D pos" 2 "GPS 2D pos" 3 "No GPS use optical flow" /end COMPU_VTAB
/begin CHARACTERISTIC EK2_GPS_TYPE "GPS mode control, This controls use of GPS measurements : 0 = use 3D velocity & 2D position, 1 = use 2D velocity and 2D position, 2 = use 2D position, 3 = use no GPS (optical flow will be used if available)" VALUE 0x36100000 Scalar_FLOAT32_IEEE 0 CM_EK2_GPS_TYPE 0.0 3.0 /end CHARACTERISTIC
/begin CHARACTERISTIC EK2_VELNE_M_NSE "GPS horizontal velocity measurement noise (m/s), This sets a lower limit on the speed accuracy reported by the GPS receiver that is used to set horizontal velocity observation noise. If the model of receiver used does not provide a speed accurcy estimate, then the parameter value will be used. Increasing it reduces the weighting of the GPS horizontal velocity measurements." VALUE 0x36100000 Scalar_FLOAT32_IEEE 0 METERS_PER_SECOND 0.05 5.0 /end CHARACTERISTIC
/begin CHARACTERISTIC EK2_VELD_M_NSE "GPS vertical velocity measurement noise (m/s), This sets a lower limit on the speed accuracy reported by the GPS receiver that is used to set vertical velocity observation noise. If the model of receiver used does not provide a speed accurcy estimate, then the parameter value will be used. Increasing it reduces the weighting of the GPS vertical velocity measurements." VALUE 0x36100000 Scalar_FLOAT32_IEEE 0 METERS_PER_SECOND 0.05 5.0 /end CHARACTERISTIC
/begin CHARACTERISTIC EK2_VEL_I_GATE "GPS velocity innovation gate size, This sets the percentage number of standard deviations applied to the GPS velocity measurement innovation consistency check. Decreasing it makes it more likely that good measurements willbe rejected. Increasing it makes it more likely that bad measurements will be accepted." VALUE 0x36100000 Scalar_FLOAT32_IEEE 0 IDENTICAL 100.0 1000.0 /end CHARACTERISTIC
/begin CHARACTERISTIC EK2_POSNE_M_NSE "GPS horizontal position measurement noise (m), This sets the GPS horizontal position observation noise. Increasing it reduces the weighting of GPS horizontal position measurements." VALUE 0x36100000 Scalar_FLOAT32_IEEE 0 METERS 0.1 10.0 /end CHARACTERISTIC
/begin CHARACTERISTIC EK2_POS_I_GATE "GPS position measurement gate size, This sets the percentage number of standard deviations applied to the GPS position measurement innovation consistency check. Decreasing it makes it more likely that good measurements will be rejected. Increasing it makes it more likely that bad measurements will be accepted." VALUE 0x36100000 Scalar_FLOAT32_IEEE 0 IDENTICAL 100.0 1000.0 /end CHARACTERISTIC
/begin CHARACTERISTIC EK2_GLITCH_RAD "GPS glitch radius gate size (m), This controls the maximum radial uncertainty in position between the value predicted by the filter and the value measured by the GPS before the filter position and velocity states are reset to the GPS. Making this value larger allows the filter to ignore larger GPS glitches but also means that non-GPS errors such as IMU and compass can create a larger error in position before the filter is forced back to the GPS position." VALUE 0x36100000 Scalar_FLOAT32_IEEE 0 METERS 10.0 100.0 /end CHARACTERISTIC
/begin CHARACTERISTIC EK2_GPS_DELAY "GPS measurement delay (msec), This is the number of msec that the GPS measurements lag behind the inertial measurements." VALUE 0x36100000 Scalar_FLOAT32_IEEE 0 MILLISECONDS 0.0 250.0 /end CHARACTERISTIC
/begin COMPU_METHOD CM_EK2_ALT_SOURCE "Primary height source" TAB_VERB "%17.6" "" COMPU_TAB_REF TAB_EK2_ALT_SOURCE /end COMPU_METHOD
/begin COMPU_VTAB TAB_EK2_ALT_SOURCE "Primary height source, This parameter controls the primary height sensor used by the EKF. If the selected option cannot be used, it will default to Baro as the primary height source. Setting 0 will use the baro altitude at all times. Setting 1 uses the range finder and is only available in combination with optical flow navigation (EK2_GPS_TYPE = 3). Setting 2 uses GPS. NOTE - the EK2_RNG_USE_HGT parameter can be used to switch to range-finder when close to the ground." TAB_VERB 3 0 "Use Baro" 1 "Use Range Finder" 2 "Use GPS" /end COMPU_VTAB
/begin CHARACTERISTIC EK2_ALT_SOURCE "Primary height source, This parameter controls the primary height sensor used by the EKF. If the selected option cannot be used, it will default to Baro as the primary height source. Setting 0 will use the baro altitude at all times. Setting 1 uses the range finder and is only available in combination with optical flow navigation (EK2_GPS_TYPE = 3). Setting 2 uses GPS. NOTE - the EK2_RNG_USE_HGT parameter can be used to switch to range-finder when close to the ground." VALUE 0x36100000 Scalar_FLOAT32_IEEE 0 CM_EK2_ALT_SOURCE 0.0 2.0 /end CHARACTERISTIC
/begin CHARACTERISTIC EK2_ALT_M_NSE "Altitude measurement noise (m), This is the RMS value of noise in the altitude measurement. Increasing it reduces the weighting of the baro measurement and will make the filter respond more slowly to baro measurement errors, but will make it more sensitive to GPS and accelerometer errors." VALUE 0x36100000 Scalar_FLOAT32_IEEE 0 METERS 0.1 10.0 /end CHARACTERISTIC
/begin CHARACTERISTIC EK2_HGT_I_GATE "Height measurement gate size, This sets the percentage number of standard deviations applied to the height measurement innovation consistency check. Decreasing it makes it more likely that good measurements will be rejected. Increasing it makes it more likely that bad measurements will be accepted." VALUE 0x36100000 Scalar_FLOAT32_IEEE 0 IDENTICAL 100.0 1000.0 /end CHARACTERISTIC
/begin CHARACTERISTIC EK2_HGT_DELAY "Height measurement delay (msec), This is the number of msec that the Height measurements lag behind the inertial measurements." VALUE 0x36100000 Scalar_FLOAT32_IEEE 0 MILLISECONDS 0.0 250.0 /end CHARACTERISTIC
/begin CHARACTERISTIC EK2_MAG_M_NSE "Magnetometer measurement noise (Gauss), This is the RMS value of noise in magnetometer measurements. Increasing it reduces the weighting on these measurements." VALUE 0x36100000 Scalar_FLOAT32_IEEE 0 GAUSS 0.01 0.5 /end CHARACTERISTIC
/begin COMPU_METHOD CM_EK2_MAG_CAL "Magnetometer calibration mode" TAB_VERB "%17.6" "" COMPU_TAB_REF TAB_EK2_MAG_CAL /end COMPU_METHOD
/begin COMPU_VTAB TAB_EK2_MAG_CAL "Magnetometer calibration mode, EKF_MAG_CAL = 0 enables calibration when airborne and is the default setting for Plane users. EKF_MAG_CAL = 1 enables calibration when manoeuvreing. EKF_MAG_CAL = 2 prevents magnetometer calibration regardless of flight condition, is recommended if the external magnetic field is varying and is the default for rovers. EKF_MAG_CAL = 3 enables calibration when the first in-air field and yaw reset has completed and is the default for copters. EKF_MAG_CAL = 4 enables calibration all the time. This determines when the filter will use the 3-axis magnetometer fusion model that estimates both earth and body fixed magnetic field states. This model is only suitable for use when the external magnetic field environment is stable." TAB_VERB 5 0 "When flying" 1 "When manoeuvring" 2 "Never" 3 "After first climb yaw reset" 4 "Always" /end COMPU_VTAB
/begin CHARACTERISTIC EK2_MAG_CAL "Magnetometer calibration mode, EKF_MAG_CAL = 0 enables calibration when airborne and is the default setting for Plane users. EKF_MAG_CAL = 1 enables calibration when manoeuvreing. EKF_MAG_CAL = 2 prevents magnetometer calibration regardless of flight condition, is recommended if the external magnetic field is varying and is the default for rovers. EKF_MAG_CAL = 3 enables calibration when the first in-air field and yaw reset has completed and is the default for copters. EKF_MAG_CAL = 4 enables calibration all the time. This determines when the filter will use the 3-axis magnetometer fusion model that estimates both earth and body fixed magnetic field states. This model is only suitable for use when the external magnetic field environment is stable." VALUE 0x36100000 Scalar_FLOAT32_IEEE 0 CM_EK2_MAG_CAL 0.0 4.0 /end CHARACTERISTIC
/begin CHARACTERISTIC EK2_MAG_I_GATE "Magnetometer measurement gate size, This sets the percentage number of standard deviations applied to the magnetometer measurement innovation consistency check. Decreasing it makes it more likely that good measurements will be rejected. Increasing it makes it more likely that bad measurements will be accepted." VALUE 0x36100000 Scalar_FLOAT32_IEEE 0 IDENTICAL 100.0 1000.0 /end CHARACTERISTIC
/begin CHARACTERISTIC EK2_EAS_M_NSE "Equivalent airspeed measurement noise (m/s), This is the RMS value of noise in equivalent airspeed measurements used by planes. Increasing it reduces the weighting of airspeed measurements and will make wind speed estimates less noisy and slower to converge. Increasing also increases navigation errors when dead-reckoning without GPS measurements." VALUE 0x36100000 Scalar_FLOAT32_IEEE 0 METERS_PER_SECOND 0.5 5.0 /end CHARACTERISTIC
/begin CHARACTERISTIC EK2_EAS_I_GATE "Airspeed measurement gate size, This sets the percentage number of standard deviations applied to the airspeed measurement innovation consistency check. Decreasing it makes it more likely that good measurements will be rejected. Increasing it makes it more likely that bad measurements will be accepted." VALUE 0x36100000 Scalar_FLOAT32_IEEE 0 IDENTICAL 100.0 1000.0 /end CHARACTERISTIC
/begin CHARACTERISTIC EK2_RNG_M_NSE "Range finder measurement noise (m), This is the RMS value of noise in the range finder measurement. Increasing it reduces the weighting on this measurement." VALUE 0x36100000 Scalar_FLOAT32_IEEE 0 METERS 0.1 10.0 /end CHARACTERISTIC
/begin CHARACTERISTIC EK2_RNG_I_GATE "Range finder measurement gate size, This sets the percentage number of standard deviations applied to the range finder innovation consistency check. Decreasing it makes it more likely that good measurements will be rejected. Increasing it makes it more likely that bad measurements will be accepted." VALUE 0x36100000 Scalar_FLOAT32_IEEE 0 IDENTICAL 100.0 1000.0 /end CHARACTERISTIC
/begin CHARACTERISTIC EK2_MAX_FLOW "Maximum valid optical flow rate, This sets the magnitude maximum optical flow rate in rad/sec that will be accepted by the filter" VALUE 0x36100000 Scalar_FLOAT32_IEEE 0 RADIANS_PER_SECOND 1.0 4.0 /end CHARACTERISTIC
/begin CHARACTERISTIC EK2_FLOW_M_NSE "Optical flow measurement noise (rad/s), This is the RMS value of noise and errors in optical flow measurements. Increasing it reduces the weighting on these measurements." VALUE 0x36100000 Scalar_FLOAT32_IEEE 0 RADIANS_PER_SECOND 0.05 1.0 /end CHARACTERISTIC
/begin CHARACTERISTIC EK2_FLOW_I_GATE "Optical Flow measurement gate size, This sets the percentage number of standard deviations applied to the optical flow innovation consistency check. Decreasing it makes it more likely that good measurements will be rejected. Increasing it makes it more likely that bad measurements will be accepted." VALUE 0x36100000 Scalar_FLOAT32_IEEE 0 IDENTICAL 100.0 1000.0 /end CHARACTERISTIC
/begin CHARACTERISTIC EK2_FLOW_DELAY "Optical Flow measurement delay (msec), This is the number of msec that the optical flow measurements lag behind the inertial measurements. It is the time from the end of the optical flow averaging period and does not include the time delay due to the 100msec of averaging within the flow sensor." VALUE 0x36100000 Scalar_FLOAT32_IEEE 0 MILLISECONDS 0.0 250.0 /end CHARACTERISTIC
/begin CHARACTERISTIC EK2_GYRO_P_NSE "Rate gyro noise (rad/s), This control disturbance noise controls the growth of estimated error due to gyro measurement errors excluding bias. Increasing it makes the flter trust the gyro measurements less and other measurements more." VALUE 0x36100000 Scalar_FLOAT32_IEEE 0 RADIANS_PER_SECOND 0.0001 0.1 /end CHARACTERISTIC
/begin CHARACTERISTIC EK2_ACC_P_NSE "Accelerometer noise (m/s^2), This control disturbance noise controls the growth of estimated error due to accelerometer measurement errors excluding bias. Increasing it makes the flter trust the accelerometer measurements less and other measurements more." VALUE 0x36100000 Scalar_FLOAT32_IEEE 0 METERS_PER_SECOND_PER_SECOND 0.01 1.0 /end CHARACTERISTIC
/begin CHARACTERISTIC EK2_GBIAS_P_NSE "Rate gyro bias stability (rad/s/s), This state  process noise controls growth of the gyro delta angle bias state error estimate. Increasing it makes rate gyro bias estimation faster and noisier." VALUE 0x36100000 Scalar_FLOAT32_IEEE 0 RADIANS_PER_SECOND_PER_SECOND 1e-05 0.001 /end CHARACTERISTIC
/begin CHARACTERISTIC EK2_GSCL_P_NSE "Rate gyro scale factor stability (1/s), This noise controls the rate of gyro scale factor learning. Increasing it makes rate gyro scale factor estimation faster and noisier." VALUE 0x36100000 Scalar_FLOAT32_IEEE 0 HERZ 1e-06 0.001 /end CHARACTERISTIC
/begin CHARACTERISTIC EK2_ABIAS_P_NSE "Accelerometer bias stability (m/s^3), This noise controls the growth of the vertical accelerometer delta velocity bias state error estimate. Increasing it makes accelerometer bias estimation faster and noisier." VALUE 0x36100000 Scalar_FLOAT32_IEEE 0 METERS_PER_SECOND_PER_SECOND 1e-05 0.001 /end CHARACTERISTIC
/begin CHARACTERISTIC EK2_WIND_P_NSE "Wind velocity process noise (m/s^2), This state process noise controls the growth of wind state error estimates. Increasing it makes wind estimation faster and noisier." VALUE 0x36100000 Scalar_FLOAT32_IEEE 0 METERS_PER_SECOND_PER_SECOND 0.01 1.0 /end CHARACTERISTIC
/begin CHARACTERISTIC EK2_WIND_PSCALE "Height rate to wind procss noise scaler, This controls how much the process noise on the wind states is increased when gaining or losing altitude to take into account changes in wind speed and direction with altitude. Increasing this parameter increases how rapidly the wind states adapt when changing altitude, but does make wind velocity estimation noiser." VALUE 0x36100000 Scalar_FLOAT32_IEEE 0 IDENTICAL 0.0 1.0 /end CHARACTERISTIC
/begin CHARACTERISTIC EK2_GPS_CHECK "GPS preflight check, This is a 1 byte bitmap controlling which GPS preflight checks are performed. Set to 0 to bypass all checks. Set to 255 perform all checks. Set to 3 to check just the number of satellites and HDoP. Set to 31 for the most rigorous checks that will still allow checks to pass when the copter is moving, eg launch from a boat." VALUE 0x36100000 Scalar_FLOAT32_IEEE 0 IDENTICAL -3.40282e+38 3.40282e+38 /end CHARACTERISTIC
/begin CHARACTERISTIC EK2_IMU_MASK "Bitmask of active IMUs, 1 byte bitmap of IMUs to use in EKF2. A separate instance of EKF2 will be started for each IMU selected. Set to 1 to use the first IMU only (default), set to 2 to use the second IMU only, set to 3 to use the first and second IMU. Additional IMU's can be used up to a maximum of 6 if memory and processing resources permit. There may be insufficient memory and processing resources to run multiple instances. If this occurs EKF2 will fail to start." VALUE 0x36100000 Scalar_FLOAT32_IEEE 0 IDENTICAL 1.0 127.0 /end CHARACTERISTIC
/begin CHARACTERISTIC EK2_CHECK_SCALE "GPS accuracy check scaler (%), This scales the thresholds that are used to check GPS accuracy before it is used by the EKF. A value of 100 is the default. Values greater than 100 increase and values less than 100 reduce the maximum GPS error the EKF will accept. A value of 200 will double the allowable GPS error." VALUE 0x36100000 Scalar_FLOAT32_IEEE 0 PERCENT 50.0 200.0 /end CHARACTERISTIC
/begin CHARACTERISTIC EK2_NOAID_M_NSE "Non-GPS operation position uncertainty (m), This sets the amount of position variation that the EKF allows for when operating without external measurements (eg GPS or optical flow). Increasing this parameter makes the EKF attitude estimate less sensitive to vehicle manoeuvres but more sensitive to IMU errors." VALUE 0x36100000 Scalar_FLOAT32_IEEE 0 METERS_PER_SECOND 0.5 50.0 /end CHARACTERISTIC
/begin COMPU_METHOD CM_EK2_LOG_MASK "EKF sensor logging IMU mask" TAB_VERB "%17.6" "" COMPU_TAB_REF TAB_EK2_LOG_MASK /end COMPU_METHOD
/begin COMPU_VTAB TAB_EK2_LOG_MASK "EKF sensor logging IMU mask, This sets the IMU mask of sensors to do full logging for" TAB_VERB 4 0 "Disabled" 1 "FirstIMU" 3 "FirstAndSecondIMU" 7 "AllIMUs" /end COMPU_VTAB
/begin CHARACTERISTIC EK2_LOG_MASK "EKF sensor logging IMU mask, This sets the IMU mask of sensors to do full logging for" VALUE 0x36100000 Scalar_FLOAT32_IEEE 0 CM_EK2_LOG_MASK 0.0 7.0 /end CHARACTERISTIC
/begin CHARACTERISTIC EK2_YAW_M_NSE "Yaw measurement noise (rad), This is the RMS value of noise in yaw measurements from the magnetometer. Increasing it reduces the weighting on these measurements." VALUE 0x36100000 Scalar_FLOAT32_IEEE 0 GAUSS 0.05 1.0 /end CHARACTERISTIC
/begin CHARACTERISTIC EK2_YAW_I_GATE "Yaw measurement gate size, This sets the percentage number of standard deviations applied to the magnetometer yaw measurement innovation consistency check. Decreasing it makes it more likely that good measurements will be rejected. Increasing it makes it more likely that bad measurements will be accepted." VALUE 0x36100000 Scalar_FLOAT32_IEEE 0 IDENTICAL 100.0 1000.0 /end CHARACTERISTIC
/begin CHARACTERISTIC EK2_TAU_OUTPUT "Output complementary filter time constant (centi-sec), Sets the time constant of the output complementary filter/predictor in centi-seconds." VALUE 0x36100000 Scalar_FLOAT32_IEEE 0 IDENTICAL 10.0 50.0 /end CHARACTERISTIC
/begin CHARACTERISTIC EK2_MAGE_P_NSE "Earth magnetic field process noise (gauss/s), This state process noise controls the growth of earth magnetic field state error estimates. Increasing it makes earth magnetic field estimation faster and noisier." VALUE 0x36100000 Scalar_FLOAT32_IEEE 0 GAUSS_PER_SECOND 1e-05 0.01 /end CHARACTERISTIC
/begin CHARACTERISTIC EK2_MAGB_P_NSE "Body magnetic field process noise (gauss/s), This state process noise controls the growth of body magnetic field state error estimates. Increasing it makes magnetometer bias error estimation faster and noisier." VALUE 0x36100000 Scalar_FLOAT32_IEEE 0 GAUSS_PER_SECOND 1e-05 0.01 /end CHARACTERISTIC
/begin CHARACTERISTIC EK2_RNG_USE_HGT "Range finder switch height percentage, The range finder will be used as the primary height source when below a specified percentage of the sensor maximum as set by the RNGFND_MAX_CM parameter. Set to -1 to prevent range finder use." VALUE 0x36100000 Scalar_FLOAT32_IEEE 0 PERCENT -1.0 70.0 /end CHARACTERISTIC
/begin CHARACTERISTIC MIS_TOTAL "Total mission commands, The number of mission mission items that has been loaded by the ground station. Do not change this manually." VALUE 0x36100000 Scalar_FLOAT32_IEEE 0 IDENTICAL 0.0 32766.0 /end CHARACTERISTIC
/begin COMPU_METHOD CM_MIS_RESTART "Mission Restart when entering Auto mode" TAB_VERB "%17.6" "" COMPU_TAB_REF TAB_MIS_RESTART /end COMPU_METHOD
/begin COMPU_VTAB TAB_MIS_RESTART "Mission Restart when entering Auto mode, Controls mission starting point when entering Auto mode (either restart from beginning of mission or resume from last command run)" TAB_VERB 2 0 "Resume Mission" 1 "Restart Mission" /end COMPU_VTAB
/begin CHARACTERISTIC MIS_RESTART "Mission Restart when entering Auto mode, Controls mission starting point when entering Auto mode (either restart from beginning of mission or resume from last command run)" VALUE 0x36100000 Scalar_FLOAT32_IEEE 0 CM_MIS_RESTART 0.0 1.0 /end CHARACTERISTIC
/begin COMPU_METHOD CM_RSSI_TYPE "RSSI Type" TAB_VERB "%17.6" "" COMPU_TAB_REF TAB_RSSI_TYPE /end COMPU_METHOD
/begin COMPU_VTAB TAB_RSSI_TYPE "RSSI Type, Radio Receiver RSSI type. If your radio receiver supports RSSI of some kind, set it here, then set its associated RSSI_XXXXX parameters, if any." TAB_VERB 3 0 "Disabled" 1 "AnalogPin" 2 "RCChannelPwmValue" /end COMPU_VTAB
/begin CHARACTERISTIC RSSI_TYPE "RSSI Type, Radio Receiver RSSI type. If your radio receiver supports RSSI of some kind, set it here, then set its associated RSSI_XXXXX parameters, if any." VALUE 0x36100000 Scalar_FLOAT32_IEEE 0 CM_RSSI_TYPE 0.0 2.0 /end CHARACTERISTIC
/begin COMPU_METHOD CM_RSSI_ANA_PIN "Receiver RSSI analog sensing pin" TAB_VERB "%17.6" "" COMPU_TAB_REF TAB_RSSI_ANA_PIN /end COMPU_METHOD
/begin COMPU_VTAB TAB_RSSI_ANA_PIN "Receiver RSSI analog sensing pin, This selects an analog pin where the receiver RSSI voltage will be read." TAB_VERB 8 0 "APM2 A0" 1 "APM2 A1" 13 "APM2 A13" 11 "Pixracer" 13 "Pixhawk ADC4" 14 "Pixhawk ADC3" 15 " Pixhawk ADC6" 103 "Pixhawk SBUS" /end COMPU_VTAB
/begin CHARACTERISTIC RSSI_ANA_PIN "Receiver RSSI analog sensing pin, This selects an analog pin where the receiver RSSI voltage will be read." VALUE 0x36100000 Scalar_FLOAT32_IEEE 0 CM_RSSI_ANA_PIN 0.0 103.0 /end CHARACTERISTIC
/begin CHARACTERISTIC RSSI_PIN_LOW "Receiver RSSI voltage low, This is the voltage value that the radio receiver will put on the RSSI_ANA_PIN when the signal strength is the weakest. Since some radio receivers put out inverted values from what you might otherwise expect, this isn't necessarily a lower value than RSSI_PIN_HIGH. " VALUE 0x36100000 Scalar_FLOAT32_IEEE 0 VOLT 0.0 5.0 /end CHARACTERISTIC
/begin CHARACTERISTIC RSSI_PIN_HIGH "Receiver RSSI voltage high, This is the voltage value that the radio receiver will put on the RSSI_ANA_PIN when the signal strength is the strongest. Since some radio receivers put out inverted values from what you might otherwise expect, this isn't necessarily a higher value than RSSI_PIN_LOW. " VALUE 0x36100000 Scalar_FLOAT32_IEEE 0 VOLT 0.0 5.0 /end CHARACTERISTIC
/begin CHARACTERISTIC RSSI_CHANNEL "Receiver RSSI channel number, The channel number where RSSI will be output by the radio receiver (5 and above)." VALUE 0x36100000 Scalar_FLOAT32_IEEE 0 IDENTICAL -3.40282e+38 3.40282e+38 /end CHARACTERISTIC
/begin CHARACTERISTIC RSSI_CHAN_LOW "Receiver RSSI PWM low value, This is the PWM value that the radio receiver will put on the RSSI_CHANNEL when the signal strength is the weakest. Since some radio receivers put out inverted values from what you might otherwise expect, this isn't necessarily a lower value than RSSI_CHAN_HIGH. " VALUE 0x36100000 Scalar_FLOAT32_IEEE 0 MICROSECONDS 0.0 2000.0 /end CHARACTERISTIC
/begin CHARACTERISTIC RSSI_CHAN_HIGH "Receiver RSSI PWM high value, This is the PWM value that the radio receiver will put on the RSSI_CHANNEL when the signal strength is the strongest. Since some radio receivers put out inverted values from what you might otherwise expect, this isn't necessarily a higher value than RSSI_CHAN_LOW. " VALUE 0x36100000 Scalar_FLOAT32_IEEE 0 MICROSECONDS 0.0 2000.0 /end CHARACTERISTIC
/begin COMPU_METHOD CM_RNGFND_TYPE "Rangefinder type" TAB_VERB "%17.6" "" COMPU_TAB_REF TAB_RNGFND_TYPE /end COMPU_METHOD
/begin COMPU_VTAB TAB_RNGFND_TYPE "Rangefinder type, What type of rangefinder device that is connected" TAB_VERB 11 0 "None" 1 "Analog" 2 "APM2-MaxbotixI2C" 3 "APM2-PulsedLightI2C" 4 "PX4-I2C" 5 "PX4-PWM" 6 "BBB-PRU" 7 "LightWareI2C" 8 "LightWareSerial" 9 "Bebop" 10 "MAVLink" /end COMPU_VTAB
/begin CHARACTERISTIC RNGFND_TYPE "Rangefinder type, What type of rangefinder device that is connected" VALUE 0x36100000 Scalar_FLOAT32_IEEE 0 CM_RNGFND_TYPE 0.0 10.0 /end CHARACTERISTIC
/begin COMPU_METHOD CM_RNGFND_PIN "Rangefinder pin" TAB_VERB "%17.6" "" COMPU_TAB_REF TAB_RNGFND_PIN /end COMPU_METHOD
/begin COMPU_VTAB TAB_RNGFND_PIN "Rangefinder pin, Analog pin that rangefinder is connected to. Set this to 0..9 for the APM2 analog pins. Set to 64 on an APM1 for the dedicated 'airspeed' port on the end of the board. Set to 11 on PX4 for the analog 'airspeed' port. Set to 15 on the Pixhawk for the analog 'airspeed' port." TAB_VERB 14 -1 "Not Used" 0 "APM2-A0" 1 "APM2-A1" 2 "APM2-A2" 3 "APM2-A3" 4 "APM2-A4" 5 "APM2-A5" 6 "APM2-A6" 7 "APM2-A7" 8 "APM2-A8" 9 "APM2-A9" 11 "PX4-airspeed port" 15 "Pixhawk-airspeed port" 64 "APM1-airspeed port" /end COMPU_VTAB
/begin CHARACTERISTIC RNGFND_PIN "Rangefinder pin, Analog pin that rangefinder is connected to. Set this to 0..9 for the APM2 analog pins. Set to 64 on an APM1 for the dedicated 'airspeed' port on the end of the board. Set to 11 on PX4 for the analog 'airspeed' port. Set to 15 on the Pixhawk for the analog 'airspeed' port." VALUE 0x36100000 Scalar_FLOAT32_IEEE 0 CM_RNGFND_PIN -1.0 64.0 /end CHARACTERISTIC
/begin CHARACTERISTIC RNGFND_SCALING "Rangefinder scaling, Scaling factor between rangefinder reading and distance. For the linear and inverted functions this is in meters per volt. For the hyperbolic function the units are meterVolts." VALUE 0x36100000 Scalar_FLOAT32_IEEE 0 METERS_PER_VOLT -3.40282e+38 3.40282e+38 /end CHARACTERISTIC
/begin CHARACTERISTIC RNGFND_OFFSET "rangefinder offset, Offset in volts for zero distance for analog rangefinders. Offset added to distance in centimeters for PWM and I2C Lidars" VALUE 0x36100000 Scalar_FLOAT32_IEEE 0 VOLT -3.40282e+38 3.40282e+38 /end CHARACTERISTIC
/begin COMPU_METHOD CM_RNGFND_FUNCTION "Rangefinder function" TAB_VERB "%17.6" "" COMPU_TAB_REF TAB_RNGFND_FUNCTION /end COMPU_METHOD
/begin COMPU_VTAB TAB_RNGFND_FUNCTION "Rangefinder function, Control over what function is used to calculate distance. For a linear function, the distance is (voltage-offset)*scaling. For a inverted function the distance is (offset-voltage)*scaling. For a hyperbolic function the distance is scaling/(voltage-offset). The functions return the distance in meters." TAB_VERB 3 0 "Linear" 1 "Inverted" 2 "Hyperbolic" /end COMPU_VTAB
/begin CHARACTERISTIC RNGFND_FUNCTION "Rangefinder function, Control over what function is used to calculate distance. For a linear function, the distance is (voltage-offset)*scaling. For a inverted function the distance is (offset-voltage)*scaling. For a hyperbolic function the distance is scaling/(voltage-offset). The functions return the distance in meters." VALUE 0x36100000 Scalar_FLOAT32_IEEE 0 CM_RNGFND_FUNCTION 0.0 2.0 /end CHARACTERISTIC
/begin CHARACTERISTIC RNGFND_MIN_CM "Rangefinder minimum distance, Minimum distance in centimeters that rangefinder can reliably read" VALUE 0x36100000 Scalar_FLOAT32_IEEE 0 CENTIMETERS -3.40282e+38 3.40282e+38 /end CHARACTERISTIC
/begin CHARACTERISTIC RNGFND_MAX_CM "Rangefinder maximum distance, Maximum distance in centimeters that rangefinder can reliably read" VALUE 0x36100000 Scalar_FLOAT32_IEEE 0 CENTIMETERS -3.40282e+38 3.40282e+38 /end CHARACTERISTIC
/begin COMPU_METHOD CM_RNGFND_STOP_PIN "Rangefinder stop pin" TAB_VERB "%17.6" "" COMPU_TAB_REF TAB_RNGFND_STOP_PIN /end COMPU_METHOD
/begin COMPU_VTAB TAB_RNGFND_STOP_PIN "Rangefinder stop pin, Digital pin that enables/disables rangefinder measurement for an analog rangefinder. A value of -1 means no pin. If this is set, then the pin is set to 1 to enable the rangefinder and set to 0 to disable it. This can be used to ensure that multiple sonar rangefinders don't interfere with each other." TAB_VERB 13 -1 "Not Used" 50 "Pixhawk AUXOUT1" 51 "Pixhawk AUXOUT2" 52 "Pixhawk AUXOUT3" 53 "Pixhawk AUXOUT4" 54 "Pixhawk AUXOUT5" 55 "Pixhawk AUXOUT6" 111 "PX4 FMU Relay1" 112 "PX4 FMU Relay2" 113 "PX4IO Relay1" 114 "PX4IO Relay2" 115 "PX4IO ACC1" 116 "PX4IO ACC2" /end COMPU_VTAB
/begin CHARACTERISTIC RNGFND_STOP_PIN "Rangefinder stop pin, Digital pin that enables/disables rangefinder measurement for an analog rangefinder. A value of -1 means no pin. If this is set, then the pin is set to 1 to enable the rangefinder and set to 0 to disable it. This can be used to ensure that multiple sonar rangefinders don't interfere with each other." VALUE 0x36100000 Scalar_FLOAT32_IEEE 0 CM_RNGFND_STOP_PIN -1.0 116.0 /end CHARACTERISTIC
/begin CHARACTERISTIC RNGFND_SETTLE "Rangefinder settle time, The time in milliseconds that the rangefinder reading takes to settle. This is only used when a STOP_PIN is specified. It determines how long we have to wait for the rangefinder to give a reading after we set the STOP_PIN high. For a sonar rangefinder with a range of around 7m this would need to be around 50 milliseconds to allow for the sonar pulse to travel to the target and back again." VALUE 0x36100000 Scalar_FLOAT32_IEEE 0 MILLISECONDS -3.40282e+38 3.40282e+38 /end CHARACTERISTIC
/begin COMPU_METHOD CM_RNGFND_RMETRIC "Ratiometric" TAB_VERB "%17.6" "" COMPU_TAB_REF TAB_RNGFND_RMETRIC /end COMPU_METHOD
/begin COMPU_VTAB TAB_RNGFND_RMETRIC "Ratiometric, This parameter sets whether an analog rangefinder is ratiometric. Most analog rangefinders are ratiometric, meaning that their output voltage is influenced by the supply voltage. Some analog rangefinders (such as the SF/02) have their own internal voltage regulators so they are not ratiometric." TAB_VERB 2 0 "No" 1 "Yes" /end COMPU_VTAB
/begin CHARACTERISTIC RNGFND_RMETRIC "Ratiometric, This parameter sets whether an analog rangefinder is ratiometric. Most analog rangefinders are ratiometric, meaning that their output voltage is influenced by the supply voltage. Some analog rangefinders (such as the SF/02) have their own internal voltage regulators so they are not ratiometric." VALUE 0x36100000 Scalar_FLOAT32_IEEE 0 CM_RNGFND_RMETRIC 0.0 1.0 /end CHARACTERISTIC
/begin CHARACTERISTIC RNGFND_PWRRNG "Powersave range, This parameter sets the estimated terrain distance in meters above which the sensor will be put into a power saving mode (if available). A value of zero means power saving is not enabled" VALUE 0x36100000 Scalar_FLOAT32_IEEE 0 METERS 0.0 32767.0 /end CHARACTERISTIC
/begin CHARACTERISTIC RNGFND_GNDCLEAR "Distance (in cm) from the range finder to the ground, This parameter sets the expected range measurement(in cm) that the range finder should return when the vehicle is on the ground." VALUE 0x36100000 Scalar_FLOAT32_IEEE 0 CENTIMETERS 0.0 127.0 /end CHARACTERISTIC
/begin CHARACTERISTIC RNGFND_ADDR "Bus address of sensor, This sets the bus address of the sensor, where applicable. Used for the LightWare I2C sensor to allow for multiple sensors on different addresses. A value of 0 disables the sensor." VALUE 0x36100000 Scalar_FLOAT32_IEEE 0 IDENTICAL 0.0 127.0 /end CHARACTERISTIC
/begin COMPU_METHOD CM_RNGFND2_TYPE "Second Rangefinder type" TAB_VERB "%17.6" "" COMPU_TAB_REF TAB_RNGFND2_TYPE /end COMPU_METHOD
/begin COMPU_VTAB TAB_RNGFND2_TYPE "Second Rangefinder type, What type of rangefinder device that is connected" TAB_VERB 11 0 "None" 1 "Analog" 2 "APM2-MaxbotixI2C" 3 "APM2-PulsedLightI2C" 4 "PX4-I2C" 5 "PX4-PWM" 6 "BBB-PRU" 7 "LightWareI2C" 8 "LightWareSerial" 9 "Bebop" 10 "MAVLink" /end COMPU_VTAB
/begin CHARACTERISTIC RNGFND2_TYPE "Second Rangefinder type, What type of rangefinder device that is connected" VALUE 0x36100000 Scalar_FLOAT32_IEEE 0 CM_RNGFND2_TYPE 0.0 10.0 /end CHARACTERISTIC
/begin COMPU_METHOD CM_RNGFND2_PIN "Rangefinder pin" TAB_VERB "%17.6" "" COMPU_TAB_REF TAB_RNGFND2_PIN /end COMPU_METHOD
/begin COMPU_VTAB TAB_RNGFND2_PIN "Rangefinder pin, Analog pin that rangefinder is connected to. Set this to 0..9 for the APM2 analog pins. Set to 64 on an APM1 for the dedicated 'airspeed' port on the end of the board. Set to 11 on PX4 for the analog 'airspeed' port. Set to 15 on the Pixhawk for the analog 'airspeed' port." TAB_VERB 14 -1 "Not Used" 0 "APM2-A0" 1 "APM2-A1" 2 "APM2-A2" 3 "APM2-A3" 4 "APM2-A4" 5 "APM2-A5" 6 "APM2-A6" 7 "APM2-A7" 8 "APM2-A8" 9 "APM2-A9" 11 "PX4-airspeed port" 15 "Pixhawk-airspeed port" 64 "APM1-airspeed port" /end COMPU_VTAB
/begin CHARACTERISTIC RNGFND2_PIN "Rangefinder pin, Analog pin that rangefinder is connected to. Set this to 0..9 for the APM2 analog pins. Set to 64 on an APM1 for the dedicated 'airspeed' port on the end of the board. Set to 11 on PX4 for the analog 'airspeed' port. Set to 15 on the Pixhawk for the analog 'airspeed' port." VALUE 0x36100000 Scalar_FLOAT32_IEEE 0 CM_RNGFND2_PIN -1.0 64.0 /end CHARACTERISTIC
/begin CHARACTERISTIC RNGFND2_SCALING "Rangefinder scaling, Scaling factor between rangefinder reading and distance. For the linear and inverted functions this is in meters per volt. For the hyperbolic function the units are meterVolts." VALUE 0x36100000 Scalar_FLOAT32_IEEE 0 METERS_PER_VOLT -3.40282e+38 3.40282e+38 /end CHARACTERISTIC
/begin CHARACTERISTIC RNGFND2_OFFSET "rangefinder offset, Offset in volts for zero distance" VALUE 0x36100000 Scalar_FLOAT32_IEEE 0 VOLT -3.40282e+38 3.40282e+38 /end CHARACTERISTIC
/begin COMPU_METHOD CM_RNGFND2_FUNCTION "Rangefinder function" TAB_VERB "%17.6" "" COMPU_TAB_REF TAB_RNGFND2_FUNCTION /end COMPU_METHOD
/begin COMPU_VTAB TAB_RNGFND2_FUNCTION "Rangefinder function, Control over what function is used to calculate distance. For a linear function, the distance is (voltage-offset)*scaling. For a inverted function the distance is (offset-voltage)*scaling. For a hyperbolic function the distance is scaling/(voltage-offset). The functions return the distance in meters." TAB_VERB 3 0 "Linear" 1 "Inverted" 2 "Hyperbolic" /end COMPU_VTAB
/begin CHARACTERISTIC RNGFND2_FUNCTION "Rangefinder function, Control over what function is used to calculate distance. For a linear function, the distance is (voltage-offset)*scaling. For a inverted function the distance is (offset-voltage)*scaling. For a hyperbolic function the distance is scaling/(voltage-offset). The functions return the distance in meters." VALUE 0x36100000 Scalar_FLOAT32_IEEE 0 CM_RNGFND2_FUNCTION 0.0 2.0 /end CHARACTERISTIC
/begin CHARACTERISTIC RNGFND2_MIN_CM "Rangefinder minimum distance, Minimum distance in centimeters that rangefinder can reliably read" VALUE 0x36100000 Scalar_FLOAT32_IEEE 0 CENTIMETERS -3.40282e+38 3.40282e+38 /end CHARACTERISTIC
/begin CHARACTERISTIC RNGFND2_MAX_CM "Rangefinder maximum distance, Maximum distance in centimeters that rangefinder can reliably read" VALUE 0x36100000 Scalar_FLOAT32_IEEE 0 CENTIMETERS -3.40282e+38 3.40282e+38 /end CHARACTERISTIC
/begin COMPU_METHOD CM_RNGFND2_STOP_PIN "Rangefinder stop pin" TAB_VERB "%17.6" "" COMPU_TAB_REF TAB_RNGFND2_STOP_PIN /end COMPU_METHOD
/begin COMPU_VTAB TAB_RNGFND2_STOP_PIN "Rangefinder stop pin, Digital pin that enables/disables rangefinder measurement for an analog rangefinder. A value of -1 means no pin. If this is set, then the pin is set to 1 to enable the rangefinder and set to 0 to disable it. This can be used to ensure that multiple sonar rangefinders don't interfere with each other." TAB_VERB 13 -1 "Not Used" 50 "Pixhawk AUXOUT1" 51 "Pixhawk AUXOUT2" 52 "Pixhawk AUXOUT3" 53 "Pixhawk AUXOUT4" 54 "Pixhawk AUXOUT5" 55 "Pixhawk AUXOUT6" 111 "PX4 FMU Relay1" 112 "PX4 FMU Relay2" 113 "PX4IO Relay1" 114 "PX4IO Relay2" 115 "PX4IO ACC1" 116 "PX4IO ACC2" /end COMPU_VTAB
/begin CHARACTERISTIC RNGFND2_STOP_PIN "Rangefinder stop pin, Digital pin that enables/disables rangefinder measurement for an analog rangefinder. A value of -1 means no pin. If this is set, then the pin is set to 1 to enable the rangefinder and set to 0 to disable it. This can be used to ensure that multiple sonar rangefinders don't interfere with each other." VALUE 0x36100000 Scalar_FLOAT32_IEEE 0 CM_RNGFND2_STOP_PIN -1.0 116.0 /end CHARACTERISTIC
/begin CHARACTERISTIC RNGFND2_SETTLE "Sonar settle time, The time in milliseconds that the rangefinder reading takes to settle. This is only used when a STOP_PIN is specified. It determines how long we have to wait for the rangefinder to give a reading after we set the STOP_PIN high. For a sonar rangefinder with a range of around 7m this would need to be around 50 milliseconds to allow for the sonar pulse to travel to the target and back again." VALUE 0x36100000 Scalar_FLOAT32_IEEE 0 MILLISECONDS -3.40282e+38 3.40282e+38 /end CHARACTERISTIC
/begin COMPU_METHOD CM_RNGFND2_RMETRIC "Ratiometric" TAB_VERB "%17.6" "" COMPU_TAB_REF TAB_RNGFND2_RMETRIC /end COMPU_METHOD
/begin COMPU_VTAB TAB_RNGFND2_RMETRIC "Ratiometric, This parameter sets whether an analog rangefinder is ratiometric. Most analog rangefinders are ratiometric, meaning that their output voltage is influenced by the supply voltage. Some analog rangefinders (such as the SF/02) have their own internal voltage regulators so they are not ratiometric." TAB_VERB 2 0 "No" 1 "Yes" /end COMPU_VTAB
/begin CHARACTERISTIC RNGFND2_RMETRIC "Ratiometric, This parameter sets whether an analog rangefinder is ratiometric. Most analog rangefinders are ratiometric, meaning that their output voltage is influenced by the supply voltage. Some analog rangefinders (such as the SF/02) have their own internal voltage regulators so they are not ratiometric." VALUE 0x36100000 Scalar_FLOAT32_IEEE 0 CM_RNGFND2_RMETRIC 0.0 1.0 /end CHARACTERISTIC
/begin CHARACTERISTIC RNGFND2_GNDCLEAR "Distance (in cm) from the second range finder to the ground, This parameter sets the expected range measurement(in cm) that the second range finder should return when the vehicle is on the ground." VALUE 0x36100000 Scalar_FLOAT32_IEEE 0 CENTIMETERS 0.0 127.0 /end CHARACTERISTIC
/begin CHARACTERISTIC RNGFND2_ADDR "Bus address of second rangefinder, This sets the bus address of the sensor, where applicable. Used for the LightWare I2C sensor to allow for multiple sensors on different addresses. A value of 0 disables the sensor." VALUE 0x36100000 Scalar_FLOAT32_IEEE 0 IDENTICAL 0.0 127.0 /end CHARACTERISTIC
/begin COMPU_METHOD CM_RNGFND3_TYPE "Third Rangefinder type" TAB_VERB "%17.6" "" COMPU_TAB_REF TAB_RNGFND3_TYPE /end COMPU_METHOD
/begin COMPU_VTAB TAB_RNGFND3_TYPE "Third Rangefinder type, What type of rangefinder device that is connected" TAB_VERB 11 0 "None" 1 "Analog" 2 "APM2-MaxbotixI2C" 3 "APM2-PulsedLightI2C" 4 "PX4-I2C" 5 "PX4-PWM" 6 "BBB-PRU" 7 "LightWareI2C" 8 "LightWareSerial" 9 "Bebop" 10 "MAVLink" /end COMPU_VTAB
/begin CHARACTERISTIC RNGFND3_TYPE "Third Rangefinder type, What type of rangefinder device that is connected" VALUE 0x36100000 Scalar_FLOAT32_IEEE 0 CM_RNGFND3_TYPE 0.0 10.0 /end CHARACTERISTIC
/begin COMPU_METHOD CM_RNGFND3_PIN "Rangefinder pin" TAB_VERB "%17.6" "" COMPU_TAB_REF TAB_RNGFND3_PIN /end COMPU_METHOD
/begin COMPU_VTAB TAB_RNGFND3_PIN "Rangefinder pin, Analog pin that rangefinder is connected to. Set this to 0..9 for the APM2 analog pins. Set to 64 on an APM1 for the dedicated 'airspeed' port on the end of the board. Set to 11 on PX4 for the analog 'airspeed' port. Set to 15 on the Pixhawk for the analog 'airspeed' port." TAB_VERB 14 -1 "Not Used" 0 "APM2-A0" 1 "APM2-A1" 2 "APM2-A2" 3 "APM2-A3" 4 "APM2-A4" 5 "APM2-A5" 6 "APM2-A6" 7 "APM2-A7" 8 "APM2-A8" 9 "APM2-A9" 11 "PX4-airspeed port" 15 "Pixhawk-airspeed port" 64 "APM1-airspeed port" /end COMPU_VTAB
/begin CHARACTERISTIC RNGFND3_PIN "Rangefinder pin, Analog pin that rangefinder is connected to. Set this to 0..9 for the APM2 analog pins. Set to 64 on an APM1 for the dedicated 'airspeed' port on the end of the board. Set to 11 on PX4 for the analog 'airspeed' port. Set to 15 on the Pixhawk for the analog 'airspeed' port." VALUE 0x36100000 Scalar_FLOAT32_IEEE 0 CM_RNGFND3_PIN -1.0 64.0 /end CHARACTERISTIC
/begin CHARACTERISTIC RNGFND3_SCALING "Rangefinder scaling, Scaling factor between rangefinder reading and distance. For the linear and inverted functions this is in meters per volt. For the hyperbolic function the units are meterVolts." VALUE 0x36100000 Scalar_FLOAT32_IEEE 0 METERS_PER_VOLT -3.40282e+38 3.40282e+38 /end CHARACTERISTIC
/begin CHARACTERISTIC RNGFND3_OFFSET "rangefinder offset, Offset in volts for zero distance" VALUE 0x36100000 Scalar_FLOAT32_IEEE 0 VOLT -3.40282e+38 3.40282e+38 /end CHARACTERISTIC
/begin COMPU_METHOD CM_RNGFND3_FUNCTION "Rangefinder function" TAB_VERB "%17.6" "" COMPU_TAB_REF TAB_RNGFND3_FUNCTION /end COMPU_METHOD
/begin COMPU_VTAB TAB_RNGFND3_FUNCTION "Rangefinder function, Control over what function is used to calculate distance. For a linear function, the distance is (voltage-offset)*scaling. For a inverted function the distance is (offset-voltage)*scaling. For a hyperbolic function the distance is scaling/(voltage-offset). The functions return the distance in meters." TAB_VERB 3 0 "Linear" 1 "Inverted" 2 "Hyperbolic" /end COMPU_VTAB
/begin CHARACTERISTIC RNGFND3_FUNCTION "Rangefinder function, Control over what function is used to calculate distance. For a linear function, the distance is (voltage-offset)*scaling. For a inverted function the distance is (offset-voltage)*scaling. For a hyperbolic function the distance is scaling/(voltage-offset). The functions return the distance in meters." VALUE 0x36100000 Scalar_FLOAT32_IEEE 0 CM_RNGFND3_FUNCTION 0.0 2.0 /end CHARACTERISTIC
/begin CHARACTERISTIC RNGFND3_MIN_CM "Rangefinder minimum distance, Minimum distance in centimeters that rangefinder can reliably read" VALUE 0x36100000 Scalar_FLOAT32_IEEE 0 CENTIMETERS -3.40282e+38 3.40282e+38 /end CHARACTERISTIC
/begin CHARACTERISTIC RNGFND3_MAX_CM "Rangefinder maximum distance, Maximum distance in centimeters that rangefinder can reliably read" VALUE 0x36100000 Scalar_FLOAT32_IEEE 0 CENTIMETERS -3.40282e+38 3.40282e+38 /end CHARACTERISTIC
/begin COMPU_METHOD CM_RNGFND3_STOP_PIN "Rangefinder stop pin" TAB_VERB "%17.6" "" COMPU_TAB_REF TAB_RNGFND3_STOP_PIN /end COMPU_METHOD
/begin COMPU_VTAB TAB_RNGFND3_STOP_PIN "Rangefinder stop pin, Digital pin that enables/disables rangefinder measurement for an analog rangefinder. A value of -1 means no pin. If this is set, then the pin is set to 1 to enable the rangefinder and set to 0 to disable it. This can be used to ensure that multiple sonar rangefinders don't interfere with each other." TAB_VERB 13 -1 "Not Used" 50 "Pixhawk AUXOUT1" 51 "Pixhawk AUXOUT2" 52 "Pixhawk AUXOUT3" 53 "Pixhawk AUXOUT4" 54 "Pixhawk AUXOUT5" 55 "Pixhawk AUXOUT6" 111 "PX4 FMU Relay1" 112 "PX4 FMU Relay2" 113 "PX4IO Relay1" 114 "PX4IO Relay2" 115 "PX4IO ACC1" 116 "PX4IO ACC2" /end COMPU_VTAB
/begin CHARACTERISTIC RNGFND3_STOP_PIN "Rangefinder stop pin, Digital pin that enables/disables rangefinder measurement for an analog rangefinder. A value of -1 means no pin. If this is set, then the pin is set to 1 to enable the rangefinder and set to 0 to disable it. This can be used to ensure that multiple sonar rangefinders don't interfere with each other." VALUE 0x36100000 Scalar_FLOAT32_IEEE 0 CM_RNGFND3_STOP_PIN -1.0 116.0 /end CHARACTERISTIC
/begin CHARACTERISTIC RNGFND3_SETTLE "Sonar settle time, The time in milliseconds that the rangefinder reading takes to settle. This is only used when a STOP_PIN is specified. It determines how long we have to wait for the rangefinder to give a reading after we set the STOP_PIN high. For a sonar rangefinder with a range of around 7m this would need to be around 50 milliseconds to allow for the sonar pulse to travel to the target and back again." VALUE 0x36100000 Scalar_FLOAT32_IEEE 0 MILLISECONDS -3.40282e+38 3.40282e+38 /end CHARACTERISTIC
/begin COMPU_METHOD CM_RNGFND3_RMETRIC "Ratiometric" TAB_VERB "%17.6" "" COMPU_TAB_REF TAB_RNGFND3_RMETRIC /end COMPU_METHOD
/begin COMPU_VTAB TAB_RNGFND3_RMETRIC "Ratiometric, This parameter sets whether an analog rangefinder is ratiometric. Most analog rangefinders are ratiometric, meaning that their output voltage is influenced by the supply voltage. Some analog rangefinders (such as the SF/02) have their own internal voltage regulators so they are not ratiometric." TAB_VERB 2 0 "No" 1 "Yes" /end COMPU_VTAB
/begin CHARACTERISTIC RNGFND3_RMETRIC "Ratiometric, This parameter sets whether an analog rangefinder is ratiometric. Most analog rangefinders are ratiometric, meaning that their output voltage is influenced by the supply voltage. Some analog rangefinders (such as the SF/02) have their own internal voltage regulators so they are not ratiometric." VALUE 0x36100000 Scalar_FLOAT32_IEEE 0 CM_RNGFND3_RMETRIC 0.0 1.0 /end CHARACTERISTIC
/begin CHARACTERISTIC RNGFND3_GNDCLEAR "Distance (in cm) from the third range finder to the ground, This parameter sets the expected range measurement(in cm) that the third range finder should return when the vehicle is on the ground." VALUE 0x36100000 Scalar_FLOAT32_IEEE 0 CENTIMETERS 0.0 127.0 /end CHARACTERISTIC
/begin CHARACTERISTIC RNGFND3_ADDR "Bus address of third rangefinder, This sets the bus address of the sensor, where applicable. Used for the LightWare I2C sensor to allow for multiple sensors on different addresses. A value of 0 disables the sensor." VALUE 0x36100000 Scalar_FLOAT32_IEEE 0 IDENTICAL 0.0 127.0 /end CHARACTERISTIC
/begin COMPU_METHOD CM_RNGFND4_TYPE "Fourth Rangefinder type" TAB_VERB "%17.6" "" COMPU_TAB_REF TAB_RNGFND4_TYPE /end COMPU_METHOD
/begin COMPU_VTAB TAB_RNGFND4_TYPE "Fourth Rangefinder type, What type of rangefinder device that is connected" TAB_VERB 11 0 "None" 1 "Analog" 2 "APM2-MaxbotixI2C" 3 "APM2-PulsedLightI2C" 4 "PX4-I2C" 5 "PX4-PWM" 6 "BBB-PRU" 7 "LightWareI2C" 8 "LightWareSerial" 9 "Bebop" 10 "MAVLink" /end COMPU_VTAB
/begin CHARACTERISTIC RNGFND4_TYPE "Fourth Rangefinder type, What type of rangefinder device that is connected" VALUE 0x36100000 Scalar_FLOAT32_IEEE 0 CM_RNGFND4_TYPE 0.0 10.0 /end CHARACTERISTIC
/begin COMPU_METHOD CM_RNGFND4_PIN "Rangefinder pin" TAB_VERB "%17.6" "" COMPU_TAB_REF TAB_RNGFND4_PIN /end COMPU_METHOD
/begin COMPU_VTAB TAB_RNGFND4_PIN "Rangefinder pin, Analog pin that rangefinder is connected to. Set this to 0..9 for the APM2 analog pins. Set to 64 on an APM1 for the dedicated 'airspeed' port on the end of the board. Set to 11 on PX4 for the analog 'airspeed' port. Set to 15 on the Pixhawk for the analog 'airspeed' port." TAB_VERB 14 -1 "Not Used" 0 "APM2-A0" 1 "APM2-A1" 2 "APM2-A2" 3 "APM2-A3" 4 "APM2-A4" 5 "APM2-A5" 6 "APM2-A6" 7 "APM2-A7" 8 "APM2-A8" 9 "APM2-A9" 11 "PX4-airspeed port" 15 "Pixhawk-airspeed port" 64 "APM1-airspeed port" /end COMPU_VTAB
/begin CHARACTERISTIC RNGFND4_PIN "Rangefinder pin, Analog pin that rangefinder is connected to. Set this to 0..9 for the APM2 analog pins. Set to 64 on an APM1 for the dedicated 'airspeed' port on the end of the board. Set to 11 on PX4 for the analog 'airspeed' port. Set to 15 on the Pixhawk for the analog 'airspeed' port." VALUE 0x36100000 Scalar_FLOAT32_IEEE 0 CM_RNGFND4_PIN -1.0 64.0 /end CHARACTERISTIC
/begin CHARACTERISTIC RNGFND4_SCALING "Rangefinder scaling, Scaling factor between rangefinder reading and distance. For the linear and inverted functions this is in meters per volt. For the hyperbolic function the units are meterVolts." VALUE 0x36100000 Scalar_FLOAT32_IEEE 0 METERS_PER_VOLT -3.40282e+38 3.40282e+38 /end CHARACTERISTIC
/begin CHARACTERISTIC RNGFND4_OFFSET "rangefinder offset, Offset in volts for zero distance" VALUE 0x36100000 Scalar_FLOAT32_IEEE 0 VOLT -3.40282e+38 3.40282e+38 /end CHARACTERISTIC
/begin COMPU_METHOD CM_RNGFND4_FUNCTION "Rangefinder function" TAB_VERB "%17.6" "" COMPU_TAB_REF TAB_RNGFND4_FUNCTION /end COMPU_METHOD
/begin COMPU_VTAB TAB_RNGFND4_FUNCTION "Rangefinder function, Control over what function is used to calculate distance. For a linear function, the distance is (voltage-offset)*scaling. For a inverted function the distance is (offset-voltage)*scaling. For a hyperbolic function the distance is scaling/(voltage-offset). The functions return the distance in meters." TAB_VERB 3 0 "Linear" 1 "Inverted" 2 "Hyperbolic" /end COMPU_VTAB
/begin CHARACTERISTIC RNGFND4_FUNCTION "Rangefinder function, Control over what function is used to calculate distance. For a linear function, the distance is (voltage-offset)*scaling. For a inverted function the distance is (offset-voltage)*scaling. For a hyperbolic function the distance is scaling/(voltage-offset). The functions return the distance in meters." VALUE 0x36100000 Scalar_FLOAT32_IEEE 0 CM_RNGFND4_FUNCTION 0.0 2.0 /end CHARACTERISTIC
/begin CHARACTERISTIC RNGFND4_MIN_CM "Rangefinder minimum distance, Minimum distance in centimeters that rangefinder can reliably read" VALUE 0x36100000 Scalar_FLOAT32_IEEE 0 CENTIMETERS -3.40282e+38 3.40282e+38 /end CHARACTERISTIC
/begin CHARACTERISTIC RNGFND4_MAX_CM "Rangefinder maximum distance, Maximum distance in centimeters that rangefinder can reliably read" VALUE 0x36100000 Scalar_FLOAT32_IEEE 0 CENTIMETERS -3.40282e+38 3.40282e+38 /end CHARACTERISTIC
/begin COMPU_METHOD CM_RNGFND4_STOP_PIN "Rangefinder stop pin" TAB_VERB "%17.6" "" COMPU_TAB_REF TAB_RNGFND4_STOP_PIN /end COMPU_METHOD
/begin COMPU_VTAB TAB_RNGFND4_STOP_PIN "Rangefinder stop pin, Digital pin that enables/disables rangefinder measurement for an analog rangefinder. A value of -1 means no pin. If this is set, then the pin is set to 1 to enable the rangefinder and set to 0 to disable it. This can be used to ensure that multiple sonar rangefinders don't interfere with each other." TAB_VERB 13 -1 "Not Used" 50 "Pixhawk AUXOUT1" 51 "Pixhawk AUXOUT2" 52 "Pixhawk AUXOUT3" 53 "Pixhawk AUXOUT4" 54 "Pixhawk AUXOUT5" 55 "Pixhawk AUXOUT6" 111 "PX4 FMU Relay1" 112 "PX4 FMU Relay2" 113 "PX4IO Relay1" 114 "PX4IO Relay2" 115 "PX4IO ACC1" 116 "PX4IO ACC2" /end COMPU_VTAB
/begin CHARACTERISTIC RNGFND4_STOP_PIN "Rangefinder stop pin, Digital pin that enables/disables rangefinder measurement for an analog rangefinder. A value of -1 means no pin. If this is set, then the pin is set to 1 to enable the rangefinder and set to 0 to disable it. This can be used to ensure that multiple sonar rangefinders don't interfere with each other." VALUE 0x36100000 Scalar_FLOAT32_IEEE 0 CM_RNGFND4_STOP_PIN -1.0 116.0 /end CHARACTERISTIC
/begin CHARACTERISTIC RNGFND4_SETTLE "Sonar settle time, The time in milliseconds that the rangefinder reading takes to settle. This is only used when a STOP_PIN is specified. It determines how long we have to wait for the rangefinder to give a reading after we set the STOP_PIN high. For a sonar rangefinder with a range of around 7m this would need to be around 50 milliseconds to allow for the sonar pulse to travel to the target and back again." VALUE 0x36100000 Scalar_FLOAT32_IEEE 0 MILLISECONDS -3.40282e+38 3.40282e+38 /end CHARACTERISTIC
/begin COMPU_METHOD CM_RNGFND4_RMETRIC "Ratiometric" TAB_VERB "%17.6" "" COMPU_TAB_REF TAB_RNGFND4_RMETRIC /end COMPU_METHOD
/begin COMPU_VTAB TAB_RNGFND4_RMETRIC "Ratiometric, This parameter sets whether an analog rangefinder is ratiometric. Most analog rangefinders are ratiometric, meaning that their output voltage is influenced by the supply voltage. Some analog rangefinders (such as the SF/02) have their own internal voltage regulators so they are not ratiometric." TAB_VERB 2 0 "No" 1 "Yes" /end COMPU_VTAB
/begin CHARACTERISTIC RNGFND4_RMETRIC "Ratiometric, This parameter sets whether an analog rangefinder is ratiometric. Most analog rangefinders are ratiometric, meaning that their output voltage is influenced by the supply voltage. Some analog rangefinders (such as the SF/02) have their own internal voltage regulators so they are not ratiometric." VALUE 0x36100000 Scalar_FLOAT32_IEEE 0 CM_RNGFND4_RMETRIC 0.0 1.0 /end CHARACTERISTIC
/begin CHARACTERISTIC RNGFND4_GNDCLEAR "Distance (in cm) from the fourth range finder to the ground, This parameter sets the expected range measurement(in cm) that the fourth range finder should return when the vehicle is on the ground." VALUE 0x36100000 Scalar_FLOAT32_IEEE 0 CENTIMETERS 0.0 127.0 /end CHARACTERISTIC
/begin CHARACTERISTIC RNGFND4_ADDR "Bus address of fourth rangefinder, This sets the bus address of the sensor, where applicable. Used for the LightWare I2C sensor to allow for multiple sensors on different addresses. A value of 0 disables the sensor." VALUE 0x36100000 Scalar_FLOAT32_IEEE 0 IDENTICAL 0.0 127.0 /end CHARACTERISTIC
/begin COMPU_METHOD CM_TERRAIN_ENABLE "Terrain data enable" TAB_VERB "%17.6" "" COMPU_TAB_REF TAB_TERRAIN_ENABLE /end COMPU_METHOD
/begin COMPU_VTAB TAB_TERRAIN_ENABLE "Terrain data enable, enable terrain data. This enables the vehicle storing a database of terrain data on the SD card. The terrain data is requested from the ground station as needed, and stored for later use on the SD card. To be useful the ground station must support TERRAIN_REQUEST messages and have access to a terrain database, such as the SRTM database." TAB_VERB 2 0 "Disable" 1 "Enable" /end COMPU_VTAB
/begin CHARACTERISTIC TERRAIN_ENABLE "Terrain data enable, enable terrain data. This enables the vehicle storing a database of terrain data on the SD card. The terrain data is requested from the ground station as needed, and stored for later use on the SD card. To be useful the ground station must support TERRAIN_REQUEST messages and have access to a terrain database, such as the SRTM database." VALUE 0x36100000 Scalar_FLOAT32_IEEE 0 CM_TERRAIN_ENABLE 0.0 1.0 /end CHARACTERISTIC
/begin CHARACTERISTIC TERRAIN_SPACING "Terrain grid spacing, Distance between terrain grid points in meters. This controls the horizontal resolution of the terrain data that is stored on te SD card and requested from the ground station. If your GCS is using the worldwide SRTM database then a resolution of 100 meters is appropriate. Some parts of the world may have higher resolution data available, such as 30 meter data available in the SRTM database in the USA. The grid spacing also controls how much data is kept in memory during flight. A larger grid spacing will allow for a larger amount of data in memory. A grid spacing of 100 meters results in the vehicle keeping 12 grid squares in memory with each grid square having a size of 2.7 kilometers by 3.2 kilometers. Any additional grid squares are stored on the SD once they are fetched from the GCS and will be demand loaded as needed." VALUE 0x36100000 Scalar_FLOAT32_IEEE 0 METERS -3.40282e+38 3.40282e+38 /end CHARACTERISTIC
/begin COMPU_METHOD CM_FLOW_ENABLE "Optical flow enable/disable" TAB_VERB "%17.6" "" COMPU_TAB_REF TAB_FLOW_ENABLE /end COMPU_METHOD
/begin COMPU_VTAB TAB_FLOW_ENABLE "Optical flow enable/disable, Setting this to Enabled(1) will enable optical flow. Setting this to Disabled(0) will disable optical flow" TAB_VERB 2 0 "Disabled" 1 "Enabled" /end COMPU_VTAB
/begin CHARACTERISTIC FLOW_ENABLE "Optical flow enable/disable, Setting this to Enabled(1) will enable optical flow. Setting this to Disabled(0) will disable optical flow" VALUE 0x36100000 Scalar_FLOAT32_IEEE 0 CM_FLOW_ENABLE 0.0 1.0 /end CHARACTERISTIC
/begin CHARACTERISTIC FLOW_FXSCALER "X axis optical flow scale factor correction, This sets the parts per thousand scale factor correction applied to the flow sensor X axis optical rate. It can be used to correct for variations in effective focal length. Each positive increment of 1 increases the scale factor applied to the X axis optical flow reading by 0.1%. Negative values reduce the scale factor." VALUE 0x36100000 Scalar_FLOAT32_IEEE 0 IDENTICAL -200.0 200.0 /end CHARACTERISTIC
/begin CHARACTERISTIC FLOW_FYSCALER "Y axis optical flow scale factor correction, This sets the parts per thousand scale factor correction applied to the flow sensor Y axis optical rate. It can be used to correct for variations in effective focal length. Each positive increment of 1 increases the scale factor applied to the Y axis optical flow reading by 0.1%. Negative values reduce the scale factor." VALUE 0x36100000 Scalar_FLOAT32_IEEE 0 IDENTICAL -200.0 200.0 /end CHARACTERISTIC
/begin CHARACTERISTIC FLOW_ORIENT_YAW "Flow sensor yaw alignment, Specifies the number of centi-degrees that the flow sensor is yawed relative to the vehicle. A sensor with its X-axis pointing to the right of the vehicle X axis has a positive yaw angle." VALUE 0x36100000 Scalar_FLOAT32_IEEE 0 IDENTICAL -18000.0 18000.0 /end CHARACTERISTIC
/begin COMPU_METHOD CM_PLND_ENABLED "Precision Land enabled/disabled and behaviour" TAB_VERB "%17.6" "" COMPU_TAB_REF TAB_PLND_ENABLED /end COMPU_METHOD
/begin COMPU_VTAB TAB_PLND_ENABLED "Precision Land enabled/disabled and behaviour, Precision Land enabled/disabled and behaviour" TAB_VERB 3 0 "Disabled" 1 "Enabled Always Land" 2 "Enabled Strict" /end COMPU_VTAB
/begin CHARACTERISTIC PLND_ENABLED "Precision Land enabled/disabled and behaviour, Precision Land enabled/disabled and behaviour" VALUE 0x36100000 Scalar_FLOAT32_IEEE 0 CM_PLND_ENABLED 0.0 2.0 /end CHARACTERISTIC
/begin COMPU_METHOD CM_PLND_TYPE "Precision Land Type" TAB_VERB "%17.6" "" COMPU_TAB_REF TAB_PLND_TYPE /end COMPU_METHOD
/begin COMPU_VTAB TAB_PLND_TYPE "Precision Land Type, Precision Land Type" TAB_VERB 3 0 "None" 1 "CompanionComputer" 2 "IRLock" /end COMPU_VTAB
/begin CHARACTERISTIC PLND_TYPE "Precision Land Type, Precision Land Type" VALUE 0x36100000 Scalar_FLOAT32_IEEE 0 CM_PLND_TYPE 0.0 2.0 /end CHARACTERISTIC
/begin COMPU_METHOD CM_RPM_TYPE "RPM type" TAB_VERB "%17.6" "" COMPU_TAB_REF TAB_RPM_TYPE /end COMPU_METHOD
/begin COMPU_VTAB TAB_RPM_TYPE "RPM type, What type of RPM sensor is connected" TAB_VERB 2 0 "None" 1 "PX4-PWM" /end COMPU_VTAB
/begin CHARACTERISTIC RPM_TYPE "RPM type, What type of RPM sensor is connected" VALUE 0x36100000 Scalar_FLOAT32_IEEE 0 CM_RPM_TYPE 0.0 1.0 /end CHARACTERISTIC
/begin CHARACTERISTIC RPM_SCALING "RPM scaling, Scaling factor between sensor reading and RPM." VALUE 0x36100000 Scalar_FLOAT32_IEEE 0 IDENTICAL -3.40282e+38 3.40282e+38 /end CHARACTERISTIC
/begin CHARACTERISTIC RPM_MAX "Maximum RPM, Maximum RPM to report" VALUE 0x36100000 Scalar_FLOAT32_IEEE 0 IDENTICAL -3.40282e+38 3.40282e+38 /end CHARACTERISTIC
/begin CHARACTERISTIC RPM_MIN "Minimum RPM, Minimum RPM to report" VALUE 0x36100000 Scalar_FLOAT32_IEEE 0 IDENTICAL -3.40282e+38 3.40282e+38 /end CHARACTERISTIC
/begin CHARACTERISTIC RPM_MIN_QUAL "Minimum Quality, Minimum data quality to be used" VALUE 0x36100000 Scalar_FLOAT32_IEEE 0 IDENTICAL -3.40282e+38 3.40282e+38 /end CHARACTERISTIC
/begin COMPU_METHOD CM_RPM2_TYPE "Second RPM type" TAB_VERB "%17.6" "" COMPU_TAB_REF TAB_RPM2_TYPE /end COMPU_METHOD
/begin COMPU_VTAB TAB_RPM2_TYPE "Second RPM type, What type of RPM sensor is connected" TAB_VERB 2 0 "None" 1 "PX4-PWM" /end COMPU_VTAB
/begin CHARACTERISTIC RPM2_TYPE "Second RPM type, What type of RPM sensor is connected" VALUE 0x36100000 Scalar_FLOAT32_IEEE 0 CM_RPM2_TYPE 0.0 1.0 /end CHARACTERISTIC
/begin CHARACTERISTIC RPM2_SCALING "RPM scaling, Scaling factor between sensor reading and RPM." VALUE 0x36100000 Scalar_FLOAT32_IEEE 0 IDENTICAL -3.40282e+38 3.40282e+38 /end CHARACTERISTIC
/begin COMPU_METHOD CM_ADSB_ENABLE "Enable ADSB" TAB_VERB "%17.6" "" COMPU_TAB_REF TAB_ADSB_ENABLE /end COMPU_METHOD
/begin COMPU_VTAB TAB_ADSB_ENABLE "Enable ADSB, Enable ADS-B" TAB_VERB 2 0 "Disabled" 1 "Enabled" /end COMPU_VTAB
/begin CHARACTERISTIC ADSB_ENABLE "Enable ADSB, Enable ADS-B" VALUE 0x36100000 Scalar_FLOAT32_IEEE 0 CM_ADSB_ENABLE 0.0 1.0 /end CHARACTERISTIC
/begin CHARACTERISTIC ADSB_LIST_MAX "ADSB vehicle list size, ADSB list size of nearest vehicles. Longer lists take longer to refresh with lower SRx_ADSB values." VALUE 0x36100000 Scalar_FLOAT32_IEEE 0 IDENTICAL 1.0 100.0 /end CHARACTERISTIC
/begin CHARACTERISTIC ADSB_LIST_RADIUS "ADSB vehicle list radius filter, ADSB vehicle list radius filter. Vehicles detected outside this radius will be completely ignored. They will not show up in the SRx_ADSB stream to the GCS and will not be considered in any avoidance calculations." VALUE 0x36100000 Scalar_FLOAT32_IEEE 0 IDENTICAL 1.0 100000.0 /end CHARACTERISTIC
/begin CHARACTERISTIC ADSB_ICAO_ID "ICAO_ID vehicle identifaction number, ICAO_ID unique vehicle identifaction number of this aircraft. This is a integer limited to 24bits. If set to 0 then one will be randomly generated. If set to -1 then static information is not sent, transceiver is assumed pre-programmed." VALUE 0x36100000 Scalar_FLOAT32_IEEE 0 IDENTICAL -1.0 16777215.0 /end CHARACTERISTIC
/begin COMPU_METHOD CM_ADSB_EMIT_TYPE "Emitter type" TAB_VERB "%17.6" "" COMPU_TAB_REF TAB_ADSB_EMIT_TYPE /end COMPU_METHOD
/begin COMPU_VTAB TAB_ADSB_EMIT_TYPE "Emitter type, ADSB classification for the type of vehicle emitting the transponder signal. Default value is 14 (UAV)." TAB_VERB 20 0 "NoInfo" 1 "Light" 2 "Small" 3 "Large" 4 "HighVortexlarge" 5 "Heavy" 6 "HighlyManuv" 7 "Rotocraft" 8 "RESERVED" 9 "Glider" 10 "LightAir" 11 "Parachute" 12 "UltraLight" 13 "RESERVED" 14 "UAV" 15 "Space" 16 "RESERVED" 17 "EmergencySurface" 18 "ServiceSurface" 19 "PointObstacle" /end COMPU_VTAB
/begin CHARACTERISTIC ADSB_EMIT_TYPE "Emitter type, ADSB classification for the type of vehicle emitting the transponder signal. Default value is 14 (UAV)." VALUE 0x36100000 Scalar_FLOAT32_IEEE 0 CM_ADSB_EMIT_TYPE 0.0 19.0 /end CHARACTERISTIC
/begin COMPU_METHOD CM_ADSB_LEN_WIDTH "Aircraft length and width" TAB_VERB "%17.6" "" COMPU_TAB_REF TAB_ADSB_LEN_WIDTH /end COMPU_METHOD
/begin COMPU_VTAB TAB_ADSB_LEN_WIDTH "Aircraft length and width, Aircraft length and width dimension options in Length and Width in meters. In most cases, use a value of 1 for smallest size." TAB_VERB 16 0 "NO_DATA" 1 "L15W23" 2 "L25W28P5" 3 "L25W34" 4 "L35W33" 5 "L35W38" 6 "L45W39P5" 7 "L45W45" 8 "L55W45" 9 "L55W52" 10 "L65W59P5" 11 "L65W67" 12 "L75W72P5" 13 "L75W80" 14 "L85W80" 15 "L85W90" /end COMPU_VTAB
/begin CHARACTERISTIC ADSB_LEN_WIDTH "Aircraft length and width, Aircraft length and width dimension options in Length and Width in meters. In most cases, use a value of 1 for smallest size." VALUE 0x36100000 Scalar_FLOAT32_IEEE 0 CM_ADSB_LEN_WIDTH 0.0 15.0 /end CHARACTERISTIC
/begin COMPU_METHOD CM_ADSB_OFFSET_LAT "GPS antenna lateral offset" TAB_VERB "%17.6" "" COMPU_TAB_REF TAB_ADSB_OFFSET_LAT /end COMPU_METHOD
/begin COMPU_VTAB TAB_ADSB_OFFSET_LAT "GPS antenna lateral offset, GPS antenna lateral offset. This describes the physical location offest from center of the GPS antenna on the aircraft." TAB_VERB 8 0 "NoData" 1 "Left2m" 2 "Left4m" 3 "Left6m" 4 "Center" 5 "Right2m" 6 "Right4m" 7 "Right6m" /end COMPU_VTAB
/begin CHARACTERISTIC ADSB_OFFSET_LAT "GPS antenna lateral offset, GPS antenna lateral offset. This describes the physical location offest from center of the GPS antenna on the aircraft." VALUE 0x36100000 Scalar_FLOAT32_IEEE 0 CM_ADSB_OFFSET_LAT 0.0 7.0 /end CHARACTERISTIC
/begin COMPU_METHOD CM_ADSB_OFFSET_LON "GPS antenna longitudinal offset" TAB_VERB "%17.6" "" COMPU_TAB_REF TAB_ADSB_OFFSET_LON /end COMPU_METHOD
/begin COMPU_VTAB TAB_ADSB_OFFSET_LON "GPS antenna longitudinal offset, GPS antenna longitudinal offset. This is usually set to 1, Applied By Sensor" TAB_VERB 2 0 "NO_DATA" 1 "AppliedBySensor" /end COMPU_VTAB
/begin CHARACTERISTIC ADSB_OFFSET_LON "GPS antenna longitudinal offset, GPS antenna longitudinal offset. This is usually set to 1, Applied By Sensor" VALUE 0x36100000 Scalar_FLOAT32_IEEE 0 CM_ADSB_OFFSET_LON 0.0 1.0 /end CHARACTERISTIC
/begin COMPU_METHOD CM_ADSB_RF_SELECT "Transceiver RF selection" TAB_VERB "%17.6" "" COMPU_TAB_REF TAB_ADSB_RF_SELECT /end COMPU_METHOD
/begin COMPU_VTAB TAB_ADSB_RF_SELECT "Transceiver RF selection, Transceiver RF selection for Rx enable and/or Tx enable." TAB_VERB 4 0 "Disabled" 1 "Rx-Only" 2 "Tx-Only" 3 "Rx and Tx Enabled" /end COMPU_VTAB
/begin CHARACTERISTIC ADSB_RF_SELECT "Transceiver RF selection, Transceiver RF selection for Rx enable and/or Tx enable." VALUE 0x36100000 Scalar_FLOAT32_IEEE 0 CM_ADSB_RF_SELECT 0.0 3.0 /end CHARACTERISTIC
/begin COMPU_METHOD CM_AVD_ENABLE "Enable Avoidance using ADSB" TAB_VERB "%17.6" "" COMPU_TAB_REF TAB_AVD_ENABLE /end COMPU_METHOD
/begin COMPU_VTAB TAB_AVD_ENABLE "Enable Avoidance using ADSB, Enable Avoidance using ADSB" TAB_VERB 2 0 "Disabled" 1 "Enabled" /end COMPU_VTAB
/begin CHARACTERISTIC AVD_ENABLE "Enable Avoidance using ADSB, Enable Avoidance using ADSB" VALUE 0x36100000 Scalar_FLOAT32_IEEE 0 CM_AVD_ENABLE 0.0 1.0 /end CHARACTERISTIC
/begin COMPU_METHOD CM_AVD_F_RCVRY "Recovery behaviour after a fail event" TAB_VERB "%17.6" "" COMPU_TAB_REF TAB_AVD_F_RCVRY /end COMPU_METHOD
/begin COMPU_VTAB TAB_AVD_F_RCVRY "Recovery behaviour after a fail event, Determines what the aircraft will do after a fail event is resolved" TAB_VERB 2 0 "Continue failsafe action" 1 "Resume previous flight mode" /end COMPU_VTAB
/begin CHARACTERISTIC AVD_F_RCVRY "Recovery behaviour after a fail event, Determines what the aircraft will do after a fail event is resolved" VALUE 0x36100000 Scalar_FLOAT32_IEEE 0 CM_AVD_F_RCVRY 0.0 1.0 /end CHARACTERISTIC
/begin CHARACTERISTIC AVD_OBS_MAX "Maximum number of obstacles to track, Maximum number of obstacles to track" VALUE 0x36100000 Scalar_FLOAT32_IEEE 0 IDENTICAL -3.40282e+38 3.40282e+38 /end CHARACTERISTIC
/begin CHARACTERISTIC AVD_W_TIME "Time Horizon Warn, Aircraft velocity vectors are multiplied by this time to determine closest approach.  If this results in an approach closer than W_DIST_XY or W_DIST_Z then W_ACTION is undertaken (assuming F_ACTION is not undertaken)" VALUE 0x36100000 Scalar_FLOAT32_IEEE 0 IDENTICAL -3.40282e+38 3.40282e+38 /end CHARACTERISTIC
/begin CHARACTERISTIC AVD_F_TIME "Time Horizon Fail, Aircraft velocity vectors are multiplied by this time to determine closest approach.  If this results in an approach closer than F_DIST_XY or F_DIST_Z then F_ACTION is undertaken" VALUE 0x36100000 Scalar_FLOAT32_IEEE 0 IDENTICAL -3.40282e+38 3.40282e+38 /end CHARACTERISTIC
/begin CHARACTERISTIC AVD_W_DIST_XY "Distance Warn XY, Closest allowed projected distance before W_ACTION is undertaken" VALUE 0x36100000 Scalar_FLOAT32_IEEE 0 IDENTICAL -3.40282e+38 3.40282e+38 /end CHARACTERISTIC
/begin CHARACTERISTIC AVD_F_DIST_XY "Distance Fail XY, Closest allowed projected distance before F_ACTION is undertaken" VALUE 0x36100000 Scalar_FLOAT32_IEEE 0 IDENTICAL -3.40282e+38 3.40282e+38 /end CHARACTERISTIC
/begin CHARACTERISTIC AVD_W_DIST_Z "Distance Warn Z, Closest allowed projected distance before BEHAVIOUR_W is undertaken" VALUE 0x36100000 Scalar_FLOAT32_IEEE 0 IDENTICAL -3.40282e+38 3.40282e+38 /end CHARACTERISTIC
/begin CHARACTERISTIC AVD_F_DIST_Z "Distance Fail Z, Closest allowed projected distance before BEHAVIOUR_F is undertaken" VALUE 0x36100000 Scalar_FLOAT32_IEEE 0 IDENTICAL -3.40282e+38 3.40282e+38 /end CHARACTERISTIC
/begin COMPU_METHOD CM_NTF_LED_BRIGHT "LED Brightness" TAB_VERB "%17.6" "" COMPU_TAB_REF TAB_NTF_LED_BRIGHT /end COMPU_METHOD
/begin COMPU_VTAB TAB_NTF_LED_BRIGHT "LED Brightness, Select the RGB LED brightness level. When USB is connected brightness will never be higher than low regardless of the setting." TAB_VERB 4 0 "Off" 1 "Low" 2 "Medium" 3 "High" /end COMPU_VTAB
/begin CHARACTERISTIC NTF_LED_BRIGHT "LED Brightness, Select the RGB LED brightness level. When USB is connected brightness will never be higher than low regardless of the setting." VALUE 0x36100000 Scalar_FLOAT32_IEEE 0 CM_NTF_LED_BRIGHT 0.0 3.0 /end CHARACTERISTIC
/begin COMPU_METHOD CM_NTF_BUZZ_ENABLE "Buzzer enable" TAB_VERB "%17.6" "" COMPU_TAB_REF TAB_NTF_BUZZ_ENABLE /end COMPU_METHOD
/begin COMPU_VTAB TAB_NTF_BUZZ_ENABLE "Buzzer enable, Enable or disable the buzzer. Only for Linux and PX4 based boards." TAB_VERB 2 0 "Disable" 1 "Enable" /end COMPU_VTAB
/begin CHARACTERISTIC NTF_BUZZ_ENABLE "Buzzer enable, Enable or disable the buzzer. Only for Linux and PX4 based boards." VALUE 0x36100000 Scalar_FLOAT32_IEEE 0 CM_NTF_BUZZ_ENABLE 0.0 1.0 /end CHARACTERISTIC
/begin COMPU_METHOD CM_NTF_LED_OVERRIDE "Setup for MAVLink LED override" TAB_VERB "%17.6" "" COMPU_TAB_REF TAB_NTF_LED_OVERRIDE /end COMPU_METHOD
/begin COMPU_VTAB TAB_NTF_LED_OVERRIDE "Setup for MAVLink LED override, This sets up the board RGB LED for override by MAVLink. Normal notify LED control is disabled" TAB_VERB 2 0 "Disable" 1 "Enable" /end COMPU_VTAB
/begin CHARACTERISTIC NTF_LED_OVERRIDE "Setup for MAVLink LED override, This sets up the board RGB LED for override by MAVLink. Normal notify LED control is disabled" VALUE 0x36100000 Scalar_FLOAT32_IEEE 0 CM_NTF_LED_OVERRIDE 0.0 1.0 /end CHARACTERISTIC
/begin COMPU_METHOD CM_BTN_ENABLE "Enable button reporting" TAB_VERB "%17.6" "" COMPU_TAB_REF TAB_BTN_ENABLE /end COMPU_METHOD
/begin COMPU_VTAB TAB_BTN_ENABLE "Enable button reporting, This enables the button checking module. When this is disabled the parameters for setting button inputs are not visible" TAB_VERB 2 0 "Disabled" 1 "Enabled" /end COMPU_VTAB
/begin CHARACTERISTIC BTN_ENABLE "Enable button reporting, This enables the button checking module. When this is disabled the parameters for setting button inputs are not visible" VALUE 0x36100000 Scalar_FLOAT32_IEEE 0 CM_BTN_ENABLE 0.0 1.0 /end CHARACTERISTIC
/begin COMPU_METHOD CM_BTN_PIN1 "First button Pin" TAB_VERB "%17.6" "" COMPU_TAB_REF TAB_BTN_PIN1 /end COMPU_METHOD
/begin COMPU_VTAB TAB_BTN_PIN1 "First button Pin, Digital pin number for first button input. " TAB_VERB 13 -1 "Disabled" 50 "Pixhawk AUXOUT1" 51 "Pixhawk AUXOUT2" 52 "Pixhawk AUXOUT3" 53 "Pixhawk AUXOUT4" 54 "Pixhawk AUXOUT5" 55 "Pixhawk AUXOUT6" 111 "PX4 FMU Relay1" 112 "PX4 FMU Relay2" 113 "PX4IO Relay1" 114 "PX4IO Relay2" 115 "PX4IO ACC1" 116 "PX4IO ACC2" /end COMPU_VTAB
/begin CHARACTERISTIC BTN_PIN1 "First button Pin, Digital pin number for first button input. " VALUE 0x36100000 Scalar_FLOAT32_IEEE 0 CM_BTN_PIN1 -1.0 116.0 /end CHARACTERISTIC
/begin COMPU_METHOD CM_BTN_PIN2 "Second button Pin" TAB_VERB "%17.6" "" COMPU_TAB_REF TAB_BTN_PIN2 /end COMPU_METHOD
/begin COMPU_VTAB TAB_BTN_PIN2 "Second button Pin, Digital pin number for second button input. " TAB_VERB 13 -1 "Disabled" 50 "Pixhawk AUXOUT1" 51 "Pixhawk AUXOUT2" 52 "Pixhawk AUXOUT3" 53 "Pixhawk AUXOUT4" 54 "Pixhawk AUXOUT5" 55 "Pixhawk AUXOUT6" 111 "PX4 FMU Relay1" 112 "PX4 FMU Relay2" 113 "PX4IO Relay1" 114 "PX4IO Relay2" 115 "PX4IO ACC1" 116 "PX4IO ACC2" /end COMPU_VTAB
/begin CHARACTERISTIC BTN_PIN2 "Second button Pin, Digital pin number for second button input. " VALUE 0x36100000 Scalar_FLOAT32_IEEE 0 CM_BTN_PIN2 -1.0 116.0 /end CHARACTERISTIC
/begin COMPU_METHOD CM_BTN_PIN3 "Third button Pin" TAB_VERB "%17.6" "" COMPU_TAB_REF TAB_BTN_PIN3 /end COMPU_METHOD
/begin COMPU_VTAB TAB_BTN_PIN3 "Third button Pin, Digital pin number for third button input. " TAB_VERB 13 -1 "Disabled" 50 "Pixhawk AUXOUT1" 51 "Pixhawk AUXOUT2" 52 "Pixhawk AUXOUT3" 53 "Pixhawk AUXOUT4" 54 "Pixhawk AUXOUT5" 55 "Pixhawk AUXOUT6" 111 "PX4 FMU Relay1" 112 "PX4 FMU Relay2" 113 "PX4IO Relay1" 114 "PX4IO Relay2" 115 "PX4IO ACC1" 116 "PX4IO ACC2" /end COMPU_VTAB
/begin CHARACTERISTIC BTN_PIN3 "Third button Pin, Digital pin number for third button input. " VALUE 0x36100000 Scalar_FLOAT32_IEEE 0 CM_BTN_PIN3 -1.0 116.0 /end CHARACTERISTIC
/begin COMPU_METHOD CM_BTN_PIN4 "Fourth button Pin" TAB_VERB "%17.6" "" COMPU_TAB_REF TAB_BTN_PIN4 /end COMPU_METHOD
/begin COMPU_VTAB TAB_BTN_PIN4 "Fourth button Pin, Digital pin number for fourth button input. " TAB_VERB 13 -1 "Disabled" 50 "Pixhawk AUXOUT1" 51 "Pixhawk AUXOUT2" 52 "Pixhawk AUXOUT3" 53 "Pixhawk AUXOUT4" 54 "Pixhawk AUXOUT5" 55 "Pixhawk AUXOUT6" 111 "PX4 FMU Relay1" 112 "PX4 FMU Relay2" 113 "PX4IO Relay1" 114 "PX4IO Relay2" 115 "PX4IO ACC1" 116 "PX4IO ACC2" /end COMPU_VTAB
/begin CHARACTERISTIC BTN_PIN4 "Fourth button Pin, Digital pin number for fourth button input. " VALUE 0x36100000 Scalar_FLOAT32_IEEE 0 CM_BTN_PIN4 -1.0 116.0 /end CHARACTERISTIC
/begin CHARACTERISTIC BTN_REPORT_SEND "Report send time, The duration in seconds that a BUTTON_CHANGE report is repeatedly sent to the GCS regarding a button changing state. Note that the BUTTON_CHANGE message is MAVLink2 only." VALUE 0x36100000 Scalar_FLOAT32_IEEE 0 IDENTICAL 0.0 3600.0 /end CHARACTERISTIC
