/begin MEASUREMENT SYSID_SW_MREV "Eeprom format version number, This value is incremented when changes are made to the eeprom format" FLOAT32_IEEE IDENTICAL 0 0 -3.40282e+38 3.40282e+38 ECU_ADDRESS 0x36100000 /end MEASUREMENT
/begin COMPU_METHOD CM_SYSID_SW_TYPE "Software Type" TAB_VERB "%17.6" "" COMPU_TAB_REF TAB_SYSID_SW_TYPE /end COMPU_METHOD
/begin COMPU_VTAB TAB_SYSID_SW_TYPE "Software Type, This is used by the ground station to recognise the software type (eg ArduPlane vs ArduCopter)" TAB_VERB 4 0 "ArduPlane" 4 "AntennaTracker" 10 "Copter" 20 "Rover" /end COMPU_VTAB
/begin MEASUREMENT SYSID_SW_TYPE "Software Type, This is used by the ground station to recognise the software type (eg ArduPlane vs ArduCopter)" FLOAT32_IEEE CM_SYSID_SW_TYPE 0 0 0.0 20.0 ECU_ADDRESS 0x36100000 /end MEASUREMENT
/begin CHARACTERISTIC SYSID_THISMAV "MAVLink system ID of this vehicle, Allows setting an individual MAVLink system id for this vehicle to distinguish it from others on the same network" VALUE 0x36100000 Scalar_FLOAT32_IEEE 0 IDENTICAL 1.0 255.0 /end CHARACTERISTIC
/begin COMPU_METHOD CM_SYSID_MYGCS "My ground station number" TAB_VERB "%17.6" "" COMPU_TAB_REF TAB_SYSID_MYGCS /end COMPU_METHOD
/begin COMPU_VTAB TAB_SYSID_MYGCS "My ground station number, Allows restricting radio overrides to only come from my ground station" TAB_VERB 2 255 "Mission Planner and DroidPlanner" 252 " AP Planner 2" /end COMPU_VTAB
/begin CHARACTERISTIC SYSID_MYGCS "My ground station number, Allows restricting radio overrides to only come from my ground station" VALUE 0x36100000 Scalar_FLOAT32_IEEE 0 CM_SYSID_MYGCS 252.0 255.0 /end CHARACTERISTIC
/begin COMPU_METHOD CM_CLI_ENABLED "CLI Enable" TAB_VERB "%17.6" "" COMPU_TAB_REF TAB_CLI_ENABLED /end COMPU_METHOD
/begin COMPU_VTAB TAB_CLI_ENABLED "CLI Enable, This enables/disables the checking for three carriage returns on telemetry links on startup to enter the diagnostics command line interface" TAB_VERB 2 0 "Disabled" 1 "Enabled" /end COMPU_VTAB
/begin CHARACTERISTIC CLI_ENABLED "CLI Enable, This enables/disables the checking for three carriage returns on telemetry links on startup to enter the diagnostics command line interface" VALUE 0x36100000 Scalar_FLOAT32_IEEE 0 CM_CLI_ENABLED 0.0 1.0 /end CHARACTERISTIC
/begin CHARACTERISTIC PILOT_THR_FILT "Throttle filter cutoff, Throttle filter cutoff (Hz) - active whenever altitude control is inactive - 0 to disable" VALUE 0x36100000 Scalar_FLOAT32_IEEE 0 HERZ 0.0 10.0 /end CHARACTERISTIC
/begin CHARACTERISTIC PILOT_TKOFF_ALT "Pilot takeoff altitude, Altitude that altitude control modes will climb to when a takeoff is triggered with the throttle stick." VALUE 0x36100000 Scalar_FLOAT32_IEEE 0 CENTIMETERS 0.0 1000.0 /end CHARACTERISTIC
/begin CHARACTERISTIC PILOT_TKOFF_DZ "Takeoff trigger deadzone, Offset from mid stick at which takeoff is triggered" VALUE 0x36100000 Scalar_FLOAT32_IEEE 0 IDENTICAL 0.0 500.0 /end CHARACTERISTIC
/begin COMPU_METHOD CM_PILOT_THR_BHV "Throttle stick behavior" TAB_VERB "%17.6" "" COMPU_TAB_REF TAB_PILOT_THR_BHV /end COMPU_METHOD
/begin COMPU_VTAB TAB_PILOT_THR_BHV "Throttle stick behavior, Bitmask containing various throttle stick options. Add up the values for options that you want." TAB_VERB 4 0 "None" 1 "Feedback from mid stick" 2 "High throttle cancels landing" 4 "Disarm on land detection" /end COMPU_VTAB
/begin CHARACTERISTIC PILOT_THR_BHV "Throttle stick behavior, Bitmask containing various throttle stick options. Add up the values for options that you want." VALUE 0x36100000 Scalar_FLOAT32_IEEE 0 CM_PILOT_THR_BHV 0.0 4.0 /end CHARACTERISTIC
/begin CHARACTERISTIC TELEM_DELAY "Telemetry startup delay, The amount of time (in seconds) to delay radio telemetry to prevent an Xbee bricking on power up" VALUE 0x36100000 Scalar_FLOAT32_IEEE 0 SECONDS 0.0 10.0 /end CHARACTERISTIC
/begin COMPU_METHOD CM_GCS_PID_MASK "GCS PID tuning mask" TAB_VERB "%17.6" "" COMPU_TAB_REF TAB_GCS_PID_MASK /end COMPU_METHOD
/begin COMPU_VTAB TAB_GCS_PID_MASK "GCS PID tuning mask, bitmask of PIDs to send MAVLink PID_TUNING messages for" TAB_VERB 4 0 "None" 1 "Roll" 2 "Pitch" 4 "Yaw" /end COMPU_VTAB
/begin CHARACTERISTIC GCS_PID_MASK "GCS PID tuning mask, bitmask of PIDs to send MAVLink PID_TUNING messages for" VALUE 0x36100000 Scalar_FLOAT32_IEEE 0 CM_GCS_PID_MASK 0.0 4.0 /end CHARACTERISTIC
/begin CHARACTERISTIC RTL_ALT "RTL Altitude, The minimum relative altitude the model will move to before Returning to Launch.  Set to zero to return at current altitude." VALUE 0x36100000 Scalar_FLOAT32_IEEE 0 CENTIMETERS 0.0 8000.0 /end CHARACTERISTIC
/begin COMPU_METHOD CM_RTL_CONE_SLOPE "RTL cone slope" TAB_VERB "%17.6" "" COMPU_TAB_REF TAB_RTL_CONE_SLOPE /end COMPU_METHOD
/begin COMPU_VTAB TAB_RTL_CONE_SLOPE "RTL cone slope, Defines a cone above home which determines maximum climb" TAB_VERB 3 0 "Disabled" 1 "Shallow" 3 "Steep" /end COMPU_VTAB
/begin CHARACTERISTIC RTL_CONE_SLOPE "RTL cone slope, Defines a cone above home which determines maximum climb" VALUE 0x36100000 Scalar_FLOAT32_IEEE 0 CM_RTL_CONE_SLOPE 0.5 10.0 /end CHARACTERISTIC
/begin CHARACTERISTIC RTL_SPEED "RTL speed, Defines the speed in cm/s which the aircraft will attempt to maintain horizontally while flying home. If this is set to zero, WPNAV_SPEED will be used instead." VALUE 0x36100000 Scalar_FLOAT32_IEEE 0 CENTIMETERS_PER_SECOND 0.0 2000.0 /end CHARACTERISTIC
/begin CHARACTERISTIC RNGFND_GAIN "Rangefinder gain, Used to adjust the speed with which the target altitude is changed when objects are sensed below the copter" VALUE 0x36100000 Scalar_FLOAT32_IEEE 0 IDENTICAL 0.01 2.0 /end CHARACTERISTIC
/begin COMPU_METHOD CM_FS_BATT_ENABLE "Battery Failsafe Enable" TAB_VERB "%17.6" "" COMPU_TAB_REF TAB_FS_BATT_ENABLE /end COMPU_METHOD
/begin COMPU_VTAB TAB_FS_BATT_ENABLE "Battery Failsafe Enable, Controls whether failsafe will be invoked when battery voltage or current runs low" TAB_VERB 3 0 "Disabled" 1 "Land" 2 "RTL" /end COMPU_VTAB
/begin CHARACTERISTIC FS_BATT_ENABLE "Battery Failsafe Enable, Controls whether failsafe will be invoked when battery voltage or current runs low" VALUE 0x36100000 Scalar_FLOAT32_IEEE 0 CM_FS_BATT_ENABLE 0.0 2.0 /end CHARACTERISTIC
/begin CHARACTERISTIC FS_BATT_VOLTAGE "Failsafe battery voltage, Battery voltage to trigger failsafe. Set to 0 to disable battery voltage failsafe. If the battery voltage drops below this voltage then the copter will RTL" VALUE 0x36100000 Scalar_FLOAT32_IEEE 0 VOLT -3.40282e+38 3.40282e+38 /end CHARACTERISTIC
/begin CHARACTERISTIC FS_BATT_MAH "Failsafe battery milliAmpHours, Battery capacity remaining to trigger failsafe. Set to 0 to disable battery remaining failsafe. If the battery remaining drops below this level then the copter will RTL" VALUE 0x36100000 Scalar_FLOAT32_IEEE 0 MILLIAMPERE_HOUR -3.40282e+38 3.40282e+38 /end CHARACTERISTIC
/begin COMPU_METHOD CM_FS_GCS_ENABLE "Ground Station Failsafe Enable" TAB_VERB "%17.6" "" COMPU_TAB_REF TAB_FS_GCS_ENABLE /end COMPU_METHOD
/begin COMPU_VTAB TAB_FS_GCS_ENABLE "Ground Station Failsafe Enable, Controls whether failsafe will be invoked (and what action to take) when connection with Ground station is lost for at least 5 seconds. NB. The GCS Failsafe is only active when RC_OVERRIDE is being used to control the vehicle." TAB_VERB 3 0 "Disabled" 1 "Enabled always RTL" 2 "Enabled Continue with Mission in Auto Mode" /end COMPU_VTAB
/begin CHARACTERISTIC FS_GCS_ENABLE "Ground Station Failsafe Enable, Controls whether failsafe will be invoked (and what action to take) when connection with Ground station is lost for at least 5 seconds. NB. The GCS Failsafe is only active when RC_OVERRIDE is being used to control the vehicle." VALUE 0x36100000 Scalar_FLOAT32_IEEE 0 CM_FS_GCS_ENABLE 0.0 2.0 /end CHARACTERISTIC
/begin CHARACTERISTIC GPS_HDOP_GOOD "GPS Hdop Good, GPS Hdop value at or below this value represent a good position.  Used for pre-arm checks" VALUE 0x36100000 Scalar_FLOAT32_IEEE 0 IDENTICAL 100.0 900.0 /end CHARACTERISTIC
/begin COMPU_METHOD CM_MAG_ENABLE "Compass enable/disable" TAB_VERB "%17.6" "" COMPU_TAB_REF TAB_MAG_ENABLE /end COMPU_METHOD
/begin COMPU_VTAB TAB_MAG_ENABLE "Compass enable/disable, Setting this to Enabled(1) will enable the compass. Setting this to Disabled(0) will disable the compass" TAB_VERB 2 0 "Disabled" 1 "Enabled" /end COMPU_VTAB
/begin CHARACTERISTIC MAG_ENABLE "Compass enable/disable, Setting this to Enabled(1) will enable the compass. Setting this to Disabled(0) will disable the compass" VALUE 0x36100000 Scalar_FLOAT32_IEEE 0 CM_MAG_ENABLE 0.0 1.0 /end CHARACTERISTIC
/begin COMPU_METHOD CM_SUPER_SIMPLE "Super Simple Mode" TAB_VERB "%17.6" "" COMPU_TAB_REF TAB_SUPER_SIMPLE /end COMPU_METHOD
/begin COMPU_VTAB TAB_SUPER_SIMPLE "Super Simple Mode, Bitmask to enable Super Simple mode for some flight modes. Setting this to Disabled(0) will disable Super Simple Mode" TAB_VERB 64 0 "Disabled" 1 "Mode1" 2 "Mode2" 3 "Mode1+2" 4 "Mode3" 5 "Mode1+3" 6 "Mode2+3" 7 "Mode1+2+3" 8 "Mode4" 9 "Mode1+4" 10 "Mode2+4" 11 "Mode1+2+4" 12 "Mode3+4" 13 "Mode1+3+4" 14 "Mode2+3+4" 15 "Mode1+2+3+4" 16 "Mode5" 17 "Mode1+5" 18 "Mode2+5" 19 "Mode1+2+5" 20 "Mode3+5" 21 "Mode1+3+5" 22 "Mode2+3+5" 23 "Mode1+2+3+5" 24 "Mode4+5" 25 "Mode1+4+5" 26 "Mode2+4+5" 27 "Mode1+2+4+5" 28 "Mode3+4+5" 29 "Mode1+3+4+5" 30 "Mode2+3+4+5" 31 "Mode1+2+3+4+5" 32 "Mode6" 33 "Mode1+6" 34 "Mode2+6" 35 "Mode1+2+6" 36 "Mode3+6" 37 "Mode1+3+6" 38 "Mode2+3+6" 39 "Mode1+2+3+6" 40 "Mode4+6" 41 "Mode1+4+6" 42 "Mode2+4+6" 43 "Mode1+2+4+6" 44 "Mode3+4+6" 45 "Mode1+3+4+6" 46 "Mode2+3+4+6" 47 "Mode1+2+3+4+6" 48 "Mode5+6" 49 "Mode1+5+6" 50 "Mode2+5+6" 51 "Mode1+2+5+6" 52 "Mode3+5+6" 53 "Mode1+3+5+6" 54 "Mode2+3+5+6" 55 "Mode1+2+3+5+6" 56 "Mode4+5+6" 57 "Mode1+4+5+6" 58 "Mode2+4+5+6" 59 "Mode1+2+4+5+6" 60 "Mode3+4+5+6" 61 "Mode1+3+4+5+6" 62 "Mode2+3+4+5+6" 63 "Mode1+2+3+4+5+6" /end COMPU_VTAB
/begin CHARACTERISTIC SUPER_SIMPLE "Super Simple Mode, Bitmask to enable Super Simple mode for some flight modes. Setting this to Disabled(0) will disable Super Simple Mode" VALUE 0x36100000 Scalar_FLOAT32_IEEE 0 CM_SUPER_SIMPLE 0.0 63.0 /end CHARACTERISTIC
/begin CHARACTERISTIC RTL_ALT_FINAL "RTL Final Altitude, This is the altitude the vehicle will move to as the final stage of Returning to Launch or after completing a mission.  Set to zero to land." VALUE 0x36100000 Scalar_FLOAT32_IEEE 0 CENTIMETERS -1.0 1000.0 /end CHARACTERISTIC
/begin CHARACTERISTIC RTL_CLIMB_MIN "RTL minimum climb, The vehicle will climb this many cm during the initial climb portion of the RTL" VALUE 0x36100000 Scalar_FLOAT32_IEEE 0 CENTIMETERS 0.0 3000.0 /end CHARACTERISTIC
/begin COMPU_METHOD CM_WP_YAW_BEHAVIOR "Yaw behaviour during missions" TAB_VERB "%17.6" "" COMPU_TAB_REF TAB_WP_YAW_BEHAVIOR /end COMPU_METHOD
/begin COMPU_VTAB TAB_WP_YAW_BEHAVIOR "Yaw behaviour during missions, Determines how the autopilot controls the yaw during missions and RTL" TAB_VERB 4 0 "Never change yaw" 1 "Face next waypoint" 2 "Face next waypoint except RTL" 3 "Face along GPS course" /end COMPU_VTAB
/begin CHARACTERISTIC WP_YAW_BEHAVIOR "Yaw behaviour during missions, Determines how the autopilot controls the yaw during missions and RTL" VALUE 0x36100000 Scalar_FLOAT32_IEEE 0 CM_WP_YAW_BEHAVIOR 0.0 3.0 /end CHARACTERISTIC
/begin CHARACTERISTIC RTL_LOIT_TIME "RTL loiter time, Time (in milliseconds) to loiter above home before beginning final descent" VALUE 0x36100000 Scalar_FLOAT32_IEEE 0 MILLISECONDS 0.0 60000.0 /end CHARACTERISTIC
/begin CHARACTERISTIC LAND_SPEED "Land speed, The descent speed for the final stage of landing in cm/s" VALUE 0x36100000 Scalar_FLOAT32_IEEE 0 CENTIMETERS_PER_SECOND 30.0 200.0 /end CHARACTERISTIC
/begin CHARACTERISTIC LAND_SPEED_HIGH "Land speed high, The descent speed for the first stage of landing in cm/s. If this is zero then WPNAV_SPEED_DN is used" VALUE 0x36100000 Scalar_FLOAT32_IEEE 0 CENTIMETERS_PER_SECOND 0.0 500.0 /end CHARACTERISTIC
/begin CHARACTERISTIC PILOT_VELZ_MAX "Pilot maximum vertical speed, The maximum vertical velocity the pilot may request in cm/s" VALUE 0x36100000 Scalar_FLOAT32_IEEE 0 CENTIMETERS_PER_SECOND 50.0 500.0 /end CHARACTERISTIC
/begin CHARACTERISTIC PILOT_ACCEL_Z "Pilot vertical acceleration, The vertical acceleration used when pilot is controlling the altitude" VALUE 0x36100000 Scalar_FLOAT32_IEEE 0 CENTIMETERS_PER_SECOND_PER_SECOND 50.0 500.0 /end CHARACTERISTIC
/begin COMPU_METHOD CM_FS_THR_ENABLE "Throttle Failsafe Enable" TAB_VERB "%17.6" "" COMPU_TAB_REF TAB_FS_THR_ENABLE /end COMPU_METHOD
/begin COMPU_VTAB TAB_FS_THR_ENABLE "Throttle Failsafe Enable, The throttle failsafe allows you to configure a software failsafe activated by a setting on the throttle input channel" TAB_VERB 4 0 "Disabled" 1 "Enabled always RTL" 2 "Enabled Continue with Mission in Auto Mode" 3 "Enabled always LAND" /end COMPU_VTAB
/begin CHARACTERISTIC FS_THR_ENABLE "Throttle Failsafe Enable, The throttle failsafe allows you to configure a software failsafe activated by a setting on the throttle input channel" VALUE 0x36100000 Scalar_FLOAT32_IEEE 0 CM_FS_THR_ENABLE 0.0 3.0 /end CHARACTERISTIC
/begin CHARACTERISTIC FS_THR_VALUE "Throttle Failsafe Value, The PWM level on channel 3 below which throttle sailsafe triggers" VALUE 0x36100000 Scalar_FLOAT32_IEEE 0 MICROSECONDS 925.0 1100.0 /end CHARACTERISTIC
/begin CHARACTERISTIC THR_DZ "Throttle deadzone, The deadzone above and below mid throttle.  Used in AltHold, Loiter, PosHold flight modes" VALUE 0x36100000 Scalar_FLOAT32_IEEE 0 MICROSECONDS 0.0 300.0 /end CHARACTERISTIC
/begin COMPU_METHOD CM_FLTMODE1 "Flight Mode 1" TAB_VERB "%17.6" "" COMPU_TAB_REF TAB_FLTMODE1 /end COMPU_METHOD
/begin COMPU_VTAB TAB_FLTMODE1 "Flight Mode 1, Flight mode when Channel 5 pwm is <= 1230" TAB_VERB 18 0 "Stabilize" 1 "Acro" 2 "AltHold" 3 "Auto" 4 "Guided" 5 "Loiter" 6 "RTL" 7 "Circle" 9 "Land" 11 "Drift" 13 "Sport" 14 "Flip" 15 "AutoTune" 16 "PosHold" 17 "Brake" 18 "Throw" 19 "Avoid_ADSB" 20 "Guided_NoGPS" /end COMPU_VTAB
/begin CHARACTERISTIC FLTMODE1 "Flight Mode 1, Flight mode when Channel 5 pwm is <= 1230" VALUE 0x36100000 Scalar_FLOAT32_IEEE 0 CM_FLTMODE1 0.0 20.0 /end CHARACTERISTIC
/begin COMPU_METHOD CM_FLTMODE2 "Flight Mode 2" TAB_VERB "%17.6" "" COMPU_TAB_REF TAB_FLTMODE2 /end COMPU_METHOD
/begin COMPU_VTAB TAB_FLTMODE2 "Flight Mode 2, Flight mode when Channel 5 pwm is >1230, <= 1360" TAB_VERB 18 0 "Stabilize" 1 "Acro" 2 "AltHold" 3 "Auto" 4 "Guided" 5 "Loiter" 6 "RTL" 7 "Circle" 9 "Land" 11 "Drift" 13 "Sport" 14 "Flip" 15 "AutoTune" 16 "PosHold" 17 "Brake" 18 "Throw" 19 "Avoid_ADSB" 20 "Guided_NoGPS" /end COMPU_VTAB
/begin CHARACTERISTIC FLTMODE2 "Flight Mode 2, Flight mode when Channel 5 pwm is >1230, <= 1360" VALUE 0x36100000 Scalar_FLOAT32_IEEE 0 CM_FLTMODE2 0.0 20.0 /end CHARACTERISTIC
/begin COMPU_METHOD CM_FLTMODE3 "Flight Mode 3" TAB_VERB "%17.6" "" COMPU_TAB_REF TAB_FLTMODE3 /end COMPU_METHOD
/begin COMPU_VTAB TAB_FLTMODE3 "Flight Mode 3, Flight mode when Channel 5 pwm is >1360, <= 1490" TAB_VERB 18 0 "Stabilize" 1 "Acro" 2 "AltHold" 3 "Auto" 4 "Guided" 5 "Loiter" 6 "RTL" 7 "Circle" 9 "Land" 11 "Drift" 13 "Sport" 14 "Flip" 15 "AutoTune" 16 "PosHold" 17 "Brake" 18 "Throw" 19 "Avoid_ADSB" 20 "Guided_NoGPS" /end COMPU_VTAB
/begin CHARACTERISTIC FLTMODE3 "Flight Mode 3, Flight mode when Channel 5 pwm is >1360, <= 1490" VALUE 0x36100000 Scalar_FLOAT32_IEEE 0 CM_FLTMODE3 0.0 20.0 /end CHARACTERISTIC
/begin COMPU_METHOD CM_FLTMODE4 "Flight Mode 4" TAB_VERB "%17.6" "" COMPU_TAB_REF TAB_FLTMODE4 /end COMPU_METHOD
/begin COMPU_VTAB TAB_FLTMODE4 "Flight Mode 4, Flight mode when Channel 5 pwm is >1490, <= 1620" TAB_VERB 18 0 "Stabilize" 1 "Acro" 2 "AltHold" 3 "Auto" 4 "Guided" 5 "Loiter" 6 "RTL" 7 "Circle" 9 "Land" 11 "Drift" 13 "Sport" 14 "Flip" 15 "AutoTune" 16 "PosHold" 17 "Brake" 18 "Throw" 19 "Avoid_ADSB" 20 "Guided_NoGPS" /end COMPU_VTAB
/begin CHARACTERISTIC FLTMODE4 "Flight Mode 4, Flight mode when Channel 5 pwm is >1490, <= 1620" VALUE 0x36100000 Scalar_FLOAT32_IEEE 0 CM_FLTMODE4 0.0 20.0 /end CHARACTERISTIC
/begin COMPU_METHOD CM_FLTMODE5 "Flight Mode 5" TAB_VERB "%17.6" "" COMPU_TAB_REF TAB_FLTMODE5 /end COMPU_METHOD
/begin COMPU_VTAB TAB_FLTMODE5 "Flight Mode 5, Flight mode when Channel 5 pwm is >1620, <= 1749" TAB_VERB 18 0 "Stabilize" 1 "Acro" 2 "AltHold" 3 "Auto" 4 "Guided" 5 "Loiter" 6 "RTL" 7 "Circle" 9 "Land" 11 "Drift" 13 "Sport" 14 "Flip" 15 "AutoTune" 16 "PosHold" 17 "Brake" 18 "Throw" 19 "Avoid_ADSB" 20 "Guided_NoGPS" /end COMPU_VTAB
/begin CHARACTERISTIC FLTMODE5 "Flight Mode 5, Flight mode when Channel 5 pwm is >1620, <= 1749" VALUE 0x36100000 Scalar_FLOAT32_IEEE 0 CM_FLTMODE5 0.0 20.0 /end CHARACTERISTIC
/begin COMPU_METHOD CM_FLTMODE6 "Flight Mode 6" TAB_VERB "%17.6" "" COMPU_TAB_REF TAB_FLTMODE6 /end COMPU_METHOD
/begin COMPU_VTAB TAB_FLTMODE6 "Flight Mode 6, Flight mode when Channel 5 pwm is >=1750" TAB_VERB 18 0 "Stabilize" 1 "Acro" 2 "AltHold" 3 "Auto" 4 "Guided" 5 "Loiter" 6 "RTL" 7 "Circle" 9 "Land" 11 "Drift" 13 "Sport" 14 "Flip" 15 "AutoTune" 16 "PosHold" 17 "Brake" 18 "Throw" 19 "Avoid_ADSB" 20 "Guided_NoGPS" /end COMPU_VTAB
/begin CHARACTERISTIC FLTMODE6 "Flight Mode 6, Flight mode when Channel 5 pwm is >=1750" VALUE 0x36100000 Scalar_FLOAT32_IEEE 0 CM_FLTMODE6 0.0 20.0 /end CHARACTERISTIC
/begin CHARACTERISTIC SIMPLE "Simple mode bitmask, Bitmask which holds which flight modes use simple heading mode (eg bit 0 = 1 means Flight Mode 0 uses simple mode)" VALUE 0x36100000 Scalar_FLOAT32_IEEE 0 IDENTICAL -3.40282e+38 3.40282e+38 /end CHARACTERISTIC
/begin COMPU_METHOD CM_LOG_BITMASK "Log bitmask" TAB_VERB "%17.6" "" COMPU_TAB_REF TAB_LOG_BITMASK /end COMPU_METHOD
/begin COMPU_VTAB TAB_LOG_BITMASK "Log bitmask, 4 byte bitmap of log types to enable" TAB_VERB 12 830 "Default" 894 "Default+RCIN" 958 "Default+IMU" 1854 "Default+Motors" -6146 "NearlyAll-AC315" 45054 "NearlyAll" 131071 "All+FastATT" 262142 "All+MotBatt" 393214 "All+FastIMU" 397310 "All+FastIMU+PID" 655358 "All+FullIMU" 0 "Disabled" /end COMPU_VTAB
/begin CHARACTERISTIC LOG_BITMASK "Log bitmask, 4 byte bitmap of log types to enable" VALUE 0x36100000 Scalar_FLOAT32_IEEE 0 CM_LOG_BITMASK -6146.0 655358.0 /end CHARACTERISTIC
/begin COMPU_METHOD CM_ESC_CALIBRATION "ESC Calibration" TAB_VERB "%17.6" "" COMPU_TAB_REF TAB_ESC_CALIBRATION /end COMPU_METHOD
/begin COMPU_VTAB TAB_ESC_CALIBRATION "ESC Calibration, Controls whether ArduCopter will enter ESC calibration on the next restart.  Do not adjust this parameter manually." TAB_VERB 4 0 "Normal Start-up" 1 "Start-up in ESC Calibration mode if throttle high" 2 "Start-up in ESC Calibration mode regardless of throttle" 9 "Disabled" /end COMPU_VTAB
/begin CHARACTERISTIC ESC_CALIBRATION "ESC Calibration, Controls whether ArduCopter will enter ESC calibration on the next restart.  Do not adjust this parameter manually." VALUE 0x36100000 Scalar_FLOAT32_IEEE 0 CM_ESC_CALIBRATION 0.0 9.0 /end CHARACTERISTIC
/begin COMPU_METHOD CM_TUNE "Channel 6 Tuning" TAB_VERB "%17.6" "" COMPU_TAB_REF TAB_TUNE /end COMPU_METHOD
/begin COMPU_VTAB TAB_TUNE "Channel 6 Tuning, Controls which parameters (normally PID gains) are being tuned with transmitter's channel 6 knob" TAB_VERB 36 0 "None" 1 "Stab Roll/Pitch kP" 4 "Rate Roll/Pitch kP" 5 "Rate Roll/Pitch kI" 21 "Rate Roll/Pitch kD" 3 "Stab Yaw kP" 6 "Rate Yaw kP" 26 "Rate Yaw kD" 14 "Altitude Hold kP" 7 "Throttle Rate kP" 34 "Throttle Accel kP" 35 "Throttle Accel kI" 36 "Throttle Accel kD" 42 "Loiter Speed" 12 "Loiter Pos kP" 22 "Velocity XY kP" 28 "Velocity XY kI" 10 "WP Speed" 25 "Acro RollPitch kP" 40 "Acro Yaw kP" 13 "Heli Ext Gyro" 17 "OF Loiter kP" 18 "OF Loiter kI" 19 "OF Loiter kD" 38 "Declination" 39 "Circle Rate" 41 "RangeFinder Gain" 46 "Rate Pitch kP" 47 "Rate Pitch kI" 48 "Rate Pitch kD" 49 "Rate Roll kP" 50 "Rate Roll kI" 51 "Rate Roll kD" 52 "Rate Pitch FF" 53 "Rate Roll FF" 54 "Rate Yaw FF" /end COMPU_VTAB
/begin CHARACTERISTIC TUNE "Channel 6 Tuning, Controls which parameters (normally PID gains) are being tuned with transmitter's channel 6 knob" VALUE 0x36100000 Scalar_FLOAT32_IEEE 0 CM_TUNE 0.0 54.0 /end CHARACTERISTIC
/begin CHARACTERISTIC TUNE_LOW "Tuning minimum, The minimum value that will be applied to the parameter currently being tuned with the transmitter's channel 6 knob" VALUE 0x36100000 Scalar_FLOAT32_IEEE 0 IDENTICAL 0.0 32767.0 /end CHARACTERISTIC
/begin CHARACTERISTIC TUNE_HIGH "Tuning maximum, The maximum value that will be applied to the parameter currently being tuned with the transmitter's channel 6 knob" VALUE 0x36100000 Scalar_FLOAT32_IEEE 0 IDENTICAL 0.0 32767.0 /end CHARACTERISTIC
/begin COMPU_METHOD CM_FRAME "Frame Orientation (+" TAB_VERB "%17.6" "" COMPU_TAB_REF TAB_FRAME /end COMPU_METHOD
/begin COMPU_VTAB TAB_FRAME "Frame Orientation (+, X or V), Controls motor mixing for multicopters.  Not used for Tri or Traditional Helicopters." TAB_VERB 7 0 "Plus" 1 "X" 2 "V" 3 "H" 4 "V-Tail" 5 "A-Tail" 10 "Y6B (New)" /end COMPU_VTAB
/begin CHARACTERISTIC FRAME "Frame Orientation (+, X or V), Controls motor mixing for multicopters.  Not used for Tri or Traditional Helicopters." VALUE 0x36100000 Scalar_FLOAT32_IEEE 0 CM_FRAME 0.0 10.0 /end CHARACTERISTIC
/begin COMPU_METHOD CM_CH7_OPT "Channel 7 option" TAB_VERB "%17.6" "" COMPU_TAB_REF TAB_CH7_OPT /end COMPU_METHOD
/begin COMPU_VTAB TAB_CH7_OPT "Channel 7 option, Select which function if performed when CH7 is above 1800 pwm" TAB_VERB 34 0 "Do Nothing" 2 "Flip" 3 "Simple Mode" 4 "RTL" 5 "Save Trim" 7 "Save WP" 9 "Camera Trigger" 10 "RangeFinder" 11 "Fence" 12 "ResetToArmedYaw" 13 "Super Simple Mode" 14 "Acro Trainer" 16 "Auto" 17 "AutoTune" 18 "Land" 19 "EPM" 21 "Parachute Enable" 22 "Parachute Release" 23 "Parachute 3pos" 24 "Auto Mission Reset" 25 "AttCon Feed Forward" 26 "AttCon Accel Limits" 27 "Retract Mount" 28 "Relay On/Off" 34 "Relay2 On/Off" 35 "Relay3 On/Off" 36 "Relay4 On/Off" 29 "Landing Gear" 30 "Lost Copter Sound" 31 "Motor Emergency Stop" 32 "Motor Interlock" 33 "Brake" 37 "Throw" 38 "Avoidance" /end COMPU_VTAB
/begin CHARACTERISTIC CH7_OPT "Channel 7 option, Select which function if performed when CH7 is above 1800 pwm" VALUE 0x36100000 Scalar_FLOAT32_IEEE 0 CM_CH7_OPT 0.0 38.0 /end CHARACTERISTIC
/begin COMPU_METHOD CM_CH8_OPT "Channel 8 option" TAB_VERB "%17.6" "" COMPU_TAB_REF TAB_CH8_OPT /end COMPU_METHOD
/begin COMPU_VTAB TAB_CH8_OPT "Channel 8 option, Select which function if performed when CH8 is above 1800 pwm" TAB_VERB 34 0 "Do Nothing" 2 "Flip" 3 "Simple Mode" 4 "RTL" 5 "Save Trim" 7 "Save WP" 9 "Camera Trigger" 10 "RangeFinder" 11 "Fence" 12 "ResetToArmedYaw" 13 "Super Simple Mode" 14 "Acro Trainer" 16 "Auto" 17 "AutoTune" 18 "Land" 19 "EPM" 21 "Parachute Enable" 22 "Parachute Release" 23 "Parachute 3pos" 24 "Auto Mission Reset" 25 "AttCon Feed Forward" 26 "AttCon Accel Limits" 27 "Retract Mount" 28 "Relay On/Off" 34 "Relay2 On/Off" 35 "Relay3 On/Off" 36 "Relay4 On/Off" 29 "Landing Gear" 30 "Lost Copter Sound" 31 "Motor Emergency Stop" 32 "Motor Interlock" 33 "Brake" 37 "Throw" 38 "Avoidance" /end COMPU_VTAB
/begin CHARACTERISTIC CH8_OPT "Channel 8 option, Select which function if performed when CH8 is above 1800 pwm" VALUE 0x36100000 Scalar_FLOAT32_IEEE 0 CM_CH8_OPT 0.0 38.0 /end CHARACTERISTIC
/begin COMPU_METHOD CM_CH9_OPT "Channel 9 option" TAB_VERB "%17.6" "" COMPU_TAB_REF TAB_CH9_OPT /end COMPU_METHOD
/begin COMPU_VTAB TAB_CH9_OPT "Channel 9 option, Select which function if performed when CH9 is above 1800 pwm" TAB_VERB 34 0 "Do Nothing" 2 "Flip" 3 "Simple Mode" 4 "RTL" 5 "Save Trim" 7 "Save WP" 9 "Camera Trigger" 10 "RangeFinder" 11 "Fence" 12 "ResetToArmedYaw" 13 "Super Simple Mode" 14 "Acro Trainer" 16 "Auto" 17 "AutoTune" 18 "Land" 19 "EPM" 21 "Parachute Enable" 22 "Parachute Release" 23 "Parachute 3pos" 24 "Auto Mission Reset" 25 "AttCon Feed Forward" 26 "AttCon Accel Limits" 27 "Retract Mount" 28 "Relay On/Off" 34 "Relay2 On/Off" 35 "Relay3 On/Off" 36 "Relay4 On/Off" 29 "Landing Gear" 30 "Lost Copter Sound" 31 "Motor Emergency Stop" 32 "Motor Interlock" 33 "Brake" 37 "Throw" 38 "Avoidance" /end COMPU_VTAB
/begin CHARACTERISTIC CH9_OPT "Channel 9 option, Select which function if performed when CH9 is above 1800 pwm" VALUE 0x36100000 Scalar_FLOAT32_IEEE 0 CM_CH9_OPT 0.0 38.0 /end CHARACTERISTIC
/begin COMPU_METHOD CM_CH10_OPT "Channel 10 option" TAB_VERB "%17.6" "" COMPU_TAB_REF TAB_CH10_OPT /end COMPU_METHOD
/begin COMPU_VTAB TAB_CH10_OPT "Channel 10 option, Select which function if performed when CH10 is above 1800 pwm" TAB_VERB 34 0 "Do Nothing" 2 "Flip" 3 "Simple Mode" 4 "RTL" 5 "Save Trim" 7 "Save WP" 9 "Camera Trigger" 10 "RangeFinder" 11 "Fence" 12 "ResetToArmedYaw" 13 "Super Simple Mode" 14 "Acro Trainer" 16 "Auto" 17 "AutoTune" 18 "Land" 19 "EPM" 21 "Parachute Enable" 22 "Parachute Release" 23 "Parachute 3pos" 24 "Auto Mission Reset" 25 "AttCon Feed Forward" 26 "AttCon Accel Limits" 27 "Retract Mount" 28 "Relay On/Off" 34 "Relay2 On/Off" 35 "Relay3 On/Off" 36 "Relay4 On/Off" 29 "Landing Gear" 30 "Lost Copter Sound" 31 "Motor Emergency Stop" 32 "Motor Interlock" 33 "Brake" 37 "Throw" 38 "Avoidance" /end COMPU_VTAB
/begin CHARACTERISTIC CH10_OPT "Channel 10 option, Select which function if performed when CH10 is above 1800 pwm" VALUE 0x36100000 Scalar_FLOAT32_IEEE 0 CM_CH10_OPT 0.0 38.0 /end CHARACTERISTIC
/begin COMPU_METHOD CM_CH11_OPT "Channel 11 option" TAB_VERB "%17.6" "" COMPU_TAB_REF TAB_CH11_OPT /end COMPU_METHOD
/begin COMPU_VTAB TAB_CH11_OPT "Channel 11 option, Select which function if performed when CH11 is above 1800 pwm" TAB_VERB 34 0 "Do Nothing" 2 "Flip" 3 "Simple Mode" 4 "RTL" 5 "Save Trim" 7 "Save WP" 9 "Camera Trigger" 10 "RangeFinder" 11 "Fence" 12 "ResetToArmedYaw" 13 "Super Simple Mode" 14 "Acro Trainer" 16 "Auto" 17 "AutoTune" 18 "Land" 19 "EPM" 21 "Parachute Enable" 22 "Parachute Release" 23 "Parachute 3pos" 24 "Auto Mission Reset" 25 "AttCon Feed Forward" 26 "AttCon Accel Limits" 27 "Retract Mount" 28 "Relay On/Off" 34 "Relay2 On/Off" 35 "Relay3 On/Off" 36 "Relay4 On/Off" 29 "Landing Gear" 30 "Lost Copter Sound" 31 "Motor Emergency Stop" 32 "Motor Interlock" 33 "Brake" 37 "Throw" 38 "Avoidance" /end COMPU_VTAB
/begin CHARACTERISTIC CH11_OPT "Channel 11 option, Select which function if performed when CH11 is above 1800 pwm" VALUE 0x36100000 Scalar_FLOAT32_IEEE 0 CM_CH11_OPT 0.0 38.0 /end CHARACTERISTIC
/begin COMPU_METHOD CM_CH12_OPT "Channel 12 option" TAB_VERB "%17.6" "" COMPU_TAB_REF TAB_CH12_OPT /end COMPU_METHOD
/begin COMPU_VTAB TAB_CH12_OPT "Channel 12 option, Select which function if performed when CH12 is above 1800 pwm" TAB_VERB 34 0 "Do Nothing" 2 "Flip" 3 "Simple Mode" 4 "RTL" 5 "Save Trim" 7 "Save WP" 9 "Camera Trigger" 10 "RangeFinder" 11 "Fence" 12 "ResetToArmedYaw" 13 "Super Simple Mode" 14 "Acro Trainer" 16 "Auto" 17 "AutoTune" 18 "Land" 19 "EPM" 21 "Parachute Enable" 22 "Parachute Release" 23 "Parachute 3pos" 24 "Auto Mission Reset" 25 "AttCon Feed Forward" 26 "AttCon Accel Limits" 27 "Retract Mount" 28 "Relay On/Off" 34 "Relay2 On/Off" 35 "Relay3 On/Off" 36 "Relay4 On/Off" 29 "Landing Gear" 30 "Lost Copter Sound" 31 "Motor Emergency Stop" 32 "Motor Interlock" 33 "Brake" 37 "Throw" 38 "Avoidance" /end COMPU_VTAB
/begin CHARACTERISTIC CH12_OPT "Channel 12 option, Select which function if performed when CH12 is above 1800 pwm" VALUE 0x36100000 Scalar_FLOAT32_IEEE 0 CM_CH12_OPT 0.0 38.0 /end CHARACTERISTIC
/begin CHARACTERISTIC DISARM_DELAY "Disarm delay, Delay before automatic disarm in seconds. A value of zero disables auto disarm." VALUE 0x36100000 Scalar_FLOAT32_IEEE 0 SECONDS 0.0 127.0 /end CHARACTERISTIC
/begin CHARACTERISTIC ANGLE_MAX "Angle Max, Maximum lean angle in all flight modes" VALUE 0x36100000 Scalar_FLOAT32_IEEE 0 CENTIDEGREES 1000.0 8000.0 /end CHARACTERISTIC
/begin COMPU_METHOD CM_RC_FEEL_RP "RC Feel Roll/Pitch" TAB_VERB "%17.6" "" COMPU_TAB_REF TAB_RC_FEEL_RP /end COMPU_METHOD
/begin COMPU_VTAB TAB_RC_FEEL_RP "RC Feel Roll/Pitch, RC feel for roll/pitch which controls vehicle response to user input with 0 being extremely soft and 100 being crisp" TAB_VERB 5 0 "Very Soft" 25 "Soft" 50 "Medium" 75 "Crisp" 100 "Very Crisp" /end COMPU_VTAB
/begin CHARACTERISTIC RC_FEEL_RP "RC Feel Roll/Pitch, RC feel for roll/pitch which controls vehicle response to user input with 0 being extremely soft and 100 being crisp" VALUE 0x36100000 Scalar_FLOAT32_IEEE 0 CM_RC_FEEL_RP 0.0 100.0 /end CHARACTERISTIC
/begin CHARACTERISTIC PHLD_BRAKE_RATE "PosHold braking rate, PosHold flight mode's rotation rate during braking in deg/sec" VALUE 0x36100000 Scalar_FLOAT32_IEEE 0 DEGREES_PER_SECOND 4.0 12.0 /end CHARACTERISTIC
/begin CHARACTERISTIC PHLD_BRAKE_ANGLE "PosHold braking angle max, PosHold flight mode's max lean angle during braking in centi-degrees" VALUE 0x36100000 Scalar_FLOAT32_IEEE 0 CENTIDEGREES 2000.0 4500.0 /end CHARACTERISTIC
/begin COMPU_METHOD CM_LAND_REPOSITION "Land repositioning" TAB_VERB "%17.6" "" COMPU_TAB_REF TAB_LAND_REPOSITION /end COMPU_METHOD
/begin COMPU_VTAB TAB_LAND_REPOSITION "Land repositioning, Enables user input during LAND mode, the landing phase of RTL, and auto mode landings." TAB_VERB 2 0 "No repositioning" 1 "Repositioning" /end COMPU_VTAB
/begin CHARACTERISTIC LAND_REPOSITION "Land repositioning, Enables user input during LAND mode, the landing phase of RTL, and auto mode landings." VALUE 0x36100000 Scalar_FLOAT32_IEEE 0 CM_LAND_REPOSITION 0.0 1.0 /end CHARACTERISTIC
/begin COMPU_METHOD CM_FS_EKF_ACTION "EKF Failsafe Action" TAB_VERB "%17.6" "" COMPU_TAB_REF TAB_FS_EKF_ACTION /end COMPU_METHOD
/begin COMPU_VTAB TAB_FS_EKF_ACTION "EKF Failsafe Action, Controls the action that will be taken when an EKF failsafe is invoked" TAB_VERB 3 1 "Land" 2 "AltHold" 3 "Land even in Stabilize" /end COMPU_VTAB
/begin CHARACTERISTIC FS_EKF_ACTION "EKF Failsafe Action, Controls the action that will be taken when an EKF failsafe is invoked" VALUE 0x36100000 Scalar_FLOAT32_IEEE 0 CM_FS_EKF_ACTION 1.0 3.0 /end CHARACTERISTIC
/begin COMPU_METHOD CM_FS_EKF_THRESH "EKF failsafe variance threshold" TAB_VERB "%17.6" "" COMPU_TAB_REF TAB_FS_EKF_THRESH /end COMPU_METHOD
/begin COMPU_VTAB TAB_FS_EKF_THRESH "EKF failsafe variance threshold, Allows setting the maximum acceptable compass and velocity variance" TAB_VERB 3 0.6 "Strict" 1.0 "Relaxed" 0.8 "Default" /end COMPU_VTAB
/begin CHARACTERISTIC FS_EKF_THRESH "EKF failsafe variance threshold, Allows setting the maximum acceptable compass and velocity variance" VALUE 0x36100000 Scalar_FLOAT32_IEEE 0 CM_FS_EKF_THRESH 0.6 1.0 /end CHARACTERISTIC
/begin COMPU_METHOD CM_FS_CRASH_CHECK "Crash check enable" TAB_VERB "%17.6" "" COMPU_TAB_REF TAB_FS_CRASH_CHECK /end COMPU_METHOD
/begin COMPU_VTAB TAB_FS_CRASH_CHECK "Crash check enable, This enables automatic crash checking. When enabled the motors will disarm if a crash is detected." TAB_VERB 2 0 "Disabled" 1 "Enabled" /end COMPU_VTAB
/begin CHARACTERISTIC FS_CRASH_CHECK "Crash check enable, This enables automatic crash checking. When enabled the motors will disarm if a crash is detected." VALUE 0x36100000 Scalar_FLOAT32_IEEE 0 CM_FS_CRASH_CHECK 0.0 1.0 /end CHARACTERISTIC
/begin CHARACTERISTIC RC_SPEED "ESC Update Speed, This is the speed in Hertz that your ESCs will receive updates" VALUE 0x36100000 Scalar_FLOAT32_IEEE 0 HERZ 50.0 490.0 /end CHARACTERISTIC
/begin CHARACTERISTIC ACRO_RP_P "Acro Roll and Pitch P gain, Converts pilot roll and pitch into a desired rate of rotation in ACRO and SPORT mode.  Higher values mean faster rate of rotation." VALUE 0x36100000 Scalar_FLOAT32_IEEE 0 IDENTICAL 1.0 10.0 /end CHARACTERISTIC
/begin CHARACTERISTIC ACRO_YAW_P "Acro Yaw P gain, Converts pilot yaw input into a desired rate of rotation in ACRO, Stabilize and SPORT modes.  Higher values mean faster rate of rotation." VALUE 0x36100000 Scalar_FLOAT32_IEEE 0 IDENTICAL 1.0 10.0 /end CHARACTERISTIC
/begin CHARACTERISTIC ACRO_BAL_ROLL "Acro Balance Roll, rate at which roll angle returns to level in acro mode.  A higher value causes the vehicle to return to level faster." VALUE 0x36100000 Scalar_FLOAT32_IEEE 0 IDENTICAL 0.0 3.0 /end CHARACTERISTIC
/begin CHARACTERISTIC ACRO_BAL_PITCH "Acro Balance Pitch, rate at which pitch angle returns to level in acro mode.  A higher value causes the vehicle to return to level faster." VALUE 0x36100000 Scalar_FLOAT32_IEEE 0 IDENTICAL 0.0 3.0 /end CHARACTERISTIC
/begin COMPU_METHOD CM_ACRO_TRAINER "Acro Trainer" TAB_VERB "%17.6" "" COMPU_TAB_REF TAB_ACRO_TRAINER /end COMPU_METHOD
/begin COMPU_VTAB TAB_ACRO_TRAINER "Acro Trainer, Type of trainer used in acro mode" TAB_VERB 3 0 "Disabled" 1 "Leveling" 2 "Leveling and Limited" /end COMPU_VTAB
/begin CHARACTERISTIC ACRO_TRAINER "Acro Trainer, Type of trainer used in acro mode" VALUE 0x36100000 Scalar_FLOAT32_IEEE 0 CM_ACRO_TRAINER 0.0 2.0 /end CHARACTERISTIC
/begin COMPU_METHOD CM_ACRO_EXPO "Acro Expo" TAB_VERB "%17.6" "" COMPU_TAB_REF TAB_ACRO_EXPO /end COMPU_METHOD
/begin COMPU_VTAB TAB_ACRO_EXPO "Acro Expo, Acro roll/pitch Expo to allow faster rotation when stick at edges" TAB_VERB 6 0 "Disabled" 0.1 "Very Low" 0.2 "Low" 0.3 "Medium" 0.4 "High" 0.5 "Very High" /end COMPU_VTAB
/begin CHARACTERISTIC ACRO_EXPO "Acro Expo, Acro roll/pitch Expo to allow faster rotation when stick at edges" VALUE 0x36100000 Scalar_FLOAT32_IEEE 0 CM_ACRO_EXPO 0.0 0.5 /end CHARACTERISTIC
/begin CHARACTERISTIC VEL_XY_P "Velocity (horizontal) P gain, Velocity (horizontal) P gain.  Converts the difference between desired velocity to a target acceleration" VALUE 0x36100000 Scalar_FLOAT32_IEEE 0 IDENTICAL 0.1 6.0 /end CHARACTERISTIC
/begin CHARACTERISTIC VEL_XY_I "Velocity (horizontal) I gain, Velocity (horizontal) I gain.  Corrects long-term difference in desired velocity to a target acceleration" VALUE 0x36100000 Scalar_FLOAT32_IEEE 0 IDENTICAL 0.02 1.0 /end CHARACTERISTIC
/begin CHARACTERISTIC VEL_XY_IMAX "Velocity (horizontal) integrator maximum, Velocity (horizontal) integrator maximum.  Constrains the target acceleration that the I gain will output" VALUE 0x36100000 Scalar_FLOAT32_IEEE 0 CENTIMETERS_PER_SECOND_PER_SECOND 0.0 4500.0 /end CHARACTERISTIC
/begin CHARACTERISTIC VEL_Z_P "Velocity (vertical) P gain, Velocity (vertical) P gain.  Converts the difference between desired vertical speed and actual speed into a desired acceleration that is passed to the throttle acceleration controller" VALUE 0x36100000 Scalar_FLOAT32_IEEE 0 IDENTICAL 1.0 8.0 /end CHARACTERISTIC
/begin CHARACTERISTIC ACCEL_Z_P "Throttle acceleration controller P gain, Throttle acceleration controller P gain.  Converts the difference between desired vertical acceleration and actual acceleration into a motor output" VALUE 0x36100000 Scalar_FLOAT32_IEEE 0 IDENTICAL 0.5 1.5 /end CHARACTERISTIC
/begin CHARACTERISTIC ACCEL_Z_I "Throttle acceleration controller I gain, Throttle acceleration controller I gain.  Corrects long-term difference in desired vertical acceleration and actual acceleration" VALUE 0x36100000 Scalar_FLOAT32_IEEE 0 IDENTICAL 0.0 3.0 /end CHARACTERISTIC
/begin CHARACTERISTIC ACCEL_Z_IMAX "Throttle acceleration controller I gain maximum, Throttle acceleration controller I gain maximum.  Constrains the maximum pwm that the I term will generate" VALUE 0x36100000 Scalar_FLOAT32_IEEE 0 DECIPERCENT 0.0 1000.0 /end CHARACTERISTIC
/begin CHARACTERISTIC ACCEL_Z_D "Throttle acceleration controller D gain, Throttle acceleration controller D gain.  Compensates for short-term change in desired vertical acceleration vs actual acceleration" VALUE 0x36100000 Scalar_FLOAT32_IEEE 0 IDENTICAL 0.0 0.4 /end CHARACTERISTIC
/begin CHARACTERISTIC ACCEL_Z_FILT_HZ "Throttle acceleration filter, Filter applied to acceleration to reduce noise.  Lower values reduce noise but add delay." VALUE 0x36100000 Scalar_FLOAT32_IEEE 0 HERZ 1.0 100.0 /end CHARACTERISTIC
/begin CHARACTERISTIC POS_Z_P "Position (vertical) controller P gain, Position (vertical) controller P gain.  Converts the difference between the desired altitude and actual altitude into a climb or descent rate which is passed to the throttle rate controller" VALUE 0x36100000 Scalar_FLOAT32_IEEE 0 IDENTICAL 1.0 3.0 /end CHARACTERISTIC
/begin CHARACTERISTIC POS_XY_P "Position (horizonal) controller P gain, Loiter position controller P gain.  Converts the distance (in the latitude direction) to the target location into a desired speed which is then passed to the loiter latitude rate controller" VALUE 0x36100000 Scalar_FLOAT32_IEEE 0 IDENTICAL 0.5 2.0 /end CHARACTERISTIC
/begin COMPU_METHOD CM_AUTOTUNE_AXES "Autotune axis bitmask" TAB_VERB "%17.6" "" COMPU_TAB_REF TAB_AUTOTUNE_AXES /end COMPU_METHOD
/begin COMPU_VTAB TAB_AUTOTUNE_AXES "Autotune axis bitmask, 1-byte bitmap of axes to autotune" TAB_VERB 7 7 "All" 1 "Roll Only" 2 "Pitch Only" 4 "Yaw Only" 3 "Roll and Pitch" 5 "Roll and Yaw" 6 "Pitch and Yaw" /end COMPU_VTAB
/begin CHARACTERISTIC AUTOTUNE_AXES "Autotune axis bitmask, 1-byte bitmap of axes to autotune" VALUE 0x36100000 Scalar_FLOAT32_IEEE 0 CM_AUTOTUNE_AXES 1.0 7.0 /end CHARACTERISTIC
/begin CHARACTERISTIC AUTOTUNE_AGGR "Autotune aggressiveness, Autotune aggressiveness. Defines the bounce back used to detect size of the D term." VALUE 0x36100000 Scalar_FLOAT32_IEEE 0 IDENTICAL 0.05 0.1 /end CHARACTERISTIC
/begin CHARACTERISTIC AUTOTUNE_MIN_D "AutoTune minimum D, Defines the minimum D gain" VALUE 0x36100000 Scalar_FLOAT32_IEEE 0 IDENTICAL 0.001 0.006 /end CHARACTERISTIC
/begin COMPU_METHOD CM_THROW_MOT_START "Start motors before throwing is detected" TAB_VERB "%17.6" "" COMPU_TAB_REF TAB_THROW_MOT_START /end COMPU_METHOD
/begin COMPU_VTAB TAB_THROW_MOT_START "Start motors before throwing is detected, Used by THROW mode. Controls whether motors will run at the speed set by THR_MIN or will be stopped when armed and waiting for the throw." TAB_VERB 2 0 "Stopped" 1 "Running" /end COMPU_VTAB
/begin CHARACTERISTIC THROW_MOT_START "Start motors before throwing is detected, Used by THROW mode. Controls whether motors will run at the speed set by THR_MIN or will be stopped when armed and waiting for the throw." VALUE 0x36100000 Scalar_FLOAT32_IEEE 0 CM_THROW_MOT_START 0.0 1.0 /end CHARACTERISTIC
/begin COMPU_METHOD CM_TERRAIN_FOLLOW "Terrain Following use control" TAB_VERB "%17.6" "" COMPU_TAB_REF TAB_TERRAIN_FOLLOW /end COMPU_METHOD
/begin COMPU_VTAB TAB_TERRAIN_FOLLOW "Terrain Following use control, This enables terrain following for RTL and LAND flight modes. To use this option TERRAIN_ENABLE must be 1 and the GCS must  support sending terrain data to the aircraft.  In RTL the RTL_ALT will be considered a height above the terrain.  In LAND mode the vehicle will slow to LAND_SPEED 10m above terrain (instead of 10m above home).  This parameter does not affect AUTO and Guided which use a per-command flag to determine if the height is above-home, absolute or above-terrain." TAB_VERB 2 0 "Do Not Use in RTL and Land" 1 "Use in RTL and Land" /end COMPU_VTAB
/begin CHARACTERISTIC TERRAIN_FOLLOW "Terrain Following use control, This enables terrain following for RTL and LAND flight modes. To use this option TERRAIN_ENABLE must be 1 and the GCS must  support sending terrain data to the aircraft.  In RTL the RTL_ALT will be considered a height above the terrain.  In LAND mode the vehicle will slow to LAND_SPEED 10m above terrain (instead of 10m above home).  This parameter does not affect AUTO and Guided which use a per-command flag to determine if the height is above-home, absolute or above-terrain." VALUE 0x36100000 Scalar_FLOAT32_IEEE 0 CM_TERRAIN_FOLLOW 0.0 1.0 /end CHARACTERISTIC
/begin CHARACTERISTIC TKOFF_NAV_ALT "Takeoff navigation altitude, This is the altitude in meters above the takeoff point that attitude changes for navigation can begin" VALUE 0x36100000 Scalar_FLOAT32_IEEE 0 IDENTICAL 0.0 5.0 /end CHARACTERISTIC
/begin COMPU_METHOD CM_THROW_NEXTMODE "Throw mode's follow up mode" TAB_VERB "%17.6" "" COMPU_TAB_REF TAB_THROW_NEXTMODE /end COMPU_METHOD
/begin COMPU_VTAB TAB_THROW_NEXTMODE "Throw mode's follow up mode, Vehicle will switch to this mode after the throw is successfully completed.  Default is to stay in throw mode (18)" TAB_VERB 6 3 "Auto" 4 "Guided" 6 "RTL" 9 "Land" 17 "Brake" 18 "Throw" /end COMPU_VTAB
/begin CHARACTERISTIC THROW_NEXTMODE "Throw mode's follow up mode, Vehicle will switch to this mode after the throw is successfully completed.  Default is to stay in throw mode (18)" VALUE 0x36100000 Scalar_FLOAT32_IEEE 0 CM_THROW_NEXTMODE 3.0 18.0 /end CHARACTERISTIC
/begin COMPU_METHOD CM_THROW_TYPE "Type of Type" TAB_VERB "%17.6" "" COMPU_TAB_REF TAB_THROW_TYPE /end COMPU_METHOD
/begin COMPU_VTAB TAB_THROW_TYPE "Type of Type, Used by THROW mode. Specifies whether Copter is thrown upward or dropped." TAB_VERB 2 0 "Upward Throw" 1 "Drop" /end COMPU_VTAB
/begin CHARACTERISTIC THROW_TYPE "Type of Type, Used by THROW mode. Specifies whether Copter is thrown upward or dropped." VALUE 0x36100000 Scalar_FLOAT32_IEEE 0 CM_THROW_TYPE 0.0 1.0 /end CHARACTERISTIC
/begin COMPU_METHOD CM_GND_EFFECT_COMP "Ground Effect Compensation Enable/Disable" TAB_VERB "%17.6" "" COMPU_TAB_REF TAB_GND_EFFECT_COMP /end COMPU_METHOD
/begin COMPU_VTAB TAB_GND_EFFECT_COMP "Ground Effect Compensation Enable/Disable, Ground Effect Compensation Enable/Disable" TAB_VERB 2 0 "Disabled" 1 "Enabled" /end COMPU_VTAB
/begin CHARACTERISTIC GND_EFFECT_COMP "Ground Effect Compensation Enable/Disable, Ground Effect Compensation Enable/Disable" VALUE 0x36100000 Scalar_FLOAT32_IEEE 0 CM_GND_EFFECT_COMP 0.0 1.0 /end CHARACTERISTIC
/begin COMPU_METHOD CM_SERIAL0_BAUD "Serial0 baud rate" TAB_VERB "%17.6" "" COMPU_TAB_REF TAB_SERIAL0_BAUD /end COMPU_METHOD
/begin COMPU_VTAB TAB_SERIAL0_BAUD "Serial0 baud rate, The baud rate used on the USB console. The APM2 can support all baudrates up to 115, and also can support 500. The PX4 can support rates of up to 1500. If you setup a rate you cannot support on APM2 and then can't connect to your board you should load a firmware from a different vehicle type. That will reset all your parameters to defaults." TAB_VERB 12 1 "1200" 2 "2400" 4 "4800" 9 "9600" 19 "19200" 38 "38400" 57 "57600" 111 "111100" 115 "115200" 500 "500000" 921 "921600" 1500 "1500000" /end COMPU_VTAB
/begin CHARACTERISTIC SERIAL0_BAUD "Serial0 baud rate, The baud rate used on the USB console. The APM2 can support all baudrates up to 115, and also can support 500. The PX4 can support rates of up to 1500. If you setup a rate you cannot support on APM2 and then can't connect to your board you should load a firmware from a different vehicle type. That will reset all your parameters to defaults." VALUE 0x36100000 Scalar_FLOAT32_IEEE 0 CM_SERIAL0_BAUD 1.0 1500.0 /end CHARACTERISTIC
/begin COMPU_METHOD CM_SERIAL0_PROTOCOL "Console protocol selection" TAB_VERB "%17.6" "" COMPU_TAB_REF TAB_SERIAL0_PROTOCOL /end COMPU_METHOD
/begin COMPU_VTAB TAB_SERIAL0_PROTOCOL "Console protocol selection, Control what protocol to use on the console. " TAB_VERB 2 1 "MAVlink1" 2 "MAVLink2" /end COMPU_VTAB
/begin CHARACTERISTIC SERIAL0_PROTOCOL "Console protocol selection, Control what protocol to use on the console. " VALUE 0x36100000 Scalar_FLOAT32_IEEE 0 CM_SERIAL0_PROTOCOL 1.0 2.0 /end CHARACTERISTIC
/begin COMPU_METHOD CM_SERIAL1_PROTOCOL "Telem1 protocol selection" TAB_VERB "%17.6" "" COMPU_TAB_REF TAB_SERIAL1_PROTOCOL /end COMPU_METHOD
/begin COMPU_VTAB TAB_SERIAL1_PROTOCOL "Telem1 protocol selection, Control what protocol to use on the Telem1 port. Note that the Frsky options require external converter hardware. See the wiki for details." TAB_VERB 9 -1 "None" 1 "MAVlink1" 2 "MAVLink2" 3 "Frsky D-PORT" 4 "Frsky S-PORT" 5 "GPS" 7 "Alexmos Gimbal Serial" 8 "SToRM32 Gimbal Serial" 9 "Lidar" /end COMPU_VTAB
/begin CHARACTERISTIC SERIAL1_PROTOCOL "Telem1 protocol selection, Control what protocol to use on the Telem1 port. Note that the Frsky options require external converter hardware. See the wiki for details." VALUE 0x36100000 Scalar_FLOAT32_IEEE 0 CM_SERIAL1_PROTOCOL -1.0 9.0 /end CHARACTERISTIC
/begin COMPU_METHOD CM_SERIAL1_BAUD "Telem1 Baud Rate" TAB_VERB "%17.6" "" COMPU_TAB_REF TAB_SERIAL1_BAUD /end COMPU_METHOD
/begin COMPU_VTAB TAB_SERIAL1_BAUD "Telem1 Baud Rate, The baud rate used on the Telem1 port. The APM2 can support all baudrates up to 115, and also can support 500. The PX4 can support rates of up to 1500. If you setup a rate you cannot support on APM2 and then can't connect to your board you should load a firmware from a different vehicle type. That will reset all your parameters to defaults." TAB_VERB 12 1 "1200" 2 "2400" 4 "4800" 9 "9600" 19 "19200" 38 "38400" 57 "57600" 111 "111100" 115 "115200" 500 "500000" 921 "921600" 1500 "1500000" /end COMPU_VTAB
/begin CHARACTERISTIC SERIAL1_BAUD "Telem1 Baud Rate, The baud rate used on the Telem1 port. The APM2 can support all baudrates up to 115, and also can support 500. The PX4 can support rates of up to 1500. If you setup a rate you cannot support on APM2 and then can't connect to your board you should load a firmware from a different vehicle type. That will reset all your parameters to defaults." VALUE 0x36100000 Scalar_FLOAT32_IEEE 0 CM_SERIAL1_BAUD 1.0 1500.0 /end CHARACTERISTIC
/begin COMPU_METHOD CM_SERIAL2_PROTOCOL "Telemetry 2 protocol selection" TAB_VERB "%17.6" "" COMPU_TAB_REF TAB_SERIAL2_PROTOCOL /end COMPU_METHOD
/begin COMPU_VTAB TAB_SERIAL2_PROTOCOL "Telemetry 2 protocol selection, Control what protocol to use on the Telem2 port. Note that the Frsky options require external converter hardware. See the wiki for details." TAB_VERB 9 -1 "None" 1 "MAVlink1" 2 "MAVLink2" 3 "Frsky D-PORT" 4 "Frsky S-PORT" 5 "GPS" 7 "Alexmos Gimbal Serial" 8 "SToRM32 Gimbal Serial" 9 "Lidar" /end COMPU_VTAB
/begin CHARACTERISTIC SERIAL2_PROTOCOL "Telemetry 2 protocol selection, Control what protocol to use on the Telem2 port. Note that the Frsky options require external converter hardware. See the wiki for details." VALUE 0x36100000 Scalar_FLOAT32_IEEE 0 CM_SERIAL2_PROTOCOL -1.0 9.0 /end CHARACTERISTIC
/begin COMPU_METHOD CM_SERIAL2_BAUD "Telemetry 2 Baud Rate" TAB_VERB "%17.6" "" COMPU_TAB_REF TAB_SERIAL2_BAUD /end COMPU_METHOD
/begin COMPU_VTAB TAB_SERIAL2_BAUD "Telemetry 2 Baud Rate, The baud rate of the Telem2 port. The APM2 can support all baudrates up to 115, and also can support 500. The PX4 can support rates of up to 1500. If you setup a rate you cannot support on APM2 and then can't connect to your board you should load a firmware from a different vehicle type. That will reset all your parameters to defaults." TAB_VERB 12 1 "1200" 2 "2400" 4 "4800" 9 "9600" 19 "19200" 38 "38400" 57 "57600" 111 "111100" 115 "115200" 500 "500000" 921 "921600" 1500 "1500000" /end COMPU_VTAB
/begin CHARACTERISTIC SERIAL2_BAUD "Telemetry 2 Baud Rate, The baud rate of the Telem2 port. The APM2 can support all baudrates up to 115, and also can support 500. The PX4 can support rates of up to 1500. If you setup a rate you cannot support on APM2 and then can't connect to your board you should load a firmware from a different vehicle type. That will reset all your parameters to defaults." VALUE 0x36100000 Scalar_FLOAT32_IEEE 0 CM_SERIAL2_BAUD 1.0 1500.0 /end CHARACTERISTIC
/begin COMPU_METHOD CM_SERIAL3_PROTOCOL "Serial 3 (GPS) protocol selection" TAB_VERB "%17.6" "" COMPU_TAB_REF TAB_SERIAL3_PROTOCOL /end COMPU_METHOD
/begin COMPU_VTAB TAB_SERIAL3_PROTOCOL "Serial 3 (GPS) protocol selection, Control what protocol Serial 3 (GPS) should be used for. Note that the Frsky options require external converter hardware. See the wiki for details." TAB_VERB 9 -1 "None" 1 "MAVlink1" 2 "MAVLink2" 3 "Frsky D-PORT" 4 "Frsky S-PORT" 5 "GPS" 7 "Alexmos Gimbal Serial" 8 "SToRM32 Gimbal Serial" 9 "Lidar" /end COMPU_VTAB
/begin CHARACTERISTIC SERIAL3_PROTOCOL "Serial 3 (GPS) protocol selection, Control what protocol Serial 3 (GPS) should be used for. Note that the Frsky options require external converter hardware. See the wiki for details." VALUE 0x36100000 Scalar_FLOAT32_IEEE 0 CM_SERIAL3_PROTOCOL -1.0 9.0 /end CHARACTERISTIC
/begin COMPU_METHOD CM_SERIAL3_BAUD "Serial 3 (GPS) Baud Rate" TAB_VERB "%17.6" "" COMPU_TAB_REF TAB_SERIAL3_BAUD /end COMPU_METHOD
/begin COMPU_VTAB TAB_SERIAL3_BAUD "Serial 3 (GPS) Baud Rate, The baud rate used for the Serial 3 (GPS). The APM2 can support all baudrates up to 115, and also can support 500. The PX4 can support rates of up to 1500. If you setup a rate you cannot support on APM2 and then can't connect to your board you should load a firmware from a different vehicle type. That will reset all your parameters to defaults." TAB_VERB 12 1 "1200" 2 "2400" 4 "4800" 9 "9600" 19 "19200" 38 "38400" 57 "57600" 111 "111100" 115 "115200" 500 "500000" 921 "921600" 1500 "1500000" /end COMPU_VTAB
/begin CHARACTERISTIC SERIAL3_BAUD "Serial 3 (GPS) Baud Rate, The baud rate used for the Serial 3 (GPS). The APM2 can support all baudrates up to 115, and also can support 500. The PX4 can support rates of up to 1500. If you setup a rate you cannot support on APM2 and then can't connect to your board you should load a firmware from a different vehicle type. That will reset all your parameters to defaults." VALUE 0x36100000 Scalar_FLOAT32_IEEE 0 CM_SERIAL3_BAUD 1.0 1500.0 /end CHARACTERISTIC
/begin COMPU_METHOD CM_SERIAL4_PROTOCOL "Serial4 protocol selection" TAB_VERB "%17.6" "" COMPU_TAB_REF TAB_SERIAL4_PROTOCOL /end COMPU_METHOD
/begin COMPU_VTAB TAB_SERIAL4_PROTOCOL "Serial4 protocol selection, Control what protocol Serial4 port should be used for. Note that the Frsky options require external converter hardware. See the wiki for details." TAB_VERB 9 -1 "None" 1 "MAVlink1" 2 "MAVLink2" 3 "Frsky D-PORT" 4 "Frsky S-PORT" 5 "GPS" 7 "Alexmos Gimbal Serial" 8 "SToRM32 Gimbal Serial" 9 "Lidar" /end COMPU_VTAB
/begin CHARACTERISTIC SERIAL4_PROTOCOL "Serial4 protocol selection, Control what protocol Serial4 port should be used for. Note that the Frsky options require external converter hardware. See the wiki for details." VALUE 0x36100000 Scalar_FLOAT32_IEEE 0 CM_SERIAL4_PROTOCOL -1.0 9.0 /end CHARACTERISTIC
/begin COMPU_METHOD CM_SERIAL4_BAUD "Serial 4 Baud Rate" TAB_VERB "%17.6" "" COMPU_TAB_REF TAB_SERIAL4_BAUD /end COMPU_METHOD
/begin COMPU_VTAB TAB_SERIAL4_BAUD "Serial 4 Baud Rate, The baud rate used for Serial4. The APM2 can support all baudrates up to 115, and also can support 500. The PX4 can support rates of up to 1500. If you setup a rate you cannot support on APM2 and then can't connect to your board you should load a firmware from a different vehicle type. That will reset all your parameters to defaults." TAB_VERB 12 1 "1200" 2 "2400" 4 "4800" 9 "9600" 19 "19200" 38 "38400" 57 "57600" 111 "111100" 115 "115200" 500 "500000" 921 "921600" 1500 "1500000" /end COMPU_VTAB
/begin CHARACTERISTIC SERIAL4_BAUD "Serial 4 Baud Rate, The baud rate used for Serial4. The APM2 can support all baudrates up to 115, and also can support 500. The PX4 can support rates of up to 1500. If you setup a rate you cannot support on APM2 and then can't connect to your board you should load a firmware from a different vehicle type. That will reset all your parameters to defaults." VALUE 0x36100000 Scalar_FLOAT32_IEEE 0 CM_SERIAL4_BAUD 1.0 1500.0 /end CHARACTERISTIC
/begin COMPU_METHOD CM_SERIAL5_PROTOCOL "Serial5 protocol selection" TAB_VERB "%17.6" "" COMPU_TAB_REF TAB_SERIAL5_PROTOCOL /end COMPU_METHOD
/begin COMPU_VTAB TAB_SERIAL5_PROTOCOL "Serial5 protocol selection, Control what protocol Serial5 port should be used for. Note that the Frsky options require external converter hardware. See the wiki for details." TAB_VERB 9 -1 "None" 1 "MAVlink1" 2 "MAVLink2" 3 "Frsky D-PORT" 4 "Frsky S-PORT" 5 "GPS" 7 "Alexmos Gimbal Serial" 8 "SToRM32 Gimbal Serial" 9 "Lidar" /end COMPU_VTAB
/begin CHARACTERISTIC SERIAL5_PROTOCOL "Serial5 protocol selection, Control what protocol Serial5 port should be used for. Note that the Frsky options require external converter hardware. See the wiki for details." VALUE 0x36100000 Scalar_FLOAT32_IEEE 0 CM_SERIAL5_PROTOCOL -1.0 9.0 /end CHARACTERISTIC
/begin COMPU_METHOD CM_SERIAL5_BAUD "Serial 5 Baud Rate" TAB_VERB "%17.6" "" COMPU_TAB_REF TAB_SERIAL5_BAUD /end COMPU_METHOD
/begin COMPU_VTAB TAB_SERIAL5_BAUD "Serial 5 Baud Rate, The baud rate used for Serial5. The APM2 can support all baudrates up to 115, and also can support 500. The PX4 can support rates of up to 1500. If you setup a rate you cannot support on APM2 and then can't connect to your board you should load a firmware from a different vehicle type. That will reset all your parameters to defaults." TAB_VERB 12 1 "1200" 2 "2400" 4 "4800" 9 "9600" 19 "19200" 38 "38400" 57 "57600" 111 "111100" 115 "115200" 500 "500000" 921 "921600" 1500 "1500000" /end COMPU_VTAB
/begin CHARACTERISTIC SERIAL5_BAUD "Serial 5 Baud Rate, The baud rate used for Serial5. The APM2 can support all baudrates up to 115, and also can support 500. The PX4 can support rates of up to 1500. If you setup a rate you cannot support on APM2 and then can't connect to your board you should load a firmware from a different vehicle type. That will reset all your parameters to defaults." VALUE 0x36100000 Scalar_FLOAT32_IEEE 0 CM_SERIAL5_BAUD 1.0 1500.0 /end CHARACTERISTIC
/begin CHARACTERISTIC RC1_MIN "RC min PWM, RC minimum PWM pulse width. Typically 1000 is lower limit, 1500 is neutral and 2000 is upper limit." VALUE 0x36100000 Scalar_FLOAT32_IEEE 0 MICROSECONDS 800.0 2200.0 /end CHARACTERISTIC
/begin CHARACTERISTIC RC1_TRIM "RC trim PWM, RC trim (neutral) PWM pulse width. Typically 1000 is lower limit, 1500 is neutral and 2000 is upper limit." VALUE 0x36100000 Scalar_FLOAT32_IEEE 0 MICROSECONDS 800.0 2200.0 /end CHARACTERISTIC
/begin CHARACTERISTIC RC1_MAX "RC max PWM, RC maximum PWM pulse width. Typically 1000 is lower limit, 1500 is neutral and 2000 is upper limit." VALUE 0x36100000 Scalar_FLOAT32_IEEE 0 MICROSECONDS 800.0 2200.0 /end CHARACTERISTIC
/begin COMPU_METHOD CM_RC1_REV "RC reverse" TAB_VERB "%17.6" "" COMPU_TAB_REF TAB_RC1_REV /end COMPU_METHOD
/begin COMPU_VTAB TAB_RC1_REV "RC reverse, Reverse servo operation. Set to 1 for normal (forward) operation. Set to -1 to reverse this channel." TAB_VERB 2 -1 "Reversed" 1 "Normal" /end COMPU_VTAB
/begin CHARACTERISTIC RC1_REV "RC reverse, Reverse servo operation. Set to 1 for normal (forward) operation. Set to -1 to reverse this channel." VALUE 0x36100000 Scalar_FLOAT32_IEEE 0 CM_RC1_REV -1.0 1.0 /end CHARACTERISTIC
/begin CHARACTERISTIC RC1_DZ "RC dead-zone, dead zone around trim or bottom" VALUE 0x36100000 Scalar_FLOAT32_IEEE 0 MICROSECONDS 0.0 200.0 /end CHARACTERISTIC
/begin CHARACTERISTIC RC2_MIN "RC min PWM, RC minimum PWM pulse width. Typically 1000 is lower limit, 1500 is neutral and 2000 is upper limit." VALUE 0x36100000 Scalar_FLOAT32_IEEE 0 MICROSECONDS 800.0 2200.0 /end CHARACTERISTIC
/begin CHARACTERISTIC RC2_TRIM "RC trim PWM, RC trim (neutral) PWM pulse width. Typically 1000 is lower limit, 1500 is neutral and 2000 is upper limit." VALUE 0x36100000 Scalar_FLOAT32_IEEE 0 MICROSECONDS 800.0 2200.0 /end CHARACTERISTIC
/begin CHARACTERISTIC RC2_MAX "RC max PWM, RC maximum PWM pulse width. Typically 1000 is lower limit, 1500 is neutral and 2000 is upper limit." VALUE 0x36100000 Scalar_FLOAT32_IEEE 0 MICROSECONDS 800.0 2200.0 /end CHARACTERISTIC
/begin COMPU_METHOD CM_RC2_REV "RC reverse" TAB_VERB "%17.6" "" COMPU_TAB_REF TAB_RC2_REV /end COMPU_METHOD
/begin COMPU_VTAB TAB_RC2_REV "RC reverse, Reverse servo operation. Set to 1 for normal (forward) operation. Set to -1 to reverse this channel." TAB_VERB 2 -1 "Reversed" 1 "Normal" /end COMPU_VTAB
/begin CHARACTERISTIC RC2_REV "RC reverse, Reverse servo operation. Set to 1 for normal (forward) operation. Set to -1 to reverse this channel." VALUE 0x36100000 Scalar_FLOAT32_IEEE 0 CM_RC2_REV -1.0 1.0 /end CHARACTERISTIC
/begin CHARACTERISTIC RC2_DZ "RC dead-zone, dead zone around trim or bottom" VALUE 0x36100000 Scalar_FLOAT32_IEEE 0 MICROSECONDS 0.0 200.0 /end CHARACTERISTIC
/begin CHARACTERISTIC RC3_MIN "RC min PWM, RC minimum PWM pulse width. Typically 1000 is lower limit, 1500 is neutral and 2000 is upper limit." VALUE 0x36100000 Scalar_FLOAT32_IEEE 0 MICROSECONDS 800.0 2200.0 /end CHARACTERISTIC
/begin CHARACTERISTIC RC3_TRIM "RC trim PWM, RC trim (neutral) PWM pulse width. Typically 1000 is lower limit, 1500 is neutral and 2000 is upper limit." VALUE 0x36100000 Scalar_FLOAT32_IEEE 0 MICROSECONDS 800.0 2200.0 /end CHARACTERISTIC
/begin CHARACTERISTIC RC3_MAX "RC max PWM, RC maximum PWM pulse width. Typically 1000 is lower limit, 1500 is neutral and 2000 is upper limit." VALUE 0x36100000 Scalar_FLOAT32_IEEE 0 MICROSECONDS 800.0 2200.0 /end CHARACTERISTIC
/begin COMPU_METHOD CM_RC3_REV "RC reverse" TAB_VERB "%17.6" "" COMPU_TAB_REF TAB_RC3_REV /end COMPU_METHOD
/begin COMPU_VTAB TAB_RC3_REV "RC reverse, Reverse servo operation. Set to 1 for normal (forward) operation. Set to -1 to reverse this channel." TAB_VERB 2 -1 "Reversed" 1 "Normal" /end COMPU_VTAB
/begin CHARACTERISTIC RC3_REV "RC reverse, Reverse servo operation. Set to 1 for normal (forward) operation. Set to -1 to reverse this channel." VALUE 0x36100000 Scalar_FLOAT32_IEEE 0 CM_RC3_REV -1.0 1.0 /end CHARACTERISTIC
/begin CHARACTERISTIC RC3_DZ "RC dead-zone, dead zone around trim or bottom" VALUE 0x36100000 Scalar_FLOAT32_IEEE 0 MICROSECONDS 0.0 200.0 /end CHARACTERISTIC
/begin CHARACTERISTIC RC4_MIN "RC min PWM, RC minimum PWM pulse width. Typically 1000 is lower limit, 1500 is neutral and 2000 is upper limit." VALUE 0x36100000 Scalar_FLOAT32_IEEE 0 MICROSECONDS 800.0 2200.0 /end CHARACTERISTIC
/begin CHARACTERISTIC RC4_TRIM "RC trim PWM, RC trim (neutral) PWM pulse width. Typically 1000 is lower limit, 1500 is neutral and 2000 is upper limit." VALUE 0x36100000 Scalar_FLOAT32_IEEE 0 MICROSECONDS 800.0 2200.0 /end CHARACTERISTIC
/begin CHARACTERISTIC RC4_MAX "RC max PWM, RC maximum PWM pulse width. Typically 1000 is lower limit, 1500 is neutral and 2000 is upper limit." VALUE 0x36100000 Scalar_FLOAT32_IEEE 0 MICROSECONDS 800.0 2200.0 /end CHARACTERISTIC
/begin COMPU_METHOD CM_RC4_REV "RC reverse" TAB_VERB "%17.6" "" COMPU_TAB_REF TAB_RC4_REV /end COMPU_METHOD
/begin COMPU_VTAB TAB_RC4_REV "RC reverse, Reverse servo operation. Set to 1 for normal (forward) operation. Set to -1 to reverse this channel." TAB_VERB 2 -1 "Reversed" 1 "Normal" /end COMPU_VTAB
/begin CHARACTERISTIC RC4_REV "RC reverse, Reverse servo operation. Set to 1 for normal (forward) operation. Set to -1 to reverse this channel." VALUE 0x36100000 Scalar_FLOAT32_IEEE 0 CM_RC4_REV -1.0 1.0 /end CHARACTERISTIC
/begin CHARACTERISTIC RC4_DZ "RC dead-zone, dead zone around trim or bottom" VALUE 0x36100000 Scalar_FLOAT32_IEEE 0 MICROSECONDS 0.0 200.0 /end CHARACTERISTIC
/begin CHARACTERISTIC RC5_MIN "RC min PWM, RC minimum PWM pulse width. Typically 1000 is lower limit, 1500 is neutral and 2000 is upper limit." VALUE 0x36100000 Scalar_FLOAT32_IEEE 0 MICROSECONDS 800.0 2200.0 /end CHARACTERISTIC
/begin CHARACTERISTIC RC5_TRIM "RC trim PWM, RC trim (neutral) PWM pulse width. Typically 1000 is lower limit, 1500 is neutral and 2000 is upper limit." VALUE 0x36100000 Scalar_FLOAT32_IEEE 0 MICROSECONDS 800.0 2200.0 /end CHARACTERISTIC
/begin CHARACTERISTIC RC5_MAX "RC max PWM, RC maximum PWM pulse width. Typically 1000 is lower limit, 1500 is neutral and 2000 is upper limit." VALUE 0x36100000 Scalar_FLOAT32_IEEE 0 MICROSECONDS 800.0 2200.0 /end CHARACTERISTIC
/begin COMPU_METHOD CM_RC5_REV "RC reverse" TAB_VERB "%17.6" "" COMPU_TAB_REF TAB_RC5_REV /end COMPU_METHOD
/begin COMPU_VTAB TAB_RC5_REV "RC reverse, Reverse servo operation. Set to 1 for normal (forward) operation. Set to -1 to reverse this channel." TAB_VERB 2 -1 "Reversed" 1 "Normal" /end COMPU_VTAB
/begin CHARACTERISTIC RC5_REV "RC reverse, Reverse servo operation. Set to 1 for normal (forward) operation. Set to -1 to reverse this channel." VALUE 0x36100000 Scalar_FLOAT32_IEEE 0 CM_RC5_REV -1.0 1.0 /end CHARACTERISTIC
/begin CHARACTERISTIC RC5_DZ "RC dead-zone, dead zone around trim or bottom" VALUE 0x36100000 Scalar_FLOAT32_IEEE 0 MICROSECONDS 0.0 200.0 /end CHARACTERISTIC
/begin COMPU_METHOD CM_RC5_FUNCTION "Servo out function" TAB_VERB "%17.6" "" COMPU_TAB_REF TAB_RC5_FUNCTION /end COMPU_METHOD
/begin COMPU_VTAB TAB_RC5_FUNCTION "Servo out function, Setting this to Disabled(0) will setup this output for control by auto missions or MAVLink servo set commands. any other value will enable the corresponding function" TAB_VERB 54 0 "Disabled" 1 "RCPassThru" 2 "Flap" 3 "Flap_auto" 4 "Aileron" 6 "mount_pan" 7 "mount_tilt" 8 "mount_roll" 9 "mount_open" 10 "camera_trigger" 11 "release" 12 "mount2_pan" 13 "mount2_tilt" 14 "mount2_roll" 15 "mount2_open" 16 "DifferentialSpoiler1" 17 "DifferentialSpoiler2" 18 "AileronWithInput" 19 "Elevator" 20 "ElevatorWithInput" 21 "Rudder" 24 "Flaperon1" 25 "Flaperon2" 26 "GroundSteering" 27 "Parachute" 28 "EPM" 29 "LandingGear" 30 "EngineRunEnable" 31 "HeliRSC" 32 "HeliTailRSC" 33 "Motor1" 34 "Motor2" 35 "Motor3" 36 "Motor4" 37 "Motor5" 38 "Motor6" 39 "Motor7" 40 "Motor8" 51 "RCIN1" 52 "RCIN2" 53 "RCIN3" 54 "RCIN4" 55 "RCIN5" 56 "RCIN6" 57 "RCIN7" 58 "RCIN8" 59 "RCIN9" 60 "RCIN10" 61 "RCIN11" 62 "RCIN12" 63 "RCIN13" 64 "RCIN14" 65 "RCIN15" 66 "RCIN16" /end COMPU_VTAB
/begin CHARACTERISTIC RC5_FUNCTION "Servo out function, Setting this to Disabled(0) will setup this output for control by auto missions or MAVLink servo set commands. any other value will enable the corresponding function" VALUE 0x36100000 Scalar_FLOAT32_IEEE 0 CM_RC5_FUNCTION 0.0 66.0 /end CHARACTERISTIC
/begin CHARACTERISTIC RC6_MIN "RC min PWM, RC minimum PWM pulse width. Typically 1000 is lower limit, 1500 is neutral and 2000 is upper limit." VALUE 0x36100000 Scalar_FLOAT32_IEEE 0 MICROSECONDS 800.0 2200.0 /end CHARACTERISTIC
/begin CHARACTERISTIC RC6_TRIM "RC trim PWM, RC trim (neutral) PWM pulse width. Typically 1000 is lower limit, 1500 is neutral and 2000 is upper limit." VALUE 0x36100000 Scalar_FLOAT32_IEEE 0 MICROSECONDS 800.0 2200.0 /end CHARACTERISTIC
/begin CHARACTERISTIC RC6_MAX "RC max PWM, RC maximum PWM pulse width. Typically 1000 is lower limit, 1500 is neutral and 2000 is upper limit." VALUE 0x36100000 Scalar_FLOAT32_IEEE 0 MICROSECONDS 800.0 2200.0 /end CHARACTERISTIC
/begin COMPU_METHOD CM_RC6_REV "RC reverse" TAB_VERB "%17.6" "" COMPU_TAB_REF TAB_RC6_REV /end COMPU_METHOD
/begin COMPU_VTAB TAB_RC6_REV "RC reverse, Reverse servo operation. Set to 1 for normal (forward) operation. Set to -1 to reverse this channel." TAB_VERB 2 -1 "Reversed" 1 "Normal" /end COMPU_VTAB
/begin CHARACTERISTIC RC6_REV "RC reverse, Reverse servo operation. Set to 1 for normal (forward) operation. Set to -1 to reverse this channel." VALUE 0x36100000 Scalar_FLOAT32_IEEE 0 CM_RC6_REV -1.0 1.0 /end CHARACTERISTIC
/begin CHARACTERISTIC RC6_DZ "RC dead-zone, dead zone around trim or bottom" VALUE 0x36100000 Scalar_FLOAT32_IEEE 0 MICROSECONDS 0.0 200.0 /end CHARACTERISTIC
/begin COMPU_METHOD CM_RC6_FUNCTION "Servo out function" TAB_VERB "%17.6" "" COMPU_TAB_REF TAB_RC6_FUNCTION /end COMPU_METHOD
/begin COMPU_VTAB TAB_RC6_FUNCTION "Servo out function, Setting this to Disabled(0) will setup this output for control by auto missions or MAVLink servo set commands. any other value will enable the corresponding function" TAB_VERB 54 0 "Disabled" 1 "RCPassThru" 2 "Flap" 3 "Flap_auto" 4 "Aileron" 6 "mount_pan" 7 "mount_tilt" 8 "mount_roll" 9 "mount_open" 10 "camera_trigger" 11 "release" 12 "mount2_pan" 13 "mount2_tilt" 14 "mount2_roll" 15 "mount2_open" 16 "DifferentialSpoiler1" 17 "DifferentialSpoiler2" 18 "AileronWithInput" 19 "Elevator" 20 "ElevatorWithInput" 21 "Rudder" 24 "Flaperon1" 25 "Flaperon2" 26 "GroundSteering" 27 "Parachute" 28 "EPM" 29 "LandingGear" 30 "EngineRunEnable" 31 "HeliRSC" 32 "HeliTailRSC" 33 "Motor1" 34 "Motor2" 35 "Motor3" 36 "Motor4" 37 "Motor5" 38 "Motor6" 39 "Motor7" 40 "Motor8" 51 "RCIN1" 52 "RCIN2" 53 "RCIN3" 54 "RCIN4" 55 "RCIN5" 56 "RCIN6" 57 "RCIN7" 58 "RCIN8" 59 "RCIN9" 60 "RCIN10" 61 "RCIN11" 62 "RCIN12" 63 "RCIN13" 64 "RCIN14" 65 "RCIN15" 66 "RCIN16" /end COMPU_VTAB
/begin CHARACTERISTIC RC6_FUNCTION "Servo out function, Setting this to Disabled(0) will setup this output for control by auto missions or MAVLink servo set commands. any other value will enable the corresponding function" VALUE 0x36100000 Scalar_FLOAT32_IEEE 0 CM_RC6_FUNCTION 0.0 66.0 /end CHARACTERISTIC
/begin CHARACTERISTIC RC7_MIN "RC min PWM, RC minimum PWM pulse width. Typically 1000 is lower limit, 1500 is neutral and 2000 is upper limit." VALUE 0x36100000 Scalar_FLOAT32_IEEE 0 MICROSECONDS 800.0 2200.0 /end CHARACTERISTIC
/begin CHARACTERISTIC RC7_TRIM "RC trim PWM, RC trim (neutral) PWM pulse width. Typically 1000 is lower limit, 1500 is neutral and 2000 is upper limit." VALUE 0x36100000 Scalar_FLOAT32_IEEE 0 MICROSECONDS 800.0 2200.0 /end CHARACTERISTIC
/begin CHARACTERISTIC RC7_MAX "RC max PWM, RC maximum PWM pulse width. Typically 1000 is lower limit, 1500 is neutral and 2000 is upper limit." VALUE 0x36100000 Scalar_FLOAT32_IEEE 0 MICROSECONDS 800.0 2200.0 /end CHARACTERISTIC
/begin COMPU_METHOD CM_RC7_REV "RC reverse" TAB_VERB "%17.6" "" COMPU_TAB_REF TAB_RC7_REV /end COMPU_METHOD
/begin COMPU_VTAB TAB_RC7_REV "RC reverse, Reverse servo operation. Set to 1 for normal (forward) operation. Set to -1 to reverse this channel." TAB_VERB 2 -1 "Reversed" 1 "Normal" /end COMPU_VTAB
/begin CHARACTERISTIC RC7_REV "RC reverse, Reverse servo operation. Set to 1 for normal (forward) operation. Set to -1 to reverse this channel." VALUE 0x36100000 Scalar_FLOAT32_IEEE 0 CM_RC7_REV -1.0 1.0 /end CHARACTERISTIC
/begin CHARACTERISTIC RC7_DZ "RC dead-zone, dead zone around trim or bottom" VALUE 0x36100000 Scalar_FLOAT32_IEEE 0 MICROSECONDS 0.0 200.0 /end CHARACTERISTIC
/begin COMPU_METHOD CM_RC7_FUNCTION "Servo out function" TAB_VERB "%17.6" "" COMPU_TAB_REF TAB_RC7_FUNCTION /end COMPU_METHOD
/begin COMPU_VTAB TAB_RC7_FUNCTION "Servo out function, Setting this to Disabled(0) will setup this output for control by auto missions or MAVLink servo set commands. any other value will enable the corresponding function" TAB_VERB 54 0 "Disabled" 1 "RCPassThru" 2 "Flap" 3 "Flap_auto" 4 "Aileron" 6 "mount_pan" 7 "mount_tilt" 8 "mount_roll" 9 "mount_open" 10 "camera_trigger" 11 "release" 12 "mount2_pan" 13 "mount2_tilt" 14 "mount2_roll" 15 "mount2_open" 16 "DifferentialSpoiler1" 17 "DifferentialSpoiler2" 18 "AileronWithInput" 19 "Elevator" 20 "ElevatorWithInput" 21 "Rudder" 24 "Flaperon1" 25 "Flaperon2" 26 "GroundSteering" 27 "Parachute" 28 "EPM" 29 "LandingGear" 30 "EngineRunEnable" 31 "HeliRSC" 32 "HeliTailRSC" 33 "Motor1" 34 "Motor2" 35 "Motor3" 36 "Motor4" 37 "Motor5" 38 "Motor6" 39 "Motor7" 40 "Motor8" 51 "RCIN1" 52 "RCIN2" 53 "RCIN3" 54 "RCIN4" 55 "RCIN5" 56 "RCIN6" 57 "RCIN7" 58 "RCIN8" 59 "RCIN9" 60 "RCIN10" 61 "RCIN11" 62 "RCIN12" 63 "RCIN13" 64 "RCIN14" 65 "RCIN15" 66 "RCIN16" /end COMPU_VTAB
/begin CHARACTERISTIC RC7_FUNCTION "Servo out function, Setting this to Disabled(0) will setup this output for control by auto missions or MAVLink servo set commands. any other value will enable the corresponding function" VALUE 0x36100000 Scalar_FLOAT32_IEEE 0 CM_RC7_FUNCTION 0.0 66.0 /end CHARACTERISTIC
/begin CHARACTERISTIC RC8_MIN "RC min PWM, RC minimum PWM pulse width. Typically 1000 is lower limit, 1500 is neutral and 2000 is upper limit." VALUE 0x36100000 Scalar_FLOAT32_IEEE 0 MICROSECONDS 800.0 2200.0 /end CHARACTERISTIC
/begin CHARACTERISTIC RC8_TRIM "RC trim PWM, RC trim (neutral) PWM pulse width. Typically 1000 is lower limit, 1500 is neutral and 2000 is upper limit." VALUE 0x36100000 Scalar_FLOAT32_IEEE 0 MICROSECONDS 800.0 2200.0 /end CHARACTERISTIC
/begin CHARACTERISTIC RC8_MAX "RC max PWM, RC maximum PWM pulse width. Typically 1000 is lower limit, 1500 is neutral and 2000 is upper limit." VALUE 0x36100000 Scalar_FLOAT32_IEEE 0 MICROSECONDS 800.0 2200.0 /end CHARACTERISTIC
/begin COMPU_METHOD CM_RC8_REV "RC reverse" TAB_VERB "%17.6" "" COMPU_TAB_REF TAB_RC8_REV /end COMPU_METHOD
/begin COMPU_VTAB TAB_RC8_REV "RC reverse, Reverse servo operation. Set to 1 for normal (forward) operation. Set to -1 to reverse this channel." TAB_VERB 2 -1 "Reversed" 1 "Normal" /end COMPU_VTAB
/begin CHARACTERISTIC RC8_REV "RC reverse, Reverse servo operation. Set to 1 for normal (forward) operation. Set to -1 to reverse this channel." VALUE 0x36100000 Scalar_FLOAT32_IEEE 0 CM_RC8_REV -1.0 1.0 /end CHARACTERISTIC
/begin CHARACTERISTIC RC8_DZ "RC dead-zone, dead zone around trim or bottom" VALUE 0x36100000 Scalar_FLOAT32_IEEE 0 MICROSECONDS 0.0 200.0 /end CHARACTERISTIC
/begin COMPU_METHOD CM_RC8_FUNCTION "Servo out function" TAB_VERB "%17.6" "" COMPU_TAB_REF TAB_RC8_FUNCTION /end COMPU_METHOD
/begin COMPU_VTAB TAB_RC8_FUNCTION "Servo out function, Setting this to Disabled(0) will setup this output for control by auto missions or MAVLink servo set commands. any other value will enable the corresponding function" TAB_VERB 54 0 "Disabled" 1 "RCPassThru" 2 "Flap" 3 "Flap_auto" 4 "Aileron" 6 "mount_pan" 7 "mount_tilt" 8 "mount_roll" 9 "mount_open" 10 "camera_trigger" 11 "release" 12 "mount2_pan" 13 "mount2_tilt" 14 "mount2_roll" 15 "mount2_open" 16 "DifferentialSpoiler1" 17 "DifferentialSpoiler2" 18 "AileronWithInput" 19 "Elevator" 20 "ElevatorWithInput" 21 "Rudder" 24 "Flaperon1" 25 "Flaperon2" 26 "GroundSteering" 27 "Parachute" 28 "EPM" 29 "LandingGear" 30 "EngineRunEnable" 31 "HeliRSC" 32 "HeliTailRSC" 33 "Motor1" 34 "Motor2" 35 "Motor3" 36 "Motor4" 37 "Motor5" 38 "Motor6" 39 "Motor7" 40 "Motor8" 51 "RCIN1" 52 "RCIN2" 53 "RCIN3" 54 "RCIN4" 55 "RCIN5" 56 "RCIN6" 57 "RCIN7" 58 "RCIN8" 59 "RCIN9" 60 "RCIN10" 61 "RCIN11" 62 "RCIN12" 63 "RCIN13" 64 "RCIN14" 65 "RCIN15" 66 "RCIN16" /end COMPU_VTAB
/begin CHARACTERISTIC RC8_FUNCTION "Servo out function, Setting this to Disabled(0) will setup this output for control by auto missions or MAVLink servo set commands. any other value will enable the corresponding function" VALUE 0x36100000 Scalar_FLOAT32_IEEE 0 CM_RC8_FUNCTION 0.0 66.0 /end CHARACTERISTIC
/begin CHARACTERISTIC RC9_MIN "RC min PWM, RC minimum PWM pulse width. Typically 1000 is lower limit, 1500 is neutral and 2000 is upper limit." VALUE 0x36100000 Scalar_FLOAT32_IEEE 0 MICROSECONDS 800.0 2200.0 /end CHARACTERISTIC
/begin CHARACTERISTIC RC9_TRIM "RC trim PWM, RC trim (neutral) PWM pulse width. Typically 1000 is lower limit, 1500 is neutral and 2000 is upper limit." VALUE 0x36100000 Scalar_FLOAT32_IEEE 0 MICROSECONDS 800.0 2200.0 /end CHARACTERISTIC
/begin CHARACTERISTIC RC9_MAX "RC max PWM, RC maximum PWM pulse width. Typically 1000 is lower limit, 1500 is neutral and 2000 is upper limit." VALUE 0x36100000 Scalar_FLOAT32_IEEE 0 MICROSECONDS 800.0 2200.0 /end CHARACTERISTIC
/begin COMPU_METHOD CM_RC9_REV "RC reverse" TAB_VERB "%17.6" "" COMPU_TAB_REF TAB_RC9_REV /end COMPU_METHOD
/begin COMPU_VTAB TAB_RC9_REV "RC reverse, Reverse servo operation. Set to 1 for normal (forward) operation. Set to -1 to reverse this channel." TAB_VERB 2 -1 "Reversed" 1 "Normal" /end COMPU_VTAB
/begin CHARACTERISTIC RC9_REV "RC reverse, Reverse servo operation. Set to 1 for normal (forward) operation. Set to -1 to reverse this channel." VALUE 0x36100000 Scalar_FLOAT32_IEEE 0 CM_RC9_REV -1.0 1.0 /end CHARACTERISTIC
/begin CHARACTERISTIC RC9_DZ "RC dead-zone, dead zone around trim or bottom" VALUE 0x36100000 Scalar_FLOAT32_IEEE 0 MICROSECONDS 0.0 200.0 /end CHARACTERISTIC
/begin COMPU_METHOD CM_RC9_FUNCTION "Servo out function" TAB_VERB "%17.6" "" COMPU_TAB_REF TAB_RC9_FUNCTION /end COMPU_METHOD
/begin COMPU_VTAB TAB_RC9_FUNCTION "Servo out function, Setting this to Disabled(0) will setup this output for control by auto missions or MAVLink servo set commands. any other value will enable the corresponding function" TAB_VERB 54 0 "Disabled" 1 "RCPassThru" 2 "Flap" 3 "Flap_auto" 4 "Aileron" 6 "mount_pan" 7 "mount_tilt" 8 "mount_roll" 9 "mount_open" 10 "camera_trigger" 11 "release" 12 "mount2_pan" 13 "mount2_tilt" 14 "mount2_roll" 15 "mount2_open" 16 "DifferentialSpoiler1" 17 "DifferentialSpoiler2" 18 "AileronWithInput" 19 "Elevator" 20 "ElevatorWithInput" 21 "Rudder" 24 "Flaperon1" 25 "Flaperon2" 26 "GroundSteering" 27 "Parachute" 28 "EPM" 29 "LandingGear" 30 "EngineRunEnable" 31 "HeliRSC" 32 "HeliTailRSC" 33 "Motor1" 34 "Motor2" 35 "Motor3" 36 "Motor4" 37 "Motor5" 38 "Motor6" 39 "Motor7" 40 "Motor8" 51 "RCIN1" 52 "RCIN2" 53 "RCIN3" 54 "RCIN4" 55 "RCIN5" 56 "RCIN6" 57 "RCIN7" 58 "RCIN8" 59 "RCIN9" 60 "RCIN10" 61 "RCIN11" 62 "RCIN12" 63 "RCIN13" 64 "RCIN14" 65 "RCIN15" 66 "RCIN16" /end COMPU_VTAB
/begin CHARACTERISTIC RC9_FUNCTION "Servo out function, Setting this to Disabled(0) will setup this output for control by auto missions or MAVLink servo set commands. any other value will enable the corresponding function" VALUE 0x36100000 Scalar_FLOAT32_IEEE 0 CM_RC9_FUNCTION 0.0 66.0 /end CHARACTERISTIC
/begin CHARACTERISTIC RC10_MIN "RC min PWM, RC minimum PWM pulse width. Typically 1000 is lower limit, 1500 is neutral and 2000 is upper limit." VALUE 0x36100000 Scalar_FLOAT32_IEEE 0 MICROSECONDS 800.0 2200.0 /end CHARACTERISTIC
/begin CHARACTERISTIC RC10_TRIM "RC trim PWM, RC trim (neutral) PWM pulse width. Typically 1000 is lower limit, 1500 is neutral and 2000 is upper limit." VALUE 0x36100000 Scalar_FLOAT32_IEEE 0 MICROSECONDS 800.0 2200.0 /end CHARACTERISTIC
/begin CHARACTERISTIC RC10_MAX "RC max PWM, RC maximum PWM pulse width. Typically 1000 is lower limit, 1500 is neutral and 2000 is upper limit." VALUE 0x36100000 Scalar_FLOAT32_IEEE 0 MICROSECONDS 800.0 2200.0 /end CHARACTERISTIC
/begin COMPU_METHOD CM_RC10_REV "RC reverse" TAB_VERB "%17.6" "" COMPU_TAB_REF TAB_RC10_REV /end COMPU_METHOD
/begin COMPU_VTAB TAB_RC10_REV "RC reverse, Reverse servo operation. Set to 1 for normal (forward) operation. Set to -1 to reverse this channel." TAB_VERB 2 -1 "Reversed" 1 "Normal" /end COMPU_VTAB
/begin CHARACTERISTIC RC10_REV "RC reverse, Reverse servo operation. Set to 1 for normal (forward) operation. Set to -1 to reverse this channel." VALUE 0x36100000 Scalar_FLOAT32_IEEE 0 CM_RC10_REV -1.0 1.0 /end CHARACTERISTIC
/begin CHARACTERISTIC RC10_DZ "RC dead-zone, dead zone around trim or bottom" VALUE 0x36100000 Scalar_FLOAT32_IEEE 0 MICROSECONDS 0.0 200.0 /end CHARACTERISTIC
/begin COMPU_METHOD CM_RC10_FUNCTION "Servo out function" TAB_VERB "%17.6" "" COMPU_TAB_REF TAB_RC10_FUNCTION /end COMPU_METHOD
/begin COMPU_VTAB TAB_RC10_FUNCTION "Servo out function, Setting this to Disabled(0) will setup this output for control by auto missions or MAVLink servo set commands. any other value will enable the corresponding function" TAB_VERB 54 0 "Disabled" 1 "RCPassThru" 2 "Flap" 3 "Flap_auto" 4 "Aileron" 6 "mount_pan" 7 "mount_tilt" 8 "mount_roll" 9 "mount_open" 10 "camera_trigger" 11 "release" 12 "mount2_pan" 13 "mount2_tilt" 14 "mount2_roll" 15 "mount2_open" 16 "DifferentialSpoiler1" 17 "DifferentialSpoiler2" 18 "AileronWithInput" 19 "Elevator" 20 "ElevatorWithInput" 21 "Rudder" 24 "Flaperon1" 25 "Flaperon2" 26 "GroundSteering" 27 "Parachute" 28 "EPM" 29 "LandingGear" 30 "EngineRunEnable" 31 "HeliRSC" 32 "HeliTailRSC" 33 "Motor1" 34 "Motor2" 35 "Motor3" 36 "Motor4" 37 "Motor5" 38 "Motor6" 39 "Motor7" 40 "Motor8" 51 "RCIN1" 52 "RCIN2" 53 "RCIN3" 54 "RCIN4" 55 "RCIN5" 56 "RCIN6" 57 "RCIN7" 58 "RCIN8" 59 "RCIN9" 60 "RCIN10" 61 "RCIN11" 62 "RCIN12" 63 "RCIN13" 64 "RCIN14" 65 "RCIN15" 66 "RCIN16" /end COMPU_VTAB
/begin CHARACTERISTIC RC10_FUNCTION "Servo out function, Setting this to Disabled(0) will setup this output for control by auto missions or MAVLink servo set commands. any other value will enable the corresponding function" VALUE 0x36100000 Scalar_FLOAT32_IEEE 0 CM_RC10_FUNCTION 0.0 66.0 /end CHARACTERISTIC
/begin CHARACTERISTIC RC11_MIN "RC min PWM, RC minimum PWM pulse width. Typically 1000 is lower limit, 1500 is neutral and 2000 is upper limit." VALUE 0x36100000 Scalar_FLOAT32_IEEE 0 MICROSECONDS 800.0 2200.0 /end CHARACTERISTIC
/begin CHARACTERISTIC RC11_TRIM "RC trim PWM, RC trim (neutral) PWM pulse width. Typically 1000 is lower limit, 1500 is neutral and 2000 is upper limit." VALUE 0x36100000 Scalar_FLOAT32_IEEE 0 MICROSECONDS 800.0 2200.0 /end CHARACTERISTIC
/begin CHARACTERISTIC RC11_MAX "RC max PWM, RC maximum PWM pulse width. Typically 1000 is lower limit, 1500 is neutral and 2000 is upper limit." VALUE 0x36100000 Scalar_FLOAT32_IEEE 0 MICROSECONDS 800.0 2200.0 /end CHARACTERISTIC
/begin COMPU_METHOD CM_RC11_REV "RC reverse" TAB_VERB "%17.6" "" COMPU_TAB_REF TAB_RC11_REV /end COMPU_METHOD
/begin COMPU_VTAB TAB_RC11_REV "RC reverse, Reverse servo operation. Set to 1 for normal (forward) operation. Set to -1 to reverse this channel." TAB_VERB 2 -1 "Reversed" 1 "Normal" /end COMPU_VTAB
/begin CHARACTERISTIC RC11_REV "RC reverse, Reverse servo operation. Set to 1 for normal (forward) operation. Set to -1 to reverse this channel." VALUE 0x36100000 Scalar_FLOAT32_IEEE 0 CM_RC11_REV -1.0 1.0 /end CHARACTERISTIC
/begin CHARACTERISTIC RC11_DZ "RC dead-zone, dead zone around trim or bottom" VALUE 0x36100000 Scalar_FLOAT32_IEEE 0 MICROSECONDS 0.0 200.0 /end CHARACTERISTIC
/begin COMPU_METHOD CM_RC11_FUNCTION "Servo out function" TAB_VERB "%17.6" "" COMPU_TAB_REF TAB_RC11_FUNCTION /end COMPU_METHOD
/begin COMPU_VTAB TAB_RC11_FUNCTION "Servo out function, Setting this to Disabled(0) will setup this output for control by auto missions or MAVLink servo set commands. any other value will enable the corresponding function" TAB_VERB 54 0 "Disabled" 1 "RCPassThru" 2 "Flap" 3 "Flap_auto" 4 "Aileron" 6 "mount_pan" 7 "mount_tilt" 8 "mount_roll" 9 "mount_open" 10 "camera_trigger" 11 "release" 12 "mount2_pan" 13 "mount2_tilt" 14 "mount2_roll" 15 "mount2_open" 16 "DifferentialSpoiler1" 17 "DifferentialSpoiler2" 18 "AileronWithInput" 19 "Elevator" 20 "ElevatorWithInput" 21 "Rudder" 24 "Flaperon1" 25 "Flaperon2" 26 "GroundSteering" 27 "Parachute" 28 "EPM" 29 "LandingGear" 30 "EngineRunEnable" 31 "HeliRSC" 32 "HeliTailRSC" 33 "Motor1" 34 "Motor2" 35 "Motor3" 36 "Motor4" 37 "Motor5" 38 "Motor6" 39 "Motor7" 40 "Motor8" 51 "RCIN1" 52 "RCIN2" 53 "RCIN3" 54 "RCIN4" 55 "RCIN5" 56 "RCIN6" 57 "RCIN7" 58 "RCIN8" 59 "RCIN9" 60 "RCIN10" 61 "RCIN11" 62 "RCIN12" 63 "RCIN13" 64 "RCIN14" 65 "RCIN15" 66 "RCIN16" /end COMPU_VTAB
/begin CHARACTERISTIC RC11_FUNCTION "Servo out function, Setting this to Disabled(0) will setup this output for control by auto missions or MAVLink servo set commands. any other value will enable the corresponding function" VALUE 0x36100000 Scalar_FLOAT32_IEEE 0 CM_RC11_FUNCTION 0.0 66.0 /end CHARACTERISTIC
/begin CHARACTERISTIC RC12_MIN "RC min PWM, RC minimum PWM pulse width. Typically 1000 is lower limit, 1500 is neutral and 2000 is upper limit." VALUE 0x36100000 Scalar_FLOAT32_IEEE 0 MICROSECONDS 800.0 2200.0 /end CHARACTERISTIC
/begin CHARACTERISTIC RC12_TRIM "RC trim PWM, RC trim (neutral) PWM pulse width. Typically 1000 is lower limit, 1500 is neutral and 2000 is upper limit." VALUE 0x36100000 Scalar_FLOAT32_IEEE 0 MICROSECONDS 800.0 2200.0 /end CHARACTERISTIC
/begin CHARACTERISTIC RC12_MAX "RC max PWM, RC maximum PWM pulse width. Typically 1000 is lower limit, 1500 is neutral and 2000 is upper limit." VALUE 0x36100000 Scalar_FLOAT32_IEEE 0 MICROSECONDS 800.0 2200.0 /end CHARACTERISTIC
/begin COMPU_METHOD CM_RC12_REV "RC reverse" TAB_VERB "%17.6" "" COMPU_TAB_REF TAB_RC12_REV /end COMPU_METHOD
/begin COMPU_VTAB TAB_RC12_REV "RC reverse, Reverse servo operation. Set to 1 for normal (forward) operation. Set to -1 to reverse this channel." TAB_VERB 2 -1 "Reversed" 1 "Normal" /end COMPU_VTAB
/begin CHARACTERISTIC RC12_REV "RC reverse, Reverse servo operation. Set to 1 for normal (forward) operation. Set to -1 to reverse this channel." VALUE 0x36100000 Scalar_FLOAT32_IEEE 0 CM_RC12_REV -1.0 1.0 /end CHARACTERISTIC
/begin CHARACTERISTIC RC12_DZ "RC dead-zone, dead zone around trim or bottom" VALUE 0x36100000 Scalar_FLOAT32_IEEE 0 MICROSECONDS 0.0 200.0 /end CHARACTERISTIC
/begin COMPU_METHOD CM_RC12_FUNCTION "Servo out function" TAB_VERB "%17.6" "" COMPU_TAB_REF TAB_RC12_FUNCTION /end COMPU_METHOD
/begin COMPU_VTAB TAB_RC12_FUNCTION "Servo out function, Setting this to Disabled(0) will setup this output for control by auto missions or MAVLink servo set commands. any other value will enable the corresponding function" TAB_VERB 54 0 "Disabled" 1 "RCPassThru" 2 "Flap" 3 "Flap_auto" 4 "Aileron" 6 "mount_pan" 7 "mount_tilt" 8 "mount_roll" 9 "mount_open" 10 "camera_trigger" 11 "release" 12 "mount2_pan" 13 "mount2_tilt" 14 "mount2_roll" 15 "mount2_open" 16 "DifferentialSpoiler1" 17 "DifferentialSpoiler2" 18 "AileronWithInput" 19 "Elevator" 20 "ElevatorWithInput" 21 "Rudder" 24 "Flaperon1" 25 "Flaperon2" 26 "GroundSteering" 27 "Parachute" 28 "EPM" 29 "LandingGear" 30 "EngineRunEnable" 31 "HeliRSC" 32 "HeliTailRSC" 33 "Motor1" 34 "Motor2" 35 "Motor3" 36 "Motor4" 37 "Motor5" 38 "Motor6" 39 "Motor7" 40 "Motor8" 51 "RCIN1" 52 "RCIN2" 53 "RCIN3" 54 "RCIN4" 55 "RCIN5" 56 "RCIN6" 57 "RCIN7" 58 "RCIN8" 59 "RCIN9" 60 "RCIN10" 61 "RCIN11" 62 "RCIN12" 63 "RCIN13" 64 "RCIN14" 65 "RCIN15" 66 "RCIN16" /end COMPU_VTAB
/begin CHARACTERISTIC RC12_FUNCTION "Servo out function, Setting this to Disabled(0) will setup this output for control by auto missions or MAVLink servo set commands. any other value will enable the corresponding function" VALUE 0x36100000 Scalar_FLOAT32_IEEE 0 CM_RC12_FUNCTION 0.0 66.0 /end CHARACTERISTIC
/begin CHARACTERISTIC RC13_MIN "RC min PWM, RC minimum PWM pulse width. Typically 1000 is lower limit, 1500 is neutral and 2000 is upper limit." VALUE 0x36100000 Scalar_FLOAT32_IEEE 0 MICROSECONDS 800.0 2200.0 /end CHARACTERISTIC
/begin CHARACTERISTIC RC13_TRIM "RC trim PWM, RC trim (neutral) PWM pulse width. Typically 1000 is lower limit, 1500 is neutral and 2000 is upper limit." VALUE 0x36100000 Scalar_FLOAT32_IEEE 0 MICROSECONDS 800.0 2200.0 /end CHARACTERISTIC
/begin CHARACTERISTIC RC13_MAX "RC max PWM, RC maximum PWM pulse width. Typically 1000 is lower limit, 1500 is neutral and 2000 is upper limit." VALUE 0x36100000 Scalar_FLOAT32_IEEE 0 MICROSECONDS 800.0 2200.0 /end CHARACTERISTIC
/begin COMPU_METHOD CM_RC13_REV "RC reverse" TAB_VERB "%17.6" "" COMPU_TAB_REF TAB_RC13_REV /end COMPU_METHOD
/begin COMPU_VTAB TAB_RC13_REV "RC reverse, Reverse servo operation. Set to 1 for normal (forward) operation. Set to -1 to reverse this channel." TAB_VERB 2 -1 "Reversed" 1 "Normal" /end COMPU_VTAB
/begin CHARACTERISTIC RC13_REV "RC reverse, Reverse servo operation. Set to 1 for normal (forward) operation. Set to -1 to reverse this channel." VALUE 0x36100000 Scalar_FLOAT32_IEEE 0 CM_RC13_REV -1.0 1.0 /end CHARACTERISTIC
/begin CHARACTERISTIC RC13_DZ "RC dead-zone, dead zone around trim or bottom" VALUE 0x36100000 Scalar_FLOAT32_IEEE 0 MICROSECONDS 0.0 200.0 /end CHARACTERISTIC
/begin COMPU_METHOD CM_RC13_FUNCTION "Servo out function" TAB_VERB "%17.6" "" COMPU_TAB_REF TAB_RC13_FUNCTION /end COMPU_METHOD
/begin COMPU_VTAB TAB_RC13_FUNCTION "Servo out function, Setting this to Disabled(0) will setup this output for control by auto missions or MAVLink servo set commands. any other value will enable the corresponding function" TAB_VERB 54 0 "Disabled" 1 "RCPassThru" 2 "Flap" 3 "Flap_auto" 4 "Aileron" 6 "mount_pan" 7 "mount_tilt" 8 "mount_roll" 9 "mount_open" 10 "camera_trigger" 11 "release" 12 "mount2_pan" 13 "mount2_tilt" 14 "mount2_roll" 15 "mount2_open" 16 "DifferentialSpoiler1" 17 "DifferentialSpoiler2" 18 "AileronWithInput" 19 "Elevator" 20 "ElevatorWithInput" 21 "Rudder" 24 "Flaperon1" 25 "Flaperon2" 26 "GroundSteering" 27 "Parachute" 28 "EPM" 29 "LandingGear" 30 "EngineRunEnable" 31 "HeliRSC" 32 "HeliTailRSC" 33 "Motor1" 34 "Motor2" 35 "Motor3" 36 "Motor4" 37 "Motor5" 38 "Motor6" 39 "Motor7" 40 "Motor8" 51 "RCIN1" 52 "RCIN2" 53 "RCIN3" 54 "RCIN4" 55 "RCIN5" 56 "RCIN6" 57 "RCIN7" 58 "RCIN8" 59 "RCIN9" 60 "RCIN10" 61 "RCIN11" 62 "RCIN12" 63 "RCIN13" 64 "RCIN14" 65 "RCIN15" 66 "RCIN16" /end COMPU_VTAB
/begin CHARACTERISTIC RC13_FUNCTION "Servo out function, Setting this to Disabled(0) will setup this output for control by auto missions or MAVLink servo set commands. any other value will enable the corresponding function" VALUE 0x36100000 Scalar_FLOAT32_IEEE 0 CM_RC13_FUNCTION 0.0 66.0 /end CHARACTERISTIC
/begin CHARACTERISTIC RC14_MIN "RC min PWM, RC minimum PWM pulse width. Typically 1000 is lower limit, 1500 is neutral and 2000 is upper limit." VALUE 0x36100000 Scalar_FLOAT32_IEEE 0 MICROSECONDS 800.0 2200.0 /end CHARACTERISTIC
/begin CHARACTERISTIC RC14_TRIM "RC trim PWM, RC trim (neutral) PWM pulse width. Typically 1000 is lower limit, 1500 is neutral and 2000 is upper limit." VALUE 0x36100000 Scalar_FLOAT32_IEEE 0 MICROSECONDS 800.0 2200.0 /end CHARACTERISTIC
/begin CHARACTERISTIC RC14_MAX "RC max PWM, RC maximum PWM pulse width. Typically 1000 is lower limit, 1500 is neutral and 2000 is upper limit." VALUE 0x36100000 Scalar_FLOAT32_IEEE 0 MICROSECONDS 800.0 2200.0 /end CHARACTERISTIC
/begin COMPU_METHOD CM_RC14_REV "RC reverse" TAB_VERB "%17.6" "" COMPU_TAB_REF TAB_RC14_REV /end COMPU_METHOD
/begin COMPU_VTAB TAB_RC14_REV "RC reverse, Reverse servo operation. Set to 1 for normal (forward) operation. Set to -1 to reverse this channel." TAB_VERB 2 -1 "Reversed" 1 "Normal" /end COMPU_VTAB
/begin CHARACTERISTIC RC14_REV "RC reverse, Reverse servo operation. Set to 1 for normal (forward) operation. Set to -1 to reverse this channel." VALUE 0x36100000 Scalar_FLOAT32_IEEE 0 CM_RC14_REV -1.0 1.0 /end CHARACTERISTIC
/begin CHARACTERISTIC RC14_DZ "RC dead-zone, dead zone around trim or bottom" VALUE 0x36100000 Scalar_FLOAT32_IEEE 0 MICROSECONDS 0.0 200.0 /end CHARACTERISTIC
/begin COMPU_METHOD CM_RC14_FUNCTION "Servo out function" TAB_VERB "%17.6" "" COMPU_TAB_REF TAB_RC14_FUNCTION /end COMPU_METHOD
/begin COMPU_VTAB TAB_RC14_FUNCTION "Servo out function, Setting this to Disabled(0) will setup this output for control by auto missions or MAVLink servo set commands. any other value will enable the corresponding function" TAB_VERB 54 0 "Disabled" 1 "RCPassThru" 2 "Flap" 3 "Flap_auto" 4 "Aileron" 6 "mount_pan" 7 "mount_tilt" 8 "mount_roll" 9 "mount_open" 10 "camera_trigger" 11 "release" 12 "mount2_pan" 13 "mount2_tilt" 14 "mount2_roll" 15 "mount2_open" 16 "DifferentialSpoiler1" 17 "DifferentialSpoiler2" 18 "AileronWithInput" 19 "Elevator" 20 "ElevatorWithInput" 21 "Rudder" 24 "Flaperon1" 25 "Flaperon2" 26 "GroundSteering" 27 "Parachute" 28 "EPM" 29 "LandingGear" 30 "EngineRunEnable" 31 "HeliRSC" 32 "HeliTailRSC" 33 "Motor1" 34 "Motor2" 35 "Motor3" 36 "Motor4" 37 "Motor5" 38 "Motor6" 39 "Motor7" 40 "Motor8" 51 "RCIN1" 52 "RCIN2" 53 "RCIN3" 54 "RCIN4" 55 "RCIN5" 56 "RCIN6" 57 "RCIN7" 58 "RCIN8" 59 "RCIN9" 60 "RCIN10" 61 "RCIN11" 62 "RCIN12" 63 "RCIN13" 64 "RCIN14" 65 "RCIN15" 66 "RCIN16" /end COMPU_VTAB
/begin CHARACTERISTIC RC14_FUNCTION "Servo out function, Setting this to Disabled(0) will setup this output for control by auto missions or MAVLink servo set commands. any other value will enable the corresponding function" VALUE 0x36100000 Scalar_FLOAT32_IEEE 0 CM_RC14_FUNCTION 0.0 66.0 /end CHARACTERISTIC
/begin COMPU_METHOD CM_CAM_TRIGG_TYPE "Camera shutter (trigger) type" TAB_VERB "%17.6" "" COMPU_TAB_REF TAB_CAM_TRIGG_TYPE /end COMPU_METHOD
/begin COMPU_VTAB TAB_CAM_TRIGG_TYPE "Camera shutter (trigger) type, how to trigger the camera to take a picture" TAB_VERB 2 0 "Servo" 1 "Relay" /end COMPU_VTAB
/begin CHARACTERISTIC CAM_TRIGG_TYPE "Camera shutter (trigger) type, how to trigger the camera to take a picture" VALUE 0x36100000 Scalar_FLOAT32_IEEE 0 CM_CAM_TRIGG_TYPE 0.0 1.0 /end CHARACTERISTIC
/begin CHARACTERISTIC CAM_DURATION "Duration that shutter is held open, How long the shutter will be held open in 10ths of a second (i.e. enter 10 for 1second, 50 for 5seconds)" VALUE 0x36100000 Scalar_FLOAT32_IEEE 0 SECONDS 0.0 50.0 /end CHARACTERISTIC
/begin CHARACTERISTIC CAM_SERVO_ON "Servo ON PWM value, PWM value to move servo to when shutter is activated" VALUE 0x36100000 Scalar_FLOAT32_IEEE 0 MICROSECONDS 1000.0 2000.0 /end CHARACTERISTIC
/begin CHARACTERISTIC CAM_SERVO_OFF "Servo OFF PWM value, PWM value to move servo to when shutter is deactivated" VALUE 0x36100000 Scalar_FLOAT32_IEEE 0 MICROSECONDS 1000.0 2000.0 /end CHARACTERISTIC
/begin CHARACTERISTIC CAM_TRIGG_DIST "Camera trigger distance, Distance in meters between camera triggers. If this value is non-zero then the camera will trigger whenever the GPS position changes by this number of meters regardless of what mode the APM is in. Note that this parameter can also be set in an auto mission using the DO_SET_CAM_TRIGG_DIST command, allowing you to enable/disable the triggering of the camera during the flight." VALUE 0x36100000 Scalar_FLOAT32_IEEE 0 METERS 0.0 1000.0 /end CHARACTERISTIC
/begin COMPU_METHOD CM_CAM_RELAY_ON "Relay ON value" TAB_VERB "%17.6" "" COMPU_TAB_REF TAB_CAM_RELAY_ON /end COMPU_METHOD
/begin COMPU_VTAB TAB_CAM_RELAY_ON "Relay ON value, This sets whether the relay goes high or low when it triggers. Note that you should also set RELAY_DEFAULT appropriately for your camera" TAB_VERB 2 0 "Low" 1 "High" /end COMPU_VTAB
/begin CHARACTERISTIC CAM_RELAY_ON "Relay ON value, This sets whether the relay goes high or low when it triggers. Note that you should also set RELAY_DEFAULT appropriately for your camera" VALUE 0x36100000 Scalar_FLOAT32_IEEE 0 CM_CAM_RELAY_ON 0.0 1.0 /end CHARACTERISTIC
/begin CHARACTERISTIC CAM_MIN_INTERVAL "Minimum time between photos, Postpone shooting if previous picture was taken less than preset time(ms) ago." VALUE 0x36100000 Scalar_FLOAT32_IEEE 0 MILLISECONDS 0.0 10000.0 /end CHARACTERISTIC
/begin CHARACTERISTIC CAM_MAX_ROLL "Maximum photo roll angle., Postpone shooting if roll is greater than limit. (0=Disable, will shoot regardless of roll)." VALUE 0x36100000 Scalar_FLOAT32_IEEE 0 DEGREES 0.0 180.0 /end CHARACTERISTIC
/begin COMPU_METHOD CM_CAM_FEEDBACK_PIN "Camera feedback pin" TAB_VERB "%17.6" "" COMPU_TAB_REF TAB_CAM_FEEDBACK_PIN /end COMPU_METHOD
/begin COMPU_VTAB TAB_CAM_FEEDBACK_PIN "Camera feedback pin, pin number to use for save accurate camera feedback messages. If set to -1 then don't use a pin flag for this, otherwise this is a pin number which if held high after a picture trigger order, will save camera messages when camera really takes a picture. A universal camera hot shoe is needed. The pin should be held high for at least 2 milliseconds for reliable trigger detection. See also the CAM_FEEDBACK_POL option. If using AUX4 pin on a Pixhawk then a fast capture method is used that allows for the trigger time to be as short as one microsecond." TAB_VERB 7 -1 "Disabled" 50 "PX4 AUX1" 51 "PX4 AUX2" 52 "PX4 AUX3" 53 "PX4 AUX4(fast capture)" 54 "PX4 AUX5" 55 "PX4 AUX6" /end COMPU_VTAB
/begin CHARACTERISTIC CAM_FEEDBACK_PIN "Camera feedback pin, pin number to use for save accurate camera feedback messages. If set to -1 then don't use a pin flag for this, otherwise this is a pin number which if held high after a picture trigger order, will save camera messages when camera really takes a picture. A universal camera hot shoe is needed. The pin should be held high for at least 2 milliseconds for reliable trigger detection. See also the CAM_FEEDBACK_POL option. If using AUX4 pin on a Pixhawk then a fast capture method is used that allows for the trigger time to be as short as one microsecond." VALUE 0x36100000 Scalar_FLOAT32_IEEE 0 CM_CAM_FEEDBACK_PIN -1.0 55.0 /end CHARACTERISTIC
/begin COMPU_METHOD CM_CAM_FEEDBACK_POL "Camera feedback pin polarity" TAB_VERB "%17.6" "" COMPU_TAB_REF TAB_CAM_FEEDBACK_POL /end COMPU_METHOD
/begin COMPU_VTAB TAB_CAM_FEEDBACK_POL "Camera feedback pin polarity, Polarity for feedback pin. If this is 1 then the feedback pin should go high on trigger. If set to 0 then it should go low" TAB_VERB 2 0 "TriggerLow" 1 "TriggerHigh" /end COMPU_VTAB
/begin CHARACTERISTIC CAM_FEEDBACK_POL "Camera feedback pin polarity, Polarity for feedback pin. If this is 1 then the feedback pin should go high on trigger. If set to 0 then it should go low" VALUE 0x36100000 Scalar_FLOAT32_IEEE 0 CM_CAM_FEEDBACK_POL 0.0 1.0 /end CHARACTERISTIC
/begin COMPU_METHOD CM_RELAY_PIN "First Relay Pin" TAB_VERB "%17.6" "" COMPU_TAB_REF TAB_RELAY_PIN /end COMPU_METHOD
/begin COMPU_VTAB TAB_RELAY_PIN "First Relay Pin, Digital pin number for first relay control. This is the pin used for camera control." TAB_VERB 15 -1 "Disabled" 13 "APM2 A9 pin" 47 "APM1 relay" 50 "Pixhawk AUXOUT1" 51 "Pixhawk AUXOUT2" 52 "Pixhawk AUXOUT3" 53 "Pixhawk AUXOUT4" 54 "Pixhawk AUXOUT5" 55 "Pixhawk AUXOUT6" 111 "PX4 FMU Relay1" 112 "PX4 FMU Relay2" 113 "PX4IO Relay1" 114 "PX4IO Relay2" 115 "PX4IO ACC1" 116 "PX4IO ACC2" /end COMPU_VTAB
/begin CHARACTERISTIC RELAY_PIN "First Relay Pin, Digital pin number for first relay control. This is the pin used for camera control." VALUE 0x36100000 Scalar_FLOAT32_IEEE 0 CM_RELAY_PIN -1.0 116.0 /end CHARACTERISTIC
/begin COMPU_METHOD CM_RELAY_PIN2 "Second Relay Pin" TAB_VERB "%17.6" "" COMPU_TAB_REF TAB_RELAY_PIN2 /end COMPU_METHOD
/begin COMPU_VTAB TAB_RELAY_PIN2 "Second Relay Pin, Digital pin number for 2nd relay control." TAB_VERB 15 -1 "Disabled" 13 "APM2 A9 pin" 47 "APM1 relay" 50 "Pixhawk AUXOUT1" 51 "Pixhawk AUXOUT2" 52 "Pixhawk AUXOUT3" 53 "Pixhawk AUXOUT4" 54 "Pixhawk AUXOUT5" 55 "Pixhawk AUXOUT6" 111 "PX4 FMU Relay1" 112 "PX4 FMU Relay2" 113 "PX4IO Relay1" 114 "PX4IO Relay2" 115 "PX4IO ACC1" 116 "PX4IO ACC2" /end COMPU_VTAB
/begin CHARACTERISTIC RELAY_PIN2 "Second Relay Pin, Digital pin number for 2nd relay control." VALUE 0x36100000 Scalar_FLOAT32_IEEE 0 CM_RELAY_PIN2 -1.0 116.0 /end CHARACTERISTIC
/begin COMPU_METHOD CM_RELAY_PIN3 "Third Relay Pin" TAB_VERB "%17.6" "" COMPU_TAB_REF TAB_RELAY_PIN3 /end COMPU_METHOD
/begin COMPU_VTAB TAB_RELAY_PIN3 "Third Relay Pin, Digital pin number for 3rd relay control." TAB_VERB 15 -1 "Disabled" 13 "APM2 A9 pin" 47 "APM1 relay" 50 "Pixhawk AUXOUT1" 51 "Pixhawk AUXOUT2" 52 "Pixhawk AUXOUT3" 53 "Pixhawk AUXOUT4" 54 "Pixhawk AUXOUT5" 55 "Pixhawk AUXOUT6" 111 "PX4 FMU Relay1" 112 "PX4 FMU Relay2" 113 "PX4IO Relay1" 114 "PX4IO Relay2" 115 "PX4IO ACC1" 116 "PX4IO ACC2" /end COMPU_VTAB
/begin CHARACTERISTIC RELAY_PIN3 "Third Relay Pin, Digital pin number for 3rd relay control." VALUE 0x36100000 Scalar_FLOAT32_IEEE 0 CM_RELAY_PIN3 -1.0 116.0 /end CHARACTERISTIC
/begin COMPU_METHOD CM_RELAY_PIN4 "Fourth Relay Pin" TAB_VERB "%17.6" "" COMPU_TAB_REF TAB_RELAY_PIN4 /end COMPU_METHOD
/begin COMPU_VTAB TAB_RELAY_PIN4 "Fourth Relay Pin, Digital pin number for 4th relay control." TAB_VERB 15 -1 "Disabled" 13 "APM2 A9 pin" 47 "APM1 relay" 50 "Pixhawk AUXOUT1" 51 "Pixhawk AUXOUT2" 52 "Pixhawk AUXOUT3" 53 "Pixhawk AUXOUT4" 54 "Pixhawk AUXOUT5" 55 "Pixhawk AUXOUT6" 111 "PX4 FMU Relay1" 112 "PX4 FMU Relay2" 113 "PX4IO Relay1" 114 "PX4IO Relay2" 115 "PX4IO ACC1" 116 "PX4IO ACC2" /end COMPU_VTAB
/begin CHARACTERISTIC RELAY_PIN4 "Fourth Relay Pin, Digital pin number for 4th relay control." VALUE 0x36100000 Scalar_FLOAT32_IEEE 0 CM_RELAY_PIN4 -1.0 116.0 /end CHARACTERISTIC
/begin COMPU_METHOD CM_RELAY_DEFAULT "Default relay state" TAB_VERB "%17.6" "" COMPU_TAB_REF TAB_RELAY_DEFAULT /end COMPU_METHOD
/begin COMPU_VTAB TAB_RELAY_DEFAULT "Default relay state, The state of the relay on boot. " TAB_VERB 3 0 "Off" 1 "On" 2 "NoChange" /end COMPU_VTAB
/begin CHARACTERISTIC RELAY_DEFAULT "Default relay state, The state of the relay on boot. " VALUE 0x36100000 Scalar_FLOAT32_IEEE 0 CM_RELAY_DEFAULT 0.0 2.0 /end CHARACTERISTIC
/begin COMPU_METHOD CM_EPM_ENABLE "EPM Enable/Disable" TAB_VERB "%17.6" "" COMPU_TAB_REF TAB_EPM_ENABLE /end COMPU_METHOD
/begin COMPU_VTAB TAB_EPM_ENABLE "EPM Enable/Disable, EPM enable/disable" TAB_VERB 2 0 "Disabled" 1 "Enabled" /end COMPU_VTAB
/begin CHARACTERISTIC EPM_ENABLE "EPM Enable/Disable, EPM enable/disable" VALUE 0x36100000 Scalar_FLOAT32_IEEE 0 CM_EPM_ENABLE 0.0 1.0 /end CHARACTERISTIC
/begin CHARACTERISTIC EPM_GRAB "EPM Grab PWM, PWM value sent to EPM to initiate grabbing the cargo" VALUE 0x36100000 Scalar_FLOAT32_IEEE 0 IDENTICAL 1000.0 2000.0 /end CHARACTERISTIC
/begin CHARACTERISTIC EPM_RELEASE "EPM Release PWM, PWM value sent to EPM to release the cargo" VALUE 0x36100000 Scalar_FLOAT32_IEEE 0 IDENTICAL 1000.0 2000.0 /end CHARACTERISTIC
/begin CHARACTERISTIC EPM_NEUTRAL "EPM Neutral PWM, PWM value sent to EPM when not grabbing or releasing" VALUE 0x36100000 Scalar_FLOAT32_IEEE 0 IDENTICAL 1000.0 2000.0 /end CHARACTERISTIC
/begin CHARACTERISTIC EPM_REGRAB "EPM UAVCAN Hardpoint ID, Refer to https://docs.zubax.com/opengrab_epm_v3#UAVCAN_interface" VALUE 0x36100000 Scalar_FLOAT32_IEEE 0 IDENTICAL 0.0 255.0 /end CHARACTERISTIC
/begin COMPU_METHOD CM_CHUTE_ENABLED "Parachute release enabled or disabled" TAB_VERB "%17.6" "" COMPU_TAB_REF TAB_CHUTE_ENABLED /end COMPU_METHOD
/begin COMPU_VTAB TAB_CHUTE_ENABLED "Parachute release enabled or disabled, Parachute release enabled or disabled" TAB_VERB 2 0 "Disabled" 1 "Enabled" /end COMPU_VTAB
/begin CHARACTERISTIC CHUTE_ENABLED "Parachute release enabled or disabled, Parachute release enabled or disabled" VALUE 0x36100000 Scalar_FLOAT32_IEEE 0 CM_CHUTE_ENABLED 0.0 1.0 /end CHARACTERISTIC
/begin COMPU_METHOD CM_CHUTE_TYPE "Parachute release mechanism type (relay or servo)" TAB_VERB "%17.6" "" COMPU_TAB_REF TAB_CHUTE_TYPE /end COMPU_METHOD
/begin COMPU_VTAB TAB_CHUTE_TYPE "Parachute release mechanism type (relay or servo), Parachute release mechanism type (relay or servo)" TAB_VERB 5 0 "First Relay" 1 "Second Relay" 2 "Third Relay" 3 "Fourth Relay" 10 "Servo" /end COMPU_VTAB
/begin CHARACTERISTIC CHUTE_TYPE "Parachute release mechanism type (relay or servo), Parachute release mechanism type (relay or servo)" VALUE 0x36100000 Scalar_FLOAT32_IEEE 0 CM_CHUTE_TYPE 0.0 10.0 /end CHARACTERISTIC
/begin CHARACTERISTIC CHUTE_SERVO_ON "Parachute Servo ON PWM value, Parachute Servo PWM value when parachute is released" VALUE 0x36100000 Scalar_FLOAT32_IEEE 0 MICROSECONDS 1000.0 2000.0 /end CHARACTERISTIC
/begin CHARACTERISTIC CHUTE_SERVO_OFF "Servo OFF PWM value, Parachute Servo PWM value when parachute is not released" VALUE 0x36100000 Scalar_FLOAT32_IEEE 0 MICROSECONDS 1000.0 2000.0 /end CHARACTERISTIC
/begin CHARACTERISTIC CHUTE_ALT_MIN "Parachute min altitude in meters above home, Parachute min altitude above home.  Parachute will not be released below this altitude.  0 to disable alt check." VALUE 0x36100000 Scalar_FLOAT32_IEEE 0 METERS 0.0 32000.0 /end CHARACTERISTIC
/begin CHARACTERISTIC CHUTE_DELAY_MS "Parachute release delay, Delay in millseconds between motor stop and chute release" VALUE 0x36100000 Scalar_FLOAT32_IEEE 0 MILLISECONDS 0.0 5000.0 /end CHARACTERISTIC
/begin CHARACTERISTIC LGR_SERVO_RTRACT "Landing Gear Servo Retracted PWM Value, Servo PWM value when landing gear is retracted" VALUE 0x36100000 Scalar_FLOAT32_IEEE 0 MICROSECONDS 1000.0 2000.0 /end CHARACTERISTIC
/begin CHARACTERISTIC LGR_SERVO_DEPLOY "Landing Gear Servo Deployed PWM Value, Servo PWM value when landing gear is deployed" VALUE 0x36100000 Scalar_FLOAT32_IEEE 0 MICROSECONDS 1000.0 2000.0 /end CHARACTERISTIC
/begin CHARACTERISTIC IM_STAB_COL_1 "Stabilize Mode Collective Point 1, Helicopter's minimum collective pitch setting at zero throttle input in Stabilize mode" VALUE 0x36100000 Scalar_FLOAT32_IEEE 0 DECIPERCENT 0.0 500.0 /end CHARACTERISTIC
/begin CHARACTERISTIC IM_STAB_COL_2 "Stabilize Mode Collective Point 2, Helicopter's collective pitch setting at mid-low throttle input in Stabilize mode" VALUE 0x36100000 Scalar_FLOAT32_IEEE 0 DECIPERCENT 0.0 500.0 /end CHARACTERISTIC
/begin CHARACTERISTIC IM_STAB_COL_3 "Stabilize Mode Collective Point 3, Helicopter's collective pitch setting at mid-high throttle input in Stabilize mode" VALUE 0x36100000 Scalar_FLOAT32_IEEE 0 DECIPERCENT 500.0 1000.0 /end CHARACTERISTIC
/begin CHARACTERISTIC IM_STAB_COL_4 "Stabilize Mode Collective Point 4, Helicopter's maximum collective pitch setting at full throttle input in Stabilize mode" VALUE 0x36100000 Scalar_FLOAT32_IEEE 0 DECIPERCENT 500.0 1000.0 /end CHARACTERISTIC
/begin COMPU_METHOD CM_IM_ACRO_COL_EXP "Acro Mode Collective Expo" TAB_VERB "%17.6" "" COMPU_TAB_REF TAB_IM_ACRO_COL_EXP /end COMPU_METHOD
/begin COMPU_VTAB TAB_IM_ACRO_COL_EXP "Acro Mode Collective Expo, Used to soften collective pitch inputs near center point in Acro mode." TAB_VERB 6 0 "Disabled" 0.1 "Very Low" 0.2 "Low" 0.3 "Medium" 0.4 "High" 0.5 "Very High" /end COMPU_VTAB
/begin CHARACTERISTIC IM_ACRO_COL_EXP "Acro Mode Collective Expo, Used to soften collective pitch inputs near center point in Acro mode." VALUE 0x36100000 Scalar_FLOAT32_IEEE 0 CM_IM_ACRO_COL_EXP 0.0 0.5 /end CHARACTERISTIC
/begin CHARACTERISTIC COMPASS_OFS_X "Compass offsets in milligauss on the X axis, Offset to be added to the compass x-axis values to compensate for metal in the frame" VALUE 0x36100000 Scalar_FLOAT32_IEEE 0 MILLIGAUSS -400.0 400.0 /end CHARACTERISTIC
/begin CHARACTERISTIC COMPASS_OFS_Y "Compass offsets in milligauss on the Y axis, Offset to be added to the compass y-axis values to compensate for metal in the frame" VALUE 0x36100000 Scalar_FLOAT32_IEEE 0 MILLIGAUSS -400.0 400.0 /end CHARACTERISTIC
/begin CHARACTERISTIC COMPASS_OFS_Z "Compass offsets in milligauss on the Z axis, Offset to be added to the compass z-axis values to compensate for metal in the frame" VALUE 0x36100000 Scalar_FLOAT32_IEEE 0 MILLIGAUSS -400.0 400.0 /end CHARACTERISTIC
/begin CHARACTERISTIC COMPASS_DEC "Compass declination, An angle to compensate between the true north and magnetic north" VALUE 0x36100000 Scalar_FLOAT32_IEEE 0 RADIANS -3.142 3.142 /end CHARACTERISTIC
/begin COMPU_METHOD CM_COMPASS_LEARN "Learn compass offsets automatically" TAB_VERB "%17.6" "" COMPU_TAB_REF TAB_COMPASS_LEARN /end COMPU_METHOD
/begin COMPU_VTAB TAB_COMPASS_LEARN "Learn compass offsets automatically, Enable or disable the automatic learning of compass offsets. You can enable learning either using a compass-only method that is suitable only for fixed wing aircraft or using the offsets learnt by the active EKF state estimator. If this option is enabled then the learnt offsets are saved when you disarm the vehicle." TAB_VERB 3 0 "Disabled" 1 "Internal-Learning" 2 "EKF-Learning" /end COMPU_VTAB
/begin CHARACTERISTIC COMPASS_LEARN "Learn compass offsets automatically, Enable or disable the automatic learning of compass offsets. You can enable learning either using a compass-only method that is suitable only for fixed wing aircraft or using the offsets learnt by the active EKF state estimator. If this option is enabled then the learnt offsets are saved when you disarm the vehicle." VALUE 0x36100000 Scalar_FLOAT32_IEEE 0 CM_COMPASS_LEARN 0.0 2.0 /end CHARACTERISTIC
/begin COMPU_METHOD CM_COMPASS_USE "Use compass for yaw" TAB_VERB "%17.6" "" COMPU_TAB_REF TAB_COMPASS_USE /end COMPU_METHOD
/begin COMPU_VTAB TAB_COMPASS_USE "Use compass for yaw, Enable or disable the use of the compass (instead of the GPS) for determining heading" TAB_VERB 2 0 "Disabled" 1 "Enabled" /end COMPU_VTAB
/begin CHARACTERISTIC COMPASS_USE "Use compass for yaw, Enable or disable the use of the compass (instead of the GPS) for determining heading" VALUE 0x36100000 Scalar_FLOAT32_IEEE 0 CM_COMPASS_USE 0.0 1.0 /end CHARACTERISTIC
/begin COMPU_METHOD CM_COMPASS_AUTODEC "Auto Declination" TAB_VERB "%17.6" "" COMPU_TAB_REF TAB_COMPASS_AUTODEC /end COMPU_METHOD
/begin COMPU_VTAB TAB_COMPASS_AUTODEC "Auto Declination, Enable or disable the automatic calculation of the declination based on gps location" TAB_VERB 2 0 "Disabled" 1 "Enabled" /end COMPU_VTAB
/begin CHARACTERISTIC COMPASS_AUTODEC "Auto Declination, Enable or disable the automatic calculation of the declination based on gps location" VALUE 0x36100000 Scalar_FLOAT32_IEEE 0 CM_COMPASS_AUTODEC 0.0 1.0 /end CHARACTERISTIC
/begin COMPU_METHOD CM_COMPASS_MOTCT "Motor interference compensation type" TAB_VERB "%17.6" "" COMPU_TAB_REF TAB_COMPASS_MOTCT /end COMPU_METHOD
/begin COMPU_VTAB TAB_COMPASS_MOTCT "Motor interference compensation type, Set motor interference compensation type to disabled, throttle or current.  Do not change manually." TAB_VERB 3 0 "Disabled" 1 "Use Throttle" 2 "Use Current" /end COMPU_VTAB
/begin CHARACTERISTIC COMPASS_MOTCT "Motor interference compensation type, Set motor interference compensation type to disabled, throttle or current.  Do not change manually." VALUE 0x36100000 Scalar_FLOAT32_IEEE 0 CM_COMPASS_MOTCT 0.0 2.0 /end CHARACTERISTIC
/begin CHARACTERISTIC COMPASS_MOT_X "Motor interference compensation for body frame X axis, Multiplied by the current throttle and added to the compass's x-axis values to compensate for motor interference" VALUE 0x36100000 Scalar_FLOAT32_IEEE 0 IDENTICAL -1000.0 1000.0 /end CHARACTERISTIC
/begin CHARACTERISTIC COMPASS_MOT_Y "Motor interference compensation for body frame Y axis, Multiplied by the current throttle and added to the compass's y-axis values to compensate for motor interference" VALUE 0x36100000 Scalar_FLOAT32_IEEE 0 IDENTICAL -1000.0 1000.0 /end CHARACTERISTIC
/begin CHARACTERISTIC COMPASS_MOT_Z "Motor interference compensation for body frame Z axis, Multiplied by the current throttle and added to the compass's z-axis values to compensate for motor interference" VALUE 0x36100000 Scalar_FLOAT32_IEEE 0 IDENTICAL -1000.0 1000.0 /end CHARACTERISTIC
/begin COMPU_METHOD CM_COMPASS_ORIENT "Compass orientation" TAB_VERB "%17.6" "" COMPU_TAB_REF TAB_COMPASS_ORIENT /end COMPU_METHOD
/begin COMPU_VTAB TAB_COMPASS_ORIENT "Compass orientation, The orientation of the compass relative to the autopilot board. This will default to the right value for each board type, but can be changed if you have an external compass. See the documentation for your external compass for the right value. The correct orientation should give the X axis forward, the Y axis to the right and the Z axis down. So if your aircraft is pointing west it should show a positive value for the Y axis, and a value close to zero for the X axis. On a PX4 or Pixhawk with an external compass the correct value is zero if the compass is correctly oriented. NOTE: This orientation is combined with any AHRS_ORIENTATION setting." TAB_VERB 39 0 "None" 1 "Yaw45" 2 "Yaw90" 3 "Yaw135" 4 "Yaw180" 5 "Yaw225" 6 "Yaw270" 7 "Yaw315" 8 "Roll180" 9 "Roll180Yaw45" 10 "Roll180Yaw90" 11 "Roll180Yaw135" 12 "Pitch180" 13 "Roll180Yaw225" 14 "Roll180Yaw270" 15 "Roll180Yaw315" 16 "Roll90" 17 "Roll90Yaw45" 18 "Roll90Yaw90" 19 "Roll90Yaw135" 20 "Roll270" 21 "Roll270Yaw45" 22 "Roll270Yaw90" 23 "Roll270Yaw136" 24 "Pitch90" 25 "Pitch270" 26 "Pitch180Yaw90" 27 "Pitch180Yaw270" 28 "Roll90Pitch90" 29 "Roll180Pitch90" 30 "Roll270Pitch90" 31 "Roll90Pitch180" 32 "Roll270Pitch180" 33 "Roll90Pitch270" 34 "Roll180Pitch270" 35 "Roll270Pitch270" 36 "Roll90Pitch180Yaw90" 37 "Roll90Yaw270" 38 "Yaw293Pitch68Roll90" /end COMPU_VTAB
/begin CHARACTERISTIC COMPASS_ORIENT "Compass orientation, The orientation of the compass relative to the autopilot board. This will default to the right value for each board type, but can be changed if you have an external compass. See the documentation for your external compass for the right value. The correct orientation should give the X axis forward, the Y axis to the right and the Z axis down. So if your aircraft is pointing west it should show a positive value for the Y axis, and a value close to zero for the X axis. On a PX4 or Pixhawk with an external compass the correct value is zero if the compass is correctly oriented. NOTE: This orientation is combined with any AHRS_ORIENTATION setting." VALUE 0x36100000 Scalar_FLOAT32_IEEE 0 CM_COMPASS_ORIENT 0.0 38.0 /end CHARACTERISTIC
/begin COMPU_METHOD CM_COMPASS_EXTERNAL "Compass is attached via an external cable" TAB_VERB "%17.6" "" COMPU_TAB_REF TAB_COMPASS_EXTERNAL /end COMPU_METHOD
/begin COMPU_VTAB TAB_COMPASS_EXTERNAL "Compass is attached via an external cable, Configure compass so it is attached externally. This is auto-detected on PX4 and Pixhawk. Set to 1 if the compass is externally connected. When externally connected the COMPASS_ORIENT option operates independently of the AHRS_ORIENTATION board orientation option. If set to 0 or 1 then auto-detection by bus connection can override the value. If set to 2 then auto-detection will be disabled." TAB_VERB 3 0 "Internal" 1 "External" 2 "ForcedExternal" /end COMPU_VTAB
/begin CHARACTERISTIC COMPASS_EXTERNAL "Compass is attached via an external cable, Configure compass so it is attached externally. This is auto-detected on PX4 and Pixhawk. Set to 1 if the compass is externally connected. When externally connected the COMPASS_ORIENT option operates independently of the AHRS_ORIENTATION board orientation option. If set to 0 or 1 then auto-detection by bus connection can override the value. If set to 2 then auto-detection will be disabled." VALUE 0x36100000 Scalar_FLOAT32_IEEE 0 CM_COMPASS_EXTERNAL 0.0 2.0 /end CHARACTERISTIC
/begin CHARACTERISTIC COMPASS_OFS2_X "Compass2 offsets in milligauss on the X axis, Offset to be added to compass2's x-axis values to compensate for metal in the frame" VALUE 0x36100000 Scalar_FLOAT32_IEEE 0 MILLIGAUSS -400.0 400.0 /end CHARACTERISTIC
/begin CHARACTERISTIC COMPASS_OFS2_Y "Compass2 offsets in milligauss on the Y axis, Offset to be added to compass2's y-axis values to compensate for metal in the frame" VALUE 0x36100000 Scalar_FLOAT32_IEEE 0 MILLIGAUSS -400.0 400.0 /end CHARACTERISTIC
/begin CHARACTERISTIC COMPASS_OFS2_Z "Compass2 offsets in milligauss on the Z axis, Offset to be added to compass2's z-axis values to compensate for metal in the frame" VALUE 0x36100000 Scalar_FLOAT32_IEEE 0 MILLIGAUSS -400.0 400.0 /end CHARACTERISTIC
/begin CHARACTERISTIC COMPASS_MOT2_X "Motor interference compensation to compass2 for body frame X axis, Multiplied by the current throttle and added to compass2's x-axis values to compensate for motor interference" VALUE 0x36100000 Scalar_FLOAT32_IEEE 0 IDENTICAL -1000.0 1000.0 /end CHARACTERISTIC
/begin CHARACTERISTIC COMPASS_MOT2_Y "Motor interference compensation to compass2 for body frame Y axis, Multiplied by the current throttle and added to compass2's y-axis values to compensate for motor interference" VALUE 0x36100000 Scalar_FLOAT32_IEEE 0 IDENTICAL -1000.0 1000.0 /end CHARACTERISTIC
/begin CHARACTERISTIC COMPASS_MOT2_Z "Motor interference compensation to compass2 for body frame Z axis, Multiplied by the current throttle and added to compass2's z-axis values to compensate for motor interference" VALUE 0x36100000 Scalar_FLOAT32_IEEE 0 IDENTICAL -1000.0 1000.0 /end CHARACTERISTIC
/begin COMPU_METHOD CM_COMPASS_PRIMARY "Choose primary compass" TAB_VERB "%17.6" "" COMPU_TAB_REF TAB_COMPASS_PRIMARY /end COMPU_METHOD
/begin COMPU_VTAB TAB_COMPASS_PRIMARY "Choose primary compass, If more than one compass is available this selects which compass is the primary. Normally 0=External, 1=Internal. If no External compass is attached this parameter is ignored" TAB_VERB 3 0 "FirstCompass" 1 "SecondCompass" 2 "ThirdCompass" /end COMPU_VTAB
/begin CHARACTERISTIC COMPASS_PRIMARY "Choose primary compass, If more than one compass is available this selects which compass is the primary. Normally 0=External, 1=Internal. If no External compass is attached this parameter is ignored" VALUE 0x36100000 Scalar_FLOAT32_IEEE 0 CM_COMPASS_PRIMARY 0.0 2.0 /end CHARACTERISTIC
/begin CHARACTERISTIC COMPASS_OFS3_X "Compass3 offsets in milligauss on the X axis, Offset to be added to compass3's x-axis values to compensate for metal in the frame" VALUE 0x36100000 Scalar_FLOAT32_IEEE 0 MILLIGAUSS -400.0 400.0 /end CHARACTERISTIC
/begin CHARACTERISTIC COMPASS_OFS3_Y "Compass3 offsets in milligauss on the Y axis, Offset to be added to compass3's y-axis values to compensate for metal in the frame" VALUE 0x36100000 Scalar_FLOAT32_IEEE 0 MILLIGAUSS -400.0 400.0 /end CHARACTERISTIC
/begin CHARACTERISTIC COMPASS_OFS3_Z "Compass3 offsets in milligauss on the Z axis, Offset to be added to compass3's z-axis values to compensate for metal in the frame" VALUE 0x36100000 Scalar_FLOAT32_IEEE 0 MILLIGAUSS -400.0 400.0 /end CHARACTERISTIC
/begin CHARACTERISTIC COMPASS_MOT3_X "Motor interference compensation to compass3 for body frame X axis, Multiplied by the current throttle and added to compass3's x-axis values to compensate for motor interference" VALUE 0x36100000 Scalar_FLOAT32_IEEE 0 IDENTICAL -1000.0 1000.0 /end CHARACTERISTIC
/begin CHARACTERISTIC COMPASS_MOT3_Y "Motor interference compensation to compass3 for body frame Y axis, Multiplied by the current throttle and added to compass3's y-axis values to compensate for motor interference" VALUE 0x36100000 Scalar_FLOAT32_IEEE 0 IDENTICAL -1000.0 1000.0 /end CHARACTERISTIC
/begin CHARACTERISTIC COMPASS_MOT3_Z "Motor interference compensation to compass3 for body frame Z axis, Multiplied by the current throttle and added to compass3's z-axis values to compensate for motor interference" VALUE 0x36100000 Scalar_FLOAT32_IEEE 0 IDENTICAL -1000.0 1000.0 /end CHARACTERISTIC
/begin CHARACTERISTIC COMPASS_DEV_ID "Compass device id, Compass device id.  Automatically detected, do not set manually" VALUE 0x36100000 Scalar_FLOAT32_IEEE 0 IDENTICAL -3.40282e+38 3.40282e+38 /end CHARACTERISTIC
/begin CHARACTERISTIC COMPASS_DEV_ID2 "Compass2 device id, Second compass's device id.  Automatically detected, do not set manually" VALUE 0x36100000 Scalar_FLOAT32_IEEE 0 IDENTICAL -3.40282e+38 3.40282e+38 /end CHARACTERISTIC
/begin CHARACTERISTIC COMPASS_DEV_ID3 "Compass3 device id, Third compass's device id.  Automatically detected, do not set manually" VALUE 0x36100000 Scalar_FLOAT32_IEEE 0 IDENTICAL -3.40282e+38 3.40282e+38 /end CHARACTERISTIC
/begin COMPU_METHOD CM_COMPASS_USE2 "Compass2 used for yaw" TAB_VERB "%17.6" "" COMPU_TAB_REF TAB_COMPASS_USE2 /end COMPU_METHOD
/begin COMPU_VTAB TAB_COMPASS_USE2 "Compass2 used for yaw, Enable or disable the second compass for determining heading." TAB_VERB 2 0 "Disabled" 1 "Enabled" /end COMPU_VTAB
/begin CHARACTERISTIC COMPASS_USE2 "Compass2 used for yaw, Enable or disable the second compass for determining heading." VALUE 0x36100000 Scalar_FLOAT32_IEEE 0 CM_COMPASS_USE2 0.0 1.0 /end CHARACTERISTIC
/begin COMPU_METHOD CM_COMPASS_ORIENT2 "Compass2 orientation" TAB_VERB "%17.6" "" COMPU_TAB_REF TAB_COMPASS_ORIENT2 /end COMPU_METHOD
/begin COMPU_VTAB TAB_COMPASS_ORIENT2 "Compass2 orientation, The orientation of the second compass relative to the frame (if external) or autopilot board (if internal)." TAB_VERB 39 0 "None" 1 "Yaw45" 2 "Yaw90" 3 "Yaw135" 4 "Yaw180" 5 "Yaw225" 6 "Yaw270" 7 "Yaw315" 8 "Roll180" 9 "Roll180Yaw45" 10 "Roll180Yaw90" 11 "Roll180Yaw135" 12 "Pitch180" 13 "Roll180Yaw225" 14 "Roll180Yaw270" 15 "Roll180Yaw315" 16 "Roll90" 17 "Roll90Yaw45" 18 "Roll90Yaw90" 19 "Roll90Yaw135" 20 "Roll270" 21 "Roll270Yaw45" 22 "Roll270Yaw90" 23 "Roll270Yaw136" 24 "Pitch90" 25 "Pitch270" 26 "Pitch180Yaw90" 27 "Pitch180Yaw270" 28 "Roll90Pitch90" 29 "Roll180Pitch90" 30 "Roll270Pitch90" 31 "Roll90Pitch180" 32 "Roll270Pitch180" 33 "Roll90Pitch270" 34 "Roll180Pitch270" 35 "Roll270Pitch270" 36 "Roll90Pitch180Yaw90" 37 "Roll90Yaw270" 38 "Yaw293Pitch68Roll90" /end COMPU_VTAB
/begin CHARACTERISTIC COMPASS_ORIENT2 "Compass2 orientation, The orientation of the second compass relative to the frame (if external) or autopilot board (if internal)." VALUE 0x36100000 Scalar_FLOAT32_IEEE 0 CM_COMPASS_ORIENT2 0.0 38.0 /end CHARACTERISTIC
/begin COMPU_METHOD CM_COMPASS_EXTERN2 "Compass2 is attached via an external cable" TAB_VERB "%17.6" "" COMPU_TAB_REF TAB_COMPASS_EXTERN2 /end COMPU_METHOD
/begin COMPU_VTAB TAB_COMPASS_EXTERN2 "Compass2 is attached via an external cable, Configure second compass so it is attached externally. This is auto-detected on PX4 and Pixhawk. If set to 0 or 1 then auto-detection by bus connection can override the value. If set to 2 then auto-detection will be disabled." TAB_VERB 3 0 "Internal" 1 "External" 2 "ForcedExternal" /end COMPU_VTAB
/begin CHARACTERISTIC COMPASS_EXTERN2 "Compass2 is attached via an external cable, Configure second compass so it is attached externally. This is auto-detected on PX4 and Pixhawk. If set to 0 or 1 then auto-detection by bus connection can override the value. If set to 2 then auto-detection will be disabled." VALUE 0x36100000 Scalar_FLOAT32_IEEE 0 CM_COMPASS_EXTERN2 0.0 2.0 /end CHARACTERISTIC
/begin COMPU_METHOD CM_COMPASS_USE3 "Compass3 used for yaw" TAB_VERB "%17.6" "" COMPU_TAB_REF TAB_COMPASS_USE3 /end COMPU_METHOD
/begin COMPU_VTAB TAB_COMPASS_USE3 "Compass3 used for yaw, Enable or disable the third compass for determining heading." TAB_VERB 2 0 "Disabled" 1 "Enabled" /end COMPU_VTAB
/begin CHARACTERISTIC COMPASS_USE3 "Compass3 used for yaw, Enable or disable the third compass for determining heading." VALUE 0x36100000 Scalar_FLOAT32_IEEE 0 CM_COMPASS_USE3 0.0 1.0 /end CHARACTERISTIC
/begin COMPU_METHOD CM_COMPASS_ORIENT3 "Compass3 orientation" TAB_VERB "%17.6" "" COMPU_TAB_REF TAB_COMPASS_ORIENT3 /end COMPU_METHOD
/begin COMPU_VTAB TAB_COMPASS_ORIENT3 "Compass3 orientation, The orientation of the third compass relative to the frame (if external) or autopilot board (if internal)." TAB_VERB 39 0 "None" 1 "Yaw45" 2 "Yaw90" 3 "Yaw135" 4 "Yaw180" 5 "Yaw225" 6 "Yaw270" 7 "Yaw315" 8 "Roll180" 9 "Roll180Yaw45" 10 "Roll180Yaw90" 11 "Roll180Yaw135" 12 "Pitch180" 13 "Roll180Yaw225" 14 "Roll180Yaw270" 15 "Roll180Yaw315" 16 "Roll90" 17 "Roll90Yaw45" 18 "Roll90Yaw90" 19 "Roll90Yaw135" 20 "Roll270" 21 "Roll270Yaw45" 22 "Roll270Yaw90" 23 "Roll270Yaw136" 24 "Pitch90" 25 "Pitch270" 26 "Pitch180Yaw90" 27 "Pitch180Yaw270" 28 "Roll90Pitch90" 29 "Roll180Pitch90" 30 "Roll270Pitch90" 31 "Roll90Pitch180" 32 "Roll270Pitch180" 33 "Roll90Pitch270" 34 "Roll180Pitch270" 35 "Roll270Pitch270" 36 "Roll90Pitch180Yaw90" 37 "Roll90Yaw270" 38 "Yaw293Pitch68Roll90" /end COMPU_VTAB
/begin CHARACTERISTIC COMPASS_ORIENT3 "Compass3 orientation, The orientation of the third compass relative to the frame (if external) or autopilot board (if internal)." VALUE 0x36100000 Scalar_FLOAT32_IEEE 0 CM_COMPASS_ORIENT3 0.0 38.0 /end CHARACTERISTIC
/begin COMPU_METHOD CM_COMPASS_EXTERN3 "Compass3 is attached via an external cable" TAB_VERB "%17.6" "" COMPU_TAB_REF TAB_COMPASS_EXTERN3 /end COMPU_METHOD
/begin COMPU_VTAB TAB_COMPASS_EXTERN3 "Compass3 is attached via an external cable, Configure third compass so it is attached externally. This is auto-detected on PX4 and Pixhawk. If set to 0 or 1 then auto-detection by bus connection can override the value. If set to 2 then auto-detection will be disabled." TAB_VERB 3 0 "Internal" 1 "External" 2 "ForcedExternal" /end COMPU_VTAB
/begin CHARACTERISTIC COMPASS_EXTERN3 "Compass3 is attached via an external cable, Configure third compass so it is attached externally. This is auto-detected on PX4 and Pixhawk. If set to 0 or 1 then auto-detection by bus connection can override the value. If set to 2 then auto-detection will be disabled." VALUE 0x36100000 Scalar_FLOAT32_IEEE 0 CM_COMPASS_EXTERN3 0.0 2.0 /end CHARACTERISTIC
/begin CHARACTERISTIC COMPASS_DIA_X "Compass soft-iron diagonal X component, DIA_X in the compass soft-iron calibration matrix: [[DIA_X, ODI_X, ODI_Y], [ODI_X, DIA_Y, ODI_Z], [ODI_Y, ODI_Z, DIA_Z]]" VALUE 0x36100000 Scalar_FLOAT32_IEEE 0 IDENTICAL -3.40282e+38 3.40282e+38 /end CHARACTERISTIC
/begin CHARACTERISTIC COMPASS_DIA_Y "Compass soft-iron diagonal Y component, DIA_Y in the compass soft-iron calibration matrix: [[DIA_X, ODI_X, ODI_Y], [ODI_X, DIA_Y, ODI_Z], [ODI_Y, ODI_Z, DIA_Z]]" VALUE 0x36100000 Scalar_FLOAT32_IEEE 0 IDENTICAL -3.40282e+38 3.40282e+38 /end CHARACTERISTIC
/begin CHARACTERISTIC COMPASS_DIA_Z "Compass soft-iron diagonal Z component, DIA_Z in the compass soft-iron calibration matrix: [[DIA_X, ODI_X, ODI_Y], [ODI_X, DIA_Y, ODI_Z], [ODI_Y, ODI_Z, DIA_Z]]" VALUE 0x36100000 Scalar_FLOAT32_IEEE 0 IDENTICAL -3.40282e+38 3.40282e+38 /end CHARACTERISTIC
/begin CHARACTERISTIC COMPASS_ODI_X "Compass soft-iron off-diagonal X component, ODI_X in the compass soft-iron calibration matrix: [[DIA_X, ODI_X, ODI_Y], [ODI_X, DIA_Y, ODI_Z], [ODI_Y, ODI_Z, DIA_Z]]" VALUE 0x36100000 Scalar_FLOAT32_IEEE 0 IDENTICAL -3.40282e+38 3.40282e+38 /end CHARACTERISTIC
/begin CHARACTERISTIC COMPASS_ODI_Y "Compass soft-iron off-diagonal Y component, ODI_Y in the compass soft-iron calibration matrix: [[DIA_X, ODI_X, ODI_Y], [ODI_X, DIA_Y, ODI_Z], [ODI_Y, ODI_Z, DIA_Z]]" VALUE 0x36100000 Scalar_FLOAT32_IEEE 0 IDENTICAL -3.40282e+38 3.40282e+38 /end CHARACTERISTIC
/begin CHARACTERISTIC COMPASS_ODI_Z "Compass soft-iron off-diagonal Z component, ODI_Z in the compass soft-iron calibration matrix: [[DIA_X, ODI_X, ODI_Y], [ODI_X, DIA_Y, ODI_Z], [ODI_Y, ODI_Z, DIA_Z]]" VALUE 0x36100000 Scalar_FLOAT32_IEEE 0 IDENTICAL -3.40282e+38 3.40282e+38 /end CHARACTERISTIC
/begin CHARACTERISTIC COMPASS_DIA2_X "Compass2 soft-iron diagonal X component, DIA_X in the compass2 soft-iron calibration matrix: [[DIA_X, ODI_X, ODI_Y], [ODI_X, DIA_Y, ODI_Z], [ODI_Y, ODI_Z, DIA_Z]]" VALUE 0x36100000 Scalar_FLOAT32_IEEE 0 IDENTICAL -3.40282e+38 3.40282e+38 /end CHARACTERISTIC
/begin CHARACTERISTIC COMPASS_DIA2_Y "Compass2 soft-iron diagonal Y component, DIA_Y in the compass2 soft-iron calibration matrix: [[DIA_X, ODI_X, ODI_Y], [ODI_X, DIA_Y, ODI_Z], [ODI_Y, ODI_Z, DIA_Z]]" VALUE 0x36100000 Scalar_FLOAT32_IEEE 0 IDENTICAL -3.40282e+38 3.40282e+38 /end CHARACTERISTIC
/begin CHARACTERISTIC COMPASS_DIA2_Z "Compass2 soft-iron diagonal Z component, DIA_Z in the compass2 soft-iron calibration matrix: [[DIA_X, ODI_X, ODI_Y], [ODI_X, DIA_Y, ODI_Z], [ODI_Y, ODI_Z, DIA_Z]]" VALUE 0x36100000 Scalar_FLOAT32_IEEE 0 IDENTICAL -3.40282e+38 3.40282e+38 /end CHARACTERISTIC
/begin CHARACTERISTIC COMPASS_ODI2_X "Compass2 soft-iron off-diagonal X component, ODI_X in the compass2 soft-iron calibration matrix: [[DIA_X, ODI_X, ODI_Y], [ODI_X, DIA_Y, ODI_Z], [ODI_Y, ODI_Z, DIA_Z]]" VALUE 0x36100000 Scalar_FLOAT32_IEEE 0 IDENTICAL -3.40282e+38 3.40282e+38 /end CHARACTERISTIC
/begin CHARACTERISTIC COMPASS_ODI2_Y "Compass2 soft-iron off-diagonal Y component, ODI_Y in the compass2 soft-iron calibration matrix: [[DIA_X, ODI_X, ODI_Y], [ODI_X, DIA_Y, ODI_Z], [ODI_Y, ODI_Z, DIA_Z]]" VALUE 0x36100000 Scalar_FLOAT32_IEEE 0 IDENTICAL -3.40282e+38 3.40282e+38 /end CHARACTERISTIC
/begin CHARACTERISTIC COMPASS_ODI2_Z "Compass2 soft-iron off-diagonal Z component, ODI_Z in the compass2 soft-iron calibration matrix: [[DIA_X, ODI_X, ODI_Y], [ODI_X, DIA_Y, ODI_Z], [ODI_Y, ODI_Z, DIA_Z]]" VALUE 0x36100000 Scalar_FLOAT32_IEEE 0 IDENTICAL -3.40282e+38 3.40282e+38 /end CHARACTERISTIC
/begin CHARACTERISTIC COMPASS_DIA3_X "Compass3 soft-iron diagonal X component, DIA_X in the compass3 soft-iron calibration matrix: [[DIA_X, ODI_X, ODI_Y], [ODI_X, DIA_Y, ODI_Z], [ODI_Y, ODI_Z, DIA_Z]]" VALUE 0x36100000 Scalar_FLOAT32_IEEE 0 IDENTICAL -3.40282e+38 3.40282e+38 /end CHARACTERISTIC
/begin CHARACTERISTIC COMPASS_DIA3_Y "Compass3 soft-iron diagonal Y component, DIA_Y in the compass3 soft-iron calibration matrix: [[DIA_X, ODI_X, ODI_Y], [ODI_X, DIA_Y, ODI_Z], [ODI_Y, ODI_Z, DIA_Z]]" VALUE 0x36100000 Scalar_FLOAT32_IEEE 0 IDENTICAL -3.40282e+38 3.40282e+38 /end CHARACTERISTIC
/begin CHARACTERISTIC COMPASS_DIA3_Z "Compass3 soft-iron diagonal Z component, DIA_Z in the compass3 soft-iron calibration matrix: [[DIA_X, ODI_X, ODI_Y], [ODI_X, DIA_Y, ODI_Z], [ODI_Y, ODI_Z, DIA_Z]]" VALUE 0x36100000 Scalar_FLOAT32_IEEE 0 IDENTICAL -3.40282e+38 3.40282e+38 /end CHARACTERISTIC
/begin CHARACTERISTIC COMPASS_ODI3_X "Compass3 soft-iron off-diagonal X component, ODI_X in the compass3 soft-iron calibration matrix: [[DIA_X, ODI_X, ODI_Y], [ODI_X, DIA_Y, ODI_Z], [ODI_Y, ODI_Z, DIA_Z]]" VALUE 0x36100000 Scalar_FLOAT32_IEEE 0 IDENTICAL -3.40282e+38 3.40282e+38 /end CHARACTERISTIC
/begin CHARACTERISTIC COMPASS_ODI3_Y "Compass3 soft-iron off-diagonal Y component, ODI_Y in the compass3 soft-iron calibration matrix: [[DIA_X, ODI_X, ODI_Y], [ODI_X, DIA_Y, ODI_Z], [ODI_Y, ODI_Z, DIA_Z]]" VALUE 0x36100000 Scalar_FLOAT32_IEEE 0 IDENTICAL -3.40282e+38 3.40282e+38 /end CHARACTERISTIC
/begin CHARACTERISTIC COMPASS_ODI3_Z "Compass3 soft-iron off-diagonal Z component, ODI_Z in the compass3 soft-iron calibration matrix: [[DIA_X, ODI_X, ODI_Y], [ODI_X, DIA_Y, ODI_Z], [ODI_Y, ODI_Z, DIA_Z]]" VALUE 0x36100000 Scalar_FLOAT32_IEEE 0 IDENTICAL -3.40282e+38 3.40282e+38 /end CHARACTERISTIC
/begin CHARACTERISTIC COMPASS_CAL_FIT "Compass calibration fitness, This controls the fitness level required for a successful compass calibration. A lower value makes for a stricter fit (less likely to pass). This is the value used for the primary magnetometer. Other magnetometers get double the value." VALUE 0x36100000 Scalar_FLOAT32_IEEE 0 IDENTICAL 4.0 20.0 /end CHARACTERISTIC
/begin COMPU_METHOD CM_INS_PRODUCT_ID "IMU Product ID" TAB_VERB "%17.6" "" COMPU_TAB_REF TAB_INS_PRODUCT_ID /end COMPU_METHOD
/begin COMPU_VTAB TAB_INS_PRODUCT_ID "IMU Product ID, Which type of IMU is installed (read-only)." TAB_VERB 9 0 "Unknown" 1 "unused" 2 "unused" 88 "unused" 3 "SITL" 4 "PX4v1" 5 "PX4v2" 256 "unused" 257 "Linux" /end COMPU_VTAB
/begin CHARACTERISTIC INS_PRODUCT_ID "IMU Product ID, Which type of IMU is installed (read-only)." VALUE 0x36100000 Scalar_FLOAT32_IEEE 0 CM_INS_PRODUCT_ID 0.0 257.0 /end CHARACTERISTIC
/begin CHARACTERISTIC INS_GYROFFS_X "Gyro offsets of X axis, Gyro sensor offsets of X axis. This is setup on each boot during gyro calibrations" VALUE 0x36100000 Scalar_FLOAT32_IEEE 0 RADIANS_PER_SECOND -3.40282e+38 3.40282e+38 /end CHARACTERISTIC
/begin CHARACTERISTIC INS_GYROFFS_Y "Gyro offsets of Y axis, Gyro sensor offsets of Y axis. This is setup on each boot during gyro calibrations" VALUE 0x36100000 Scalar_FLOAT32_IEEE 0 RADIANS_PER_SECOND -3.40282e+38 3.40282e+38 /end CHARACTERISTIC
/begin CHARACTERISTIC INS_GYROFFS_Z "Gyro offsets of Z axis, Gyro sensor offsets of Z axis. This is setup on each boot during gyro calibrations" VALUE 0x36100000 Scalar_FLOAT32_IEEE 0 RADIANS_PER_SECOND -3.40282e+38 3.40282e+38 /end CHARACTERISTIC
/begin CHARACTERISTIC INS_GYR2OFFS_X "Gyro2 offsets of X axis, Gyro2 sensor offsets of X axis. This is setup on each boot during gyro calibrations" VALUE 0x36100000 Scalar_FLOAT32_IEEE 0 RADIANS_PER_SECOND -3.40282e+38 3.40282e+38 /end CHARACTERISTIC
/begin CHARACTERISTIC INS_GYR2OFFS_Y "Gyro2 offsets of Y axis, Gyro2 sensor offsets of Y axis. This is setup on each boot during gyro calibrations" VALUE 0x36100000 Scalar_FLOAT32_IEEE 0 RADIANS_PER_SECOND -3.40282e+38 3.40282e+38 /end CHARACTERISTIC
/begin CHARACTERISTIC INS_GYR2OFFS_Z "Gyro2 offsets of Z axis, Gyro2 sensor offsets of Z axis. This is setup on each boot during gyro calibrations" VALUE 0x36100000 Scalar_FLOAT32_IEEE 0 RADIANS_PER_SECOND -3.40282e+38 3.40282e+38 /end CHARACTERISTIC
/begin CHARACTERISTIC INS_GYR3OFFS_X "Gyro3 offsets of X axis, Gyro3 sensor offsets of X axis. This is setup on each boot during gyro calibrations" VALUE 0x36100000 Scalar_FLOAT32_IEEE 0 RADIANS_PER_SECOND -3.40282e+38 3.40282e+38 /end CHARACTERISTIC
/begin CHARACTERISTIC INS_GYR3OFFS_Y "Gyro3 offsets of Y axis, Gyro3 sensor offsets of Y axis. This is setup on each boot during gyro calibrations" VALUE 0x36100000 Scalar_FLOAT32_IEEE 0 RADIANS_PER_SECOND -3.40282e+38 3.40282e+38 /end CHARACTERISTIC
/begin CHARACTERISTIC INS_GYR3OFFS_Z "Gyro3 offsets of Z axis, Gyro3 sensor offsets of Z axis. This is setup on each boot during gyro calibrations" VALUE 0x36100000 Scalar_FLOAT32_IEEE 0 RADIANS_PER_SECOND -3.40282e+38 3.40282e+38 /end CHARACTERISTIC
/begin CHARACTERISTIC INS_ACCSCAL_X "Accelerometer scaling of X axis, Accelerometer scaling of X axis.  Calculated during acceleration calibration routine" VALUE 0x36100000 Scalar_FLOAT32_IEEE 0 IDENTICAL 0.8 1.2 /end CHARACTERISTIC
/begin CHARACTERISTIC INS_ACCSCAL_Y "Accelerometer scaling of Y axis, Accelerometer scaling of Y axis  Calculated during acceleration calibration routine" VALUE 0x36100000 Scalar_FLOAT32_IEEE 0 IDENTICAL 0.8 1.2 /end CHARACTERISTIC
/begin CHARACTERISTIC INS_ACCSCAL_Z "Accelerometer scaling of Z axis, Accelerometer scaling of Z axis  Calculated during acceleration calibration routine" VALUE 0x36100000 Scalar_FLOAT32_IEEE 0 IDENTICAL 0.8 1.2 /end CHARACTERISTIC
/begin CHARACTERISTIC INS_ACCOFFS_X "Accelerometer offsets of X axis, Accelerometer offsets of X axis. This is setup using the acceleration calibration or level operations" VALUE 0x36100000 Scalar_FLOAT32_IEEE 0 METERS_PER_SECOND_PER_SECOND -3.5 3.5 /end CHARACTERISTIC
/begin CHARACTERISTIC INS_ACCOFFS_Y "Accelerometer offsets of Y axis, Accelerometer offsets of Y axis. This is setup using the acceleration calibration or level operations" VALUE 0x36100000 Scalar_FLOAT32_IEEE 0 METERS_PER_SECOND_PER_SECOND -3.5 3.5 /end CHARACTERISTIC
/begin CHARACTERISTIC INS_ACCOFFS_Z "Accelerometer offsets of Z axis, Accelerometer offsets of Z axis. This is setup using the acceleration calibration or level operations" VALUE 0x36100000 Scalar_FLOAT32_IEEE 0 METERS_PER_SECOND_PER_SECOND -3.5 3.5 /end CHARACTERISTIC
/begin CHARACTERISTIC INS_ACC2SCAL_X "Accelerometer2 scaling of X axis, Accelerometer2 scaling of X axis.  Calculated during acceleration calibration routine" VALUE 0x36100000 Scalar_FLOAT32_IEEE 0 IDENTICAL 0.8 1.2 /end CHARACTERISTIC
/begin CHARACTERISTIC INS_ACC2SCAL_Y "Accelerometer2 scaling of Y axis, Accelerometer2 scaling of Y axis  Calculated during acceleration calibration routine" VALUE 0x36100000 Scalar_FLOAT32_IEEE 0 IDENTICAL 0.8 1.2 /end CHARACTERISTIC
/begin CHARACTERISTIC INS_ACC2SCAL_Z "Accelerometer2 scaling of Z axis, Accelerometer2 scaling of Z axis  Calculated during acceleration calibration routine" VALUE 0x36100000 Scalar_FLOAT32_IEEE 0 IDENTICAL 0.8 1.2 /end CHARACTERISTIC
/begin CHARACTERISTIC INS_ACC2OFFS_X "Accelerometer2 offsets of X axis, Accelerometer2 offsets of X axis. This is setup using the acceleration calibration or level operations" VALUE 0x36100000 Scalar_FLOAT32_IEEE 0 METERS_PER_SECOND_PER_SECOND -3.5 3.5 /end CHARACTERISTIC
/begin CHARACTERISTIC INS_ACC2OFFS_Y "Accelerometer2 offsets of Y axis, Accelerometer2 offsets of Y axis. This is setup using the acceleration calibration or level operations" VALUE 0x36100000 Scalar_FLOAT32_IEEE 0 METERS_PER_SECOND_PER_SECOND -3.5 3.5 /end CHARACTERISTIC
/begin CHARACTERISTIC INS_ACC2OFFS_Z "Accelerometer2 offsets of Z axis, Accelerometer2 offsets of Z axis. This is setup using the acceleration calibration or level operations" VALUE 0x36100000 Scalar_FLOAT32_IEEE 0 METERS_PER_SECOND_PER_SECOND -3.5 3.5 /end CHARACTERISTIC
/begin CHARACTERISTIC INS_ACC3SCAL_X "Accelerometer3 scaling of X axis, Accelerometer3 scaling of X axis.  Calculated during acceleration calibration routine" VALUE 0x36100000 Scalar_FLOAT32_IEEE 0 IDENTICAL 0.8 1.2 /end CHARACTERISTIC
/begin CHARACTERISTIC INS_ACC3SCAL_Y "Accelerometer3 scaling of Y axis, Accelerometer3 scaling of Y axis  Calculated during acceleration calibration routine" VALUE 0x36100000 Scalar_FLOAT32_IEEE 0 IDENTICAL 0.8 1.2 /end CHARACTERISTIC
/begin CHARACTERISTIC INS_ACC3SCAL_Z "Accelerometer3 scaling of Z axis, Accelerometer3 scaling of Z axis  Calculated during acceleration calibration routine" VALUE 0x36100000 Scalar_FLOAT32_IEEE 0 IDENTICAL 0.8 1.2 /end CHARACTERISTIC
/begin CHARACTERISTIC INS_ACC3OFFS_X "Accelerometer3 offsets of X axis, Accelerometer3 offsets of X axis. This is setup using the acceleration calibration or level operations" VALUE 0x36100000 Scalar_FLOAT32_IEEE 0 METERS_PER_SECOND_PER_SECOND -3.5 3.5 /end CHARACTERISTIC
/begin CHARACTERISTIC INS_ACC3OFFS_Y "Accelerometer3 offsets of Y axis, Accelerometer3 offsets of Y axis. This is setup using the acceleration calibration or level operations" VALUE 0x36100000 Scalar_FLOAT32_IEEE 0 METERS_PER_SECOND_PER_SECOND -3.5 3.5 /end CHARACTERISTIC
/begin CHARACTERISTIC INS_ACC3OFFS_Z "Accelerometer3 offsets of Z axis, Accelerometer3 offsets of Z axis. This is setup using the acceleration calibration or level operations" VALUE 0x36100000 Scalar_FLOAT32_IEEE 0 METERS_PER_SECOND_PER_SECOND -3.5 3.5 /end CHARACTERISTIC
/begin CHARACTERISTIC INS_GYRO_FILTER "Gyro filter cutoff frequency, Filter cutoff frequency for gyroscopes. This can be set to a lower value to try to cope with very high vibration levels in aircraft. This option takes effect on the next reboot. A value of zero means no filtering (not recommended!)" VALUE 0x36100000 Scalar_FLOAT32_IEEE 0 HERZ 0.0 127.0 /end CHARACTERISTIC
/begin CHARACTERISTIC INS_ACCEL_FILTER "Accel filter cutoff frequency, Filter cutoff frequency for accelerometers. This can be set to a lower value to try to cope with very high vibration levels in aircraft. This option takes effect on the next reboot. A value of zero means no filtering (not recommended!)" VALUE 0x36100000 Scalar_FLOAT32_IEEE 0 HERZ 0.0 127.0 /end CHARACTERISTIC
/begin COMPU_METHOD CM_INS_USE "Use first IMU for attitude" TAB_VERB "%17.6" "" COMPU_TAB_REF TAB_INS_USE /end COMPU_METHOD
/begin COMPU_VTAB TAB_INS_USE "Use first IMU for attitude, velocity and position estimates, Use first IMU for attitude, velocity and position estimates" TAB_VERB 2 0 "Disabled" 1 "Enabled" /end COMPU_VTAB
/begin CHARACTERISTIC INS_USE "Use first IMU for attitude, velocity and position estimates, Use first IMU for attitude, velocity and position estimates" VALUE 0x36100000 Scalar_FLOAT32_IEEE 0 CM_INS_USE 0.0 1.0 /end CHARACTERISTIC
/begin COMPU_METHOD CM_INS_USE2 "Use second IMU for attitude" TAB_VERB "%17.6" "" COMPU_TAB_REF TAB_INS_USE2 /end COMPU_METHOD
/begin COMPU_VTAB TAB_INS_USE2 "Use second IMU for attitude, velocity and position estimates, Use second IMU for attitude, velocity and position estimates" TAB_VERB 2 0 "Disabled" 1 "Enabled" /end COMPU_VTAB
/begin CHARACTERISTIC INS_USE2 "Use second IMU for attitude, velocity and position estimates, Use second IMU for attitude, velocity and position estimates" VALUE 0x36100000 Scalar_FLOAT32_IEEE 0 CM_INS_USE2 0.0 1.0 /end CHARACTERISTIC
/begin COMPU_METHOD CM_INS_USE3 "Use third IMU for attitude" TAB_VERB "%17.6" "" COMPU_TAB_REF TAB_INS_USE3 /end COMPU_METHOD
/begin COMPU_VTAB TAB_INS_USE3 "Use third IMU for attitude, velocity and position estimates, Use third IMU for attitude, velocity and position estimates" TAB_VERB 2 0 "Disabled" 1 "Enabled" /end COMPU_VTAB
/begin CHARACTERISTIC INS_USE3 "Use third IMU for attitude, velocity and position estimates, Use third IMU for attitude, velocity and position estimates" VALUE 0x36100000 Scalar_FLOAT32_IEEE 0 CM_INS_USE3 0.0 1.0 /end CHARACTERISTIC
/begin CHARACTERISTIC INS_STILL_THRESH "Stillness threshold for detecting if we are moving, Threshold to tolerate vibration to determine if vehicle is motionless. This depends on the frame type and if there is a constant vibration due to motors before launch or after landing. Total motionless is about 0.05. Suggested values: Planes/rover use 0.1, multirotors use 1, tradHeli uses 5" VALUE 0x36100000 Scalar_FLOAT32_IEEE 0 IDENTICAL 0.05 50.0 /end CHARACTERISTIC
/begin COMPU_METHOD CM_INS_GYR_CAL "Gyro Calibration scheme" TAB_VERB "%17.6" "" COMPU_TAB_REF TAB_INS_GYR_CAL /end COMPU_METHOD
/begin COMPU_VTAB TAB_INS_GYR_CAL "Gyro Calibration scheme, Conrols when automatic gyro calibration is performed" TAB_VERB 2 0 "Never" 1 "Start-up only" /end COMPU_VTAB
/begin CHARACTERISTIC INS_GYR_CAL "Gyro Calibration scheme, Conrols when automatic gyro calibration is performed" VALUE 0x36100000 Scalar_FLOAT32_IEEE 0 CM_INS_GYR_CAL 0.0 1.0 /end CHARACTERISTIC
/begin COMPU_METHOD CM_INS_TRIM_OPTION "Accel cal trim option" TAB_VERB "%17.6" "" COMPU_TAB_REF TAB_INS_TRIM_OPTION /end COMPU_METHOD
/begin COMPU_VTAB TAB_INS_TRIM_OPTION "Accel cal trim option, Specifies how the accel cal routine determines the trims" TAB_VERB 3 0 "Don't adjust the trims" 1 "Assume first orientation was level" 2 "Assume ACC_BODYFIX is perfectly aligned to the vehicle" /end COMPU_VTAB
/begin CHARACTERISTIC INS_TRIM_OPTION "Accel cal trim option, Specifies how the accel cal routine determines the trims" VALUE 0x36100000 Scalar_FLOAT32_IEEE 0 CM_INS_TRIM_OPTION 0.0 2.0 /end CHARACTERISTIC
/begin COMPU_METHOD CM_INS_ACC_BODYFIX "Body-fixed accelerometer" TAB_VERB "%17.6" "" COMPU_TAB_REF TAB_INS_ACC_BODYFIX /end COMPU_METHOD
/begin COMPU_VTAB TAB_INS_ACC_BODYFIX "Body-fixed accelerometer, The body-fixed accelerometer to be used for trim calculation" TAB_VERB 3 1 "IMU 1" 2 "IMU 2" 3 "IMU 3" /end COMPU_VTAB
/begin CHARACTERISTIC INS_ACC_BODYFIX "Body-fixed accelerometer, The body-fixed accelerometer to be used for trim calculation" VALUE 0x36100000 Scalar_FLOAT32_IEEE 0 CM_INS_ACC_BODYFIX 1.0 3.0 /end CHARACTERISTIC
/begin CHARACTERISTIC WPNAV_SPEED "Waypoint Horizontal Speed Target, Defines the speed in cm/s which the aircraft will attempt to maintain horizontally during a WP mission" VALUE 0x36100000 Scalar_FLOAT32_IEEE 0 CENTIMETERS_PER_SECOND 0.0 2000.0 /end CHARACTERISTIC
/begin CHARACTERISTIC WPNAV_RADIUS "Waypoint Radius, Defines the distance from a waypoint, that when crossed indicates the wp has been hit." VALUE 0x36100000 Scalar_FLOAT32_IEEE 0 CENTIMETERS 100.0 1000.0 /end CHARACTERISTIC
/begin CHARACTERISTIC WPNAV_SPEED_UP "Waypoint Climb Speed Target, Defines the speed in cm/s which the aircraft will attempt to maintain while climbing during a WP mission" VALUE 0x36100000 Scalar_FLOAT32_IEEE 0 CENTIMETERS_PER_SECOND 0.0 1000.0 /end CHARACTERISTIC
/begin CHARACTERISTIC WPNAV_SPEED_DN "Waypoint Descent Speed Target, Defines the speed in cm/s which the aircraft will attempt to maintain while descending during a WP mission" VALUE 0x36100000 Scalar_FLOAT32_IEEE 0 CENTIMETERS_PER_SECOND 0.0 500.0 /end CHARACTERISTIC
/begin CHARACTERISTIC WPNAV_LOIT_SPEED "Loiter Horizontal Maximum Speed, Defines the maximum speed in cm/s which the aircraft will travel horizontally while in loiter mode" VALUE 0x36100000 Scalar_FLOAT32_IEEE 0 CENTIMETERS_PER_SECOND 0.0 2000.0 /end CHARACTERISTIC
/begin CHARACTERISTIC WPNAV_ACCEL "Waypoint Acceleration , Defines the horizontal acceleration in cm/s/s used during missions" VALUE 0x36100000 Scalar_FLOAT32_IEEE 0 CENTIMETERS_PER_SECOND_PER_SECOND 50.0 500.0 /end CHARACTERISTIC
/begin CHARACTERISTIC WPNAV_ACCEL_Z "Waypoint Vertical Acceleration, Defines the vertical acceleration in cm/s/s used during missions" VALUE 0x36100000 Scalar_FLOAT32_IEEE 0 CENTIMETERS_PER_SECOND_PER_SECOND 50.0 500.0 /end CHARACTERISTIC
/begin CHARACTERISTIC WPNAV_LOIT_JERK "Loiter maximum jerk, Loiter maximum jerk in cm/s/s/s" VALUE 0x36100000 Scalar_FLOAT32_IEEE 0 CENTIMETERS_PER_SECOND_PER_SECOND 500.0 5000.0 /end CHARACTERISTIC
/begin CHARACTERISTIC WPNAV_LOIT_MAXA "Loiter maximum acceleration, Loiter maximum acceleration in cm/s/s.  Higher values cause the copter to accelerate and stop more quickly." VALUE 0x36100000 Scalar_FLOAT32_IEEE 0 CENTIMETERS_PER_SECOND_PER_SECOND 100.0 981.0 /end CHARACTERISTIC
/begin CHARACTERISTIC WPNAV_LOIT_MINA "Loiter minimum acceleration, Loiter minimum acceleration in cm/s/s. Higher values stop the copter more quickly when the stick is centered, but cause a larger jerk when the copter stops." VALUE 0x36100000 Scalar_FLOAT32_IEEE 0 CENTIMETERS_PER_SECOND_PER_SECOND 25.0 250.0 /end CHARACTERISTIC
/begin CHARACTERISTIC CIRCLE_RADIUS "Circle Radius, Defines the radius of the circle the vehicle will fly when in Circle flight mode" VALUE 0x36100000 Scalar_FLOAT32_IEEE 0 CENTIMETERS 0.0 10000.0 /end CHARACTERISTIC
/begin CHARACTERISTIC CIRCLE_RATE "Circle rate, Circle mode's turn rate in deg/sec.  Positive to turn clockwise, negative for counter clockwise" VALUE 0x36100000 Scalar_FLOAT32_IEEE 0 DEGREES_PER_SECOND -90.0 90.0 /end CHARACTERISTIC
/begin CHARACTERISTIC ATC_SLEW_YAW "Yaw target slew rate, Maximum rate the yaw target can be updated in Loiter, RTL, Auto flight modes" VALUE 0x36100000 Scalar_FLOAT32_IEEE 0 CENTIDEGREES 500.0 18000.0 /end CHARACTERISTIC
/begin COMPU_METHOD CM_ATC_ACCEL_Y_MAX "Acceleration Max for Yaw" TAB_VERB "%17.6" "" COMPU_TAB_REF TAB_ATC_ACCEL_Y_MAX /end COMPU_METHOD
/begin COMPU_VTAB TAB_ATC_ACCEL_Y_MAX "Acceleration Max for Yaw, Maximum acceleration in yaw axis" TAB_VERB 4 0 "Disabled" 18000 "Slow" 36000 "Medium" 54000 "Fast" /end COMPU_VTAB
/begin CHARACTERISTIC ATC_ACCEL_Y_MAX "Acceleration Max for Yaw, Maximum acceleration in yaw axis" VALUE 0x36100000 Scalar_FLOAT32_IEEE 0 CM_ATC_ACCEL_Y_MAX 0.0 72000.0 /end CHARACTERISTIC
/begin COMPU_METHOD CM_ATC_RATE_FF_ENAB "Rate Feedforward Enable" TAB_VERB "%17.6" "" COMPU_TAB_REF TAB_ATC_RATE_FF_ENAB /end COMPU_METHOD
/begin COMPU_VTAB TAB_ATC_RATE_FF_ENAB "Rate Feedforward Enable, Controls whether body-frame rate feedfoward is enabled or disabled" TAB_VERB 2 0 "Disabled" 1 "Enabled" /end COMPU_VTAB
/begin CHARACTERISTIC ATC_RATE_FF_ENAB "Rate Feedforward Enable, Controls whether body-frame rate feedfoward is enabled or disabled" VALUE 0x36100000 Scalar_FLOAT32_IEEE 0 CM_ATC_RATE_FF_ENAB 0.0 1.0 /end CHARACTERISTIC
/begin COMPU_METHOD CM_ATC_ACCEL_R_MAX "Acceleration Max for Roll" TAB_VERB "%17.6" "" COMPU_TAB_REF TAB_ATC_ACCEL_R_MAX /end COMPU_METHOD
/begin COMPU_VTAB TAB_ATC_ACCEL_R_MAX "Acceleration Max for Roll, Maximum acceleration in roll axis" TAB_VERB 4 0 "Disabled" 72000 "Slow" 108000 "Medium" 162000 "Fast" /end COMPU_VTAB
/begin CHARACTERISTIC ATC_ACCEL_R_MAX "Acceleration Max for Roll, Maximum acceleration in roll axis" VALUE 0x36100000 Scalar_FLOAT32_IEEE 0 CM_ATC_ACCEL_R_MAX 0.0 180000.0 /end CHARACTERISTIC
/begin COMPU_METHOD CM_ATC_ACCEL_P_MAX "Acceleration Max for Pitch" TAB_VERB "%17.6" "" COMPU_TAB_REF TAB_ATC_ACCEL_P_MAX /end COMPU_METHOD
/begin COMPU_VTAB TAB_ATC_ACCEL_P_MAX "Acceleration Max for Pitch, Maximum acceleration in pitch axis" TAB_VERB 4 0 "Disabled" 72000 "Slow" 108000 "Medium" 162000 "Fast" /end COMPU_VTAB
/begin CHARACTERISTIC ATC_ACCEL_P_MAX "Acceleration Max for Pitch, Maximum acceleration in pitch axis" VALUE 0x36100000 Scalar_FLOAT32_IEEE 0 CM_ATC_ACCEL_P_MAX 0.0 180000.0 /end CHARACTERISTIC
/begin COMPU_METHOD CM_ATC_ANGLE_BOOST "Angle Boost" TAB_VERB "%17.6" "" COMPU_TAB_REF TAB_ATC_ANGLE_BOOST /end COMPU_METHOD
/begin COMPU_VTAB TAB_ATC_ANGLE_BOOST "Angle Boost, Angle Boost increases output throttle as the vehicle leans to reduce loss of altitude" TAB_VERB 2 0 "Disabled" 1 "Enabled" /end COMPU_VTAB
/begin CHARACTERISTIC ATC_ANGLE_BOOST "Angle Boost, Angle Boost increases output throttle as the vehicle leans to reduce loss of altitude" VALUE 0x36100000 Scalar_FLOAT32_IEEE 0 CM_ATC_ANGLE_BOOST 0.0 1.0 /end CHARACTERISTIC
/begin CHARACTERISTIC ATC_ANG_RLL_P "Roll axis angle controller P gain, Roll axis angle controller P gain.  Converts the error between the desired roll angle and actual angle to a desired roll rate" VALUE 0x36100000 Scalar_FLOAT32_IEEE 0 IDENTICAL 3.0 12.0 /end CHARACTERISTIC
/begin CHARACTERISTIC ATC_ANG_PIT_P "Pitch axis angle controller P gain, Pitch axis angle controller P gain.  Converts the error between the desired pitch angle and actual angle to a desired pitch rate" VALUE 0x36100000 Scalar_FLOAT32_IEEE 0 IDENTICAL 3.0 12.0 /end CHARACTERISTIC
/begin CHARACTERISTIC ATC_ANG_YAW_P "Yaw axis angle controller P gain, Yaw axis angle controller P gain.  Converts the error between the desired yaw angle and actual angle to a desired yaw rate" VALUE 0x36100000 Scalar_FLOAT32_IEEE 0 IDENTICAL 3.0 6.0 /end CHARACTERISTIC
/begin CHARACTERISTIC ATC_ANG_LIM_TC "Angle Limit (to maintain altitude) Time Constant, Angle Limit (to maintain altitude) Time Constant" VALUE 0x36100000 Scalar_FLOAT32_IEEE 0 IDENTICAL 0.5 10.0 /end CHARACTERISTIC
/begin CHARACTERISTIC ATC_RAT_RLL_P "Roll axis rate controller P gain, Roll axis rate controller P gain.  Converts the difference between desired roll rate and actual roll rate into a motor speed output" VALUE 0x36100000 Scalar_FLOAT32_IEEE 0 IDENTICAL 0.08 0.3 /end CHARACTERISTIC
/begin CHARACTERISTIC ATC_RAT_RLL_I "Roll axis rate controller I gain, Roll axis rate controller I gain.  Corrects long-term difference in desired roll rate vs actual roll rate" VALUE 0x36100000 Scalar_FLOAT32_IEEE 0 IDENTICAL 0.01 0.5 /end CHARACTERISTIC
/begin CHARACTERISTIC ATC_RAT_RLL_IMAX "Roll axis rate controller I gain maximum, Roll axis rate controller I gain maximum.  Constrains the maximum motor output that the I gain will output" VALUE 0x36100000 Scalar_FLOAT32_IEEE 0 PERCENT 0.0 1.0 /end CHARACTERISTIC
/begin CHARACTERISTIC ATC_RAT_RLL_D "Roll axis rate controller D gain, Roll axis rate controller D gain.  Compensates for short-term change in desired roll rate vs actual roll rate" VALUE 0x36100000 Scalar_FLOAT32_IEEE 0 IDENTICAL 0.0 0.02 /end CHARACTERISTIC
/begin CHARACTERISTIC ATC_RAT_RLL_FILT "Roll axis rate conroller input frequency in Hz, Roll axis rate conroller input frequency in Hz" VALUE 0x36100000 Scalar_FLOAT32_IEEE 0 HERZ 1.0 100.0 /end CHARACTERISTIC
/begin CHARACTERISTIC ATC_RAT_PIT_P "Pitch axis rate controller P gain, Pitch axis rate controller P gain.  Converts the difference between desired pitch rate and actual pitch rate into a motor speed output" VALUE 0x36100000 Scalar_FLOAT32_IEEE 0 IDENTICAL 0.08 0.3 /end CHARACTERISTIC
/begin CHARACTERISTIC ATC_RAT_PIT_I "Pitch axis rate controller I gain, Pitch axis rate controller I gain.  Corrects long-term difference in desired pitch rate vs actual pitch rate" VALUE 0x36100000 Scalar_FLOAT32_IEEE 0 IDENTICAL 0.01 0.5 /end CHARACTERISTIC
/begin CHARACTERISTIC ATC_RAT_PIT_IMAX "Pitch axis rate controller I gain maximum, Pitch axis rate controller I gain maximum.  Constrains the maximum motor output that the I gain will output" VALUE 0x36100000 Scalar_FLOAT32_IEEE 0 PERCENT 0.0 1.0 /end CHARACTERISTIC
/begin CHARACTERISTIC ATC_RAT_PIT_D "Pitch axis rate controller D gain, Pitch axis rate controller D gain.  Compensates for short-term change in desired pitch rate vs actual pitch rate" VALUE 0x36100000 Scalar_FLOAT32_IEEE 0 IDENTICAL 0.0 0.02 /end CHARACTERISTIC
/begin CHARACTERISTIC ATC_RAT_PIT_FILT "Pitch axis rate conroller input frequency in Hz, Pitch axis rate conroller input frequency in Hz" VALUE 0x36100000 Scalar_FLOAT32_IEEE 0 HERZ 1.0 100.0 /end CHARACTERISTIC
/begin CHARACTERISTIC ATC_RAT_YAW_P "Yaw axis rate controller P gain, Yaw axis rate controller P gain.  Converts the difference between desired yaw rate and actual yaw rate into a motor speed output" VALUE 0x36100000 Scalar_FLOAT32_IEEE 0 IDENTICAL 0.1 0.5 /end CHARACTERISTIC
/begin CHARACTERISTIC ATC_RAT_YAW_I "Yaw axis rate controller I gain, Yaw axis rate controller I gain.  Corrects long-term difference in desired yaw rate vs actual yaw rate" VALUE 0x36100000 Scalar_FLOAT32_IEEE 0 IDENTICAL 0.01 0.05 /end CHARACTERISTIC
/begin CHARACTERISTIC ATC_RAT_YAW_IMAX "Yaw axis rate controller I gain maximum, Yaw axis rate controller I gain maximum.  Constrains the maximum motor output that the I gain will output" VALUE 0x36100000 Scalar_FLOAT32_IEEE 0 PERCENT 0.0 1.0 /end CHARACTERISTIC
/begin CHARACTERISTIC ATC_RAT_YAW_D "Yaw axis rate controller D gain, Yaw axis rate controller D gain.  Compensates for short-term change in desired yaw rate vs actual yaw rate" VALUE 0x36100000 Scalar_FLOAT32_IEEE 0 IDENTICAL 0.0 0.02 /end CHARACTERISTIC
/begin CHARACTERISTIC ATC_RAT_YAW_FILT "Yaw axis rate conroller input frequency in Hz, Yaw axis rate conroller input frequency in Hz" VALUE 0x36100000 Scalar_FLOAT32_IEEE 0 HERZ 1.0 100.0 /end CHARACTERISTIC
/begin CHARACTERISTIC ATC_THR_MIX_MIN "Throttle Mix Minimum, Throttle vs attitude control prioritisation used when landing (higher values mean we prioritise attitude control over throttle)" VALUE 0x36100000 Scalar_FLOAT32_IEEE 0 IDENTICAL 0.1 0.25 /end CHARACTERISTIC
/begin CHARACTERISTIC ATC_THR_MIX_MAX "Throttle Mix Maximum, Throttle vs attitude control prioritisation used during active flight (higher values mean we prioritise attitude control over throttle)" VALUE 0x36100000 Scalar_FLOAT32_IEEE 0 IDENTICAL 0.5 0.9 /end CHARACTERISTIC
/begin CHARACTERISTIC POSCON__ACC_XY_FILT "XY Acceleration filter cutoff frequency, Lower values will slow the response of the navigation controller and reduce twitchiness" VALUE 0x36100000 Scalar_FLOAT32_IEEE 0 HERZ 0.5 5.0 /end CHARACTERISTIC
/begin CHARACTERISTIC SR0_RAW_SENS "Raw sensor stream rate, Stream rate of RAW_IMU, SCALED_IMU2, SCALED_PRESSURE, and SENSOR_OFFSETS to ground station" VALUE 0x36100000 Scalar_FLOAT32_IEEE 0 HERZ 0.0 10.0 /end CHARACTERISTIC
/begin CHARACTERISTIC SR0_EXT_STAT "Extended status stream rate to ground station, Stream rate of SYS_STATUS, MEMINFO, MISSION_CURRENT, GPS_RAW_INT, NAV_CONTROLLER_OUTPUT, and LIMITS_STATUS to ground station" VALUE 0x36100000 Scalar_FLOAT32_IEEE 0 HERZ 0.0 10.0 /end CHARACTERISTIC
/begin CHARACTERISTIC SR0_RC_CHAN "RC Channel stream rate to ground station, Stream rate of SERVO_OUTPUT_RAW and RC_CHANNELS_RAW to ground station" VALUE 0x36100000 Scalar_FLOAT32_IEEE 0 HERZ 0.0 10.0 /end CHARACTERISTIC
/begin CHARACTERISTIC SR0_RAW_CTRL "Raw Control stream rate to ground station, Stream rate of RC_CHANNELS_SCALED (HIL only) to ground station" VALUE 0x36100000 Scalar_FLOAT32_IEEE 0 HERZ 0.0 10.0 /end CHARACTERISTIC
/begin CHARACTERISTIC SR0_POSITION "Position stream rate to ground station, Stream rate of GLOBAL_POSITION_INT to ground station" VALUE 0x36100000 Scalar_FLOAT32_IEEE 0 HERZ 0.0 10.0 /end CHARACTERISTIC
/begin CHARACTERISTIC SR0_EXTRA1 "Extra data type 1 stream rate to ground station, Stream rate of ATTITUDE and SIMSTATE (SITL only) to ground station" VALUE 0x36100000 Scalar_FLOAT32_IEEE 0 HERZ 0.0 10.0 /end CHARACTERISTIC
/begin CHARACTERISTIC SR0_EXTRA2 "Extra data type 2 stream rate to ground station, Stream rate of VFR_HUD to ground station" VALUE 0x36100000 Scalar_FLOAT32_IEEE 0 HERZ 0.0 10.0 /end CHARACTERISTIC
/begin CHARACTERISTIC SR0_EXTRA3 "Extra data type 3 stream rate to ground station, Stream rate of AHRS, HWSTATUS, and SYSTEM_TIME to ground station" VALUE 0x36100000 Scalar_FLOAT32_IEEE 0 HERZ 0.0 10.0 /end CHARACTERISTIC
/begin CHARACTERISTIC SR0_PARAMS "Parameter stream rate to ground station, Stream rate of PARAM_VALUE to ground station" VALUE 0x36100000 Scalar_FLOAT32_IEEE 0 HERZ 0.0 10.0 /end CHARACTERISTIC
/begin CHARACTERISTIC SR0_ADSB "ADSB stream rate to ground station, ADSB stream rate to ground station" VALUE 0x36100000 Scalar_FLOAT32_IEEE 0 HERZ 0.0 50.0 /end CHARACTERISTIC
/begin CHARACTERISTIC SR1_RAW_SENS "Raw sensor stream rate, Stream rate of RAW_IMU, SCALED_IMU2, SCALED_PRESSURE, and SENSOR_OFFSETS to ground station" VALUE 0x36100000 Scalar_FLOAT32_IEEE 0 HERZ 0.0 10.0 /end CHARACTERISTIC
/begin CHARACTERISTIC SR1_EXT_STAT "Extended status stream rate to ground station, Stream rate of SYS_STATUS, MEMINFO, MISSION_CURRENT, GPS_RAW_INT, NAV_CONTROLLER_OUTPUT, and LIMITS_STATUS to ground station" VALUE 0x36100000 Scalar_FLOAT32_IEEE 0 HERZ 0.0 10.0 /end CHARACTERISTIC
/begin CHARACTERISTIC SR1_RC_CHAN "RC Channel stream rate to ground station, Stream rate of SERVO_OUTPUT_RAW and RC_CHANNELS_RAW to ground station" VALUE 0x36100000 Scalar_FLOAT32_IEEE 0 HERZ 0.0 10.0 /end CHARACTERISTIC
/begin CHARACTERISTIC SR1_RAW_CTRL "Raw Control stream rate to ground station, Stream rate of RC_CHANNELS_SCALED (HIL only) to ground station" VALUE 0x36100000 Scalar_FLOAT32_IEEE 0 HERZ 0.0 10.0 /end CHARACTERISTIC
/begin CHARACTERISTIC SR1_POSITION "Position stream rate to ground station, Stream rate of GLOBAL_POSITION_INT to ground station" VALUE 0x36100000 Scalar_FLOAT32_IEEE 0 HERZ 0.0 10.0 /end CHARACTERISTIC
/begin CHARACTERISTIC SR1_EXTRA1 "Extra data type 1 stream rate to ground station, Stream rate of ATTITUDE and SIMSTATE (SITL only) to ground station" VALUE 0x36100000 Scalar_FLOAT32_IEEE 0 HERZ 0.0 10.0 /end CHARACTERISTIC
/begin CHARACTERISTIC SR1_EXTRA2 "Extra data type 2 stream rate to ground station, Stream rate of VFR_HUD to ground station" VALUE 0x36100000 Scalar_FLOAT32_IEEE 0 HERZ 0.0 10.0 /end CHARACTERISTIC
/begin CHARACTERISTIC SR1_EXTRA3 "Extra data type 3 stream rate to ground station, Stream rate of AHRS, HWSTATUS, and SYSTEM_TIME to ground station" VALUE 0x36100000 Scalar_FLOAT32_IEEE 0 HERZ 0.0 10.0 /end CHARACTERISTIC
/begin CHARACTERISTIC SR1_PARAMS "Parameter stream rate to ground station, Stream rate of PARAM_VALUE to ground station" VALUE 0x36100000 Scalar_FLOAT32_IEEE 0 HERZ 0.0 10.0 /end CHARACTERISTIC
/begin CHARACTERISTIC SR1_ADSB "ADSB stream rate to ground station, ADSB stream rate to ground station" VALUE 0x36100000 Scalar_FLOAT32_IEEE 0 HERZ 0.0 50.0 /end CHARACTERISTIC
/begin CHARACTERISTIC SR2_RAW_SENS "Raw sensor stream rate, Stream rate of RAW_IMU, SCALED_IMU2, SCALED_PRESSURE, and SENSOR_OFFSETS to ground station" VALUE 0x36100000 Scalar_FLOAT32_IEEE 0 HERZ 0.0 10.0 /end CHARACTERISTIC
/begin CHARACTERISTIC SR2_EXT_STAT "Extended status stream rate to ground station, Stream rate of SYS_STATUS, MEMINFO, MISSION_CURRENT, GPS_RAW_INT, NAV_CONTROLLER_OUTPUT, and LIMITS_STATUS to ground station" VALUE 0x36100000 Scalar_FLOAT32_IEEE 0 HERZ 0.0 10.0 /end CHARACTERISTIC
/begin CHARACTERISTIC SR2_RC_CHAN "RC Channel stream rate to ground station, Stream rate of SERVO_OUTPUT_RAW and RC_CHANNELS_RAW to ground station" VALUE 0x36100000 Scalar_FLOAT32_IEEE 0 HERZ 0.0 10.0 /end CHARACTERISTIC
/begin CHARACTERISTIC SR2_RAW_CTRL "Raw Control stream rate to ground station, Stream rate of RC_CHANNELS_SCALED (HIL only) to ground station" VALUE 0x36100000 Scalar_FLOAT32_IEEE 0 HERZ 0.0 10.0 /end CHARACTERISTIC
/begin CHARACTERISTIC SR2_POSITION "Position stream rate to ground station, Stream rate of GLOBAL_POSITION_INT to ground station" VALUE 0x36100000 Scalar_FLOAT32_IEEE 0 HERZ 0.0 10.0 /end CHARACTERISTIC
/begin CHARACTERISTIC SR2_EXTRA1 "Extra data type 1 stream rate to ground station, Stream rate of ATTITUDE and SIMSTATE (SITL only) to ground station" VALUE 0x36100000 Scalar_FLOAT32_IEEE 0 HERZ 0.0 10.0 /end CHARACTERISTIC
/begin CHARACTERISTIC SR2_EXTRA2 "Extra data type 2 stream rate to ground station, Stream rate of VFR_HUD to ground station" VALUE 0x36100000 Scalar_FLOAT32_IEEE 0 HERZ 0.0 10.0 /end CHARACTERISTIC
/begin CHARACTERISTIC SR2_EXTRA3 "Extra data type 3 stream rate to ground station, Stream rate of AHRS, HWSTATUS, and SYSTEM_TIME to ground station" VALUE 0x36100000 Scalar_FLOAT32_IEEE 0 HERZ 0.0 10.0 /end CHARACTERISTIC
/begin CHARACTERISTIC SR2_PARAMS "Parameter stream rate to ground station, Stream rate of PARAM_VALUE to ground station" VALUE 0x36100000 Scalar_FLOAT32_IEEE 0 HERZ 0.0 10.0 /end CHARACTERISTIC
/begin CHARACTERISTIC SR2_ADSB "ADSB stream rate to ground station, ADSB stream rate to ground station" VALUE 0x36100000 Scalar_FLOAT32_IEEE 0 HERZ 0.0 50.0 /end CHARACTERISTIC
/begin CHARACTERISTIC SR3_RAW_SENS "Raw sensor stream rate, Stream rate of RAW_IMU, SCALED_IMU2, SCALED_PRESSURE, and SENSOR_OFFSETS to ground station" VALUE 0x36100000 Scalar_FLOAT32_IEEE 0 HERZ 0.0 10.0 /end CHARACTERISTIC
/begin CHARACTERISTIC SR3_EXT_STAT "Extended status stream rate to ground station, Stream rate of SYS_STATUS, MEMINFO, MISSION_CURRENT, GPS_RAW_INT, NAV_CONTROLLER_OUTPUT, and LIMITS_STATUS to ground station" VALUE 0x36100000 Scalar_FLOAT32_IEEE 0 HERZ 0.0 10.0 /end CHARACTERISTIC
/begin CHARACTERISTIC SR3_RC_CHAN "RC Channel stream rate to ground station, Stream rate of SERVO_OUTPUT_RAW and RC_CHANNELS_RAW to ground station" VALUE 0x36100000 Scalar_FLOAT32_IEEE 0 HERZ 0.0 10.0 /end CHARACTERISTIC
/begin CHARACTERISTIC SR3_RAW_CTRL "Raw Control stream rate to ground station, Stream rate of RC_CHANNELS_SCALED (HIL only) to ground station" VALUE 0x36100000 Scalar_FLOAT32_IEEE 0 HERZ 0.0 10.0 /end CHARACTERISTIC
/begin CHARACTERISTIC SR3_POSITION "Position stream rate to ground station, Stream rate of GLOBAL_POSITION_INT to ground station" VALUE 0x36100000 Scalar_FLOAT32_IEEE 0 HERZ 0.0 10.0 /end CHARACTERISTIC
/begin CHARACTERISTIC SR3_EXTRA1 "Extra data type 1 stream rate to ground station, Stream rate of ATTITUDE and SIMSTATE (SITL only) to ground station" VALUE 0x36100000 Scalar_FLOAT32_IEEE 0 HERZ 0.0 10.0 /end CHARACTERISTIC
/begin CHARACTERISTIC SR3_EXTRA2 "Extra data type 2 stream rate to ground station, Stream rate of VFR_HUD to ground station" VALUE 0x36100000 Scalar_FLOAT32_IEEE 0 HERZ 0.0 10.0 /end CHARACTERISTIC
/begin CHARACTERISTIC SR3_EXTRA3 "Extra data type 3 stream rate to ground station, Stream rate of AHRS, HWSTATUS, and SYSTEM_TIME to ground station" VALUE 0x36100000 Scalar_FLOAT32_IEEE 0 HERZ 0.0 10.0 /end CHARACTERISTIC
/begin CHARACTERISTIC SR3_PARAMS "Parameter stream rate to ground station, Stream rate of PARAM_VALUE to ground station" VALUE 0x36100000 Scalar_FLOAT32_IEEE 0 HERZ 0.0 10.0 /end CHARACTERISTIC
/begin CHARACTERISTIC SR3_ADSB "ADSB stream rate to ground station, ADSB stream rate to ground station" VALUE 0x36100000 Scalar_FLOAT32_IEEE 0 HERZ 0.0 50.0 /end CHARACTERISTIC
/begin CHARACTERISTIC AHRS_GPS_GAIN "AHRS GPS gain, This controls how how much to use the GPS to correct the attitude. This should never be set to zero for a plane as it would result in the plane losing control in turns. For a plane please use the default value of 1.0." VALUE 0x36100000 Scalar_FLOAT32_IEEE 0 IDENTICAL 0.0 1.0 /end CHARACTERISTIC
/* Rendered 712 CHARACTERISTIC(s), 4 MEASUREMENT(s), 237 VTAB(s) */
